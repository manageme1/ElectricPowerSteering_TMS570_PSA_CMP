AUTOSAR XML (schema 314)
package /PortInterface
  sender receiver interface HwTrq_HwNm_f32
    data HwNm_f32: sw-calibration-access=READ-ONLY, type=Float
  sender receiver interface MtrTrq_MtrNm_f32
    data MtrNm_f32: sw-calibration-access=READ-ONLY, type=Float
  sender receiver interface VehSpd_Kph_f32
    data Kph_f32: sw-calibration-access=READ-ONLY, type=Float
