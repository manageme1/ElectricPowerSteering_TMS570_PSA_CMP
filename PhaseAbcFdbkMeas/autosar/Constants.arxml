AUTOSAR XML (schema 314)
package /Constant
  constant specification D_ZERO_CNT_U32
    value:
      integer literal D_ZERO_CNT_U32: type=UInt32, value=0
