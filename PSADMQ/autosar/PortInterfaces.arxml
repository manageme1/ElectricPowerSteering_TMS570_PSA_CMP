AUTOSAR XML (schema 314)
package /PortInterface
  sender receiver interface BoolStatusFlag_Cnt_lgc
    data Cnt_lgc: sw-calibration-access=READ-ONLY, type=Boolean
  sender receiver interface Count_Cnt_u16
    data Cnt_u16: sw-calibration-access=READ-ONLY, type=UInt16
  sender receiver interface PsaTunModSt_Cnt_enum
    data Cnt_enum: sw-calibration-access=READ-ONLY, type=PsaTunModSt_Cnt_enum
