AUTOSAR XML (schema 314)
package /ModeDclrGroup
  mode declaration group StaMd_Mode: initial-mode=WARMINIT  # EPS System State mode declaration
    4 x mode:
      DISABLE
      OFF
      OPERATE
      WARMINIT
package /PortInterface
  14 x client server interface:
    DigitalIn
      operation OP_SET: possible-error=DigitalIn/E_NOT_OK
        arg signal: type=IoHwAb_BoolType, direction=IN
      error E_NOT_OK: error-code=1
    DigitalInOut
      operation OP_GET: possible-error=DigitalInOut/E_NOT_OK
        arg signal: type=IoHwAb_BoolType, direction=OUT
      operation OP_SET: possible-error=DigitalInOut/E_NOT_OK
        arg signal: type=IoHwAb_BoolType, direction=IN
      error E_NOT_OK: error-code=1
    DigitalOut
      operation OP_SET: possible-error=DigitalOut/E_NOT_OK
        arg signal: type=IoHwAb_BoolType, direction=IN
      error E_NOT_OK: error-code=1
    FaultInjection_SCom
      operation FltInjection
        arg SignalPath_Uls_f32: type=Float, direction=INOUT
        arg LocationKey_Cnt_enum: type=FltInjectionLocType, direction=IN
    FaultInjection_SCom_Cnt_lgc
      operation FltInjection
        arg SignalPath_Cnt_lgc: type=Boolean, direction=INOUT
        arg LocationKey_Cnt_enum: type=FltInjectionLocType, direction=IN
    FaultInjection_SCom_Cnt_u08
      operation FltInjection
        arg SignalPath_Cnt_u08: type=UInt8, direction=INOUT
        arg LocationKey_Cnt_enum: type=FltInjectionLocType, direction=IN
    ImcArbr_SCom
      4 x operation, all with possible-error=ImcArbr_SCom/E_NOT_OK:
        GetSigImcData
          arg SigId_Cnt_T_u08: type=UInt8, direction=IN
          arg DataPtr_Uls_T_u32: type=UInt32, direction=INOUT
          arg StsPtr_Cnt_T_enum: type=ImcArbrRxSts_enum, direction=INOUT
        GetTxRateGroup
          arg RateGroup_Cnt_T_u08: type=UInt8, direction=IN
          arg BufPtr_Uls_T_u08: type=UInt8, direction=INOUT
        GetTxSigGroup
          arg SigGroupId_Cnt_T_u08: type=UInt8, direction=IN
          arg BufPtr_Uls_T_u08: type=UInt8, direction=INOUT
        SetRxSigGroup
          arg SigGroup_Cnt_T_u08: type=UInt8, direction=IN
          arg DataSrc_Cnt_T_enum: type=ImcArbrDataSrc_enum, direction=IN
          arg BufPtr_Cnt_T_u08: type=UInt8, direction=INOUT
      error E_NOT_OK: error-code=1
    MilestoneRequest
      operation WarmInitMilestoneComplete
        arg user: type=StaMd_Users, direction=IN
      operation WarmInitMilestoneNotComplete
        arg user: type=StaMd_Users, direction=IN
    MotVelCtrl_SCom
      4 x operation:
        GetCtrlPrm
          7 x arg, all with type=Float, direction=OUT:
            PropGain_MtrNmpMtrRadpS_T_f32
            IntgtrGain_MtrNmpMtrRad_T_f32
            DerivtvGain_MtrNmpMtrRadpSpS_T_f32
            AntiWdupGain_MtrNm_T_f32
            AntiWdupLim_Uls_T_f32
            DerivtvLpFilTiCon_Sec_T_f32
            TqCmdLim_MtrNm_T_f32
        SetCtrlPrm
          7 x arg, all with type=Float, direction=IN:
            PropGain_MtrNmpMtrRadpS_T_f32
            IntgtrGain_MtrNmpMtrRad_T_f32
            DerivtvGain_MtrNmpMtrRadpSpS_T_f32
            AntiWdupGain_MtrNm_T_f32
            AntiWdupLim_Uls_T_f32
            DerivtvLpFilTiCon_Sec_T_f32
            TqCmdLim_MtrNm_T_f32
        StopCtrl
          arg VelSlewRate_MtrRadpSpS_T_f32: type=Float, direction=IN
        StrtCtrl
          arg MotVelTar_MtrRadpS_T_f32: type=Float, direction=IN
          arg VelSlewRate_MtrRadpSpS_T_f32: type=Float, direction=IN
    NvM_AC3_SRBS_Srv: is-service=true  # Port Interface for NVRAM Blocks of Management Types "NATIVE" or "REDUNDANT" without default values.
      6 x operation:
        EraseBlock: possible-error=NvM_AC3_SRBS_Srv/E_NOT_OK
        GetErrorStatus
          arg ErrorStatus: type=NvM_RequestResultType, direction=OUT
        InvalidateNvBlock: possible-error=NvM_AC3_SRBS_Srv/E_NOT_OK
        ReadBlock: possible-error=NvM_AC3_SRBS_Srv/E_NOT_OK
          arg DstPtr: type=NvM_DestPtr, direction=OUT
        SetRamBlockStatus
          arg RamBlockStatus: type=Boolean, direction=IN
        WriteBlock: possible-error=NvM_AC3_SRBS_Srv/E_NOT_OK
          arg DstPtr: type=NvM_DestPtr, direction=IN
      error E_NOT_OK: error-code=1
    NxtrDiagMgr
      4 x operation, all with possible-error=NxtrDiagMgr/E_NOT_OK:
        GetNTCActive
          arg NTC_Cnt_T_enum: type=NTCNumber, direction=IN
          arg NTCActive_Ptr_T_lgc: type=Boolean, direction=OUT
        GetNTCFailed
          arg NTC_Cnt_T_enum: type=NTCNumber, direction=IN
          arg NTCFailed_Ptr_T_lgc: type=Boolean, direction=OUT
        GetNTCStatus
          arg NTC_Cnt_T_enum: type=NTCNumber, direction=IN
          arg Status_Ptr_T_u08: type=UInt8, direction=OUT
        SetNTCStatus
          arg NTC_Cnt_T_enum: type=NTCNumber, direction=IN
          arg Param_Cnt_T_u08: type=UInt8, direction=IN
          arg Status_Cnt_T_enum: type=NxtrDiagMgrStatus, direction=IN
      error E_NOT_OK: error-code=1
    SCom_AnaMSBArbn_MtrPos
      operation ReadEOLMtrCals
        arg MtrCalDataPtr: type=MtrPosCal_DataType, direction=OUT
        arg Mtr2CalDataPtr: type=MtrPos2Cal_DataType, direction=OUT
      operation SetEOLMtrCals
        arg MtrCalDataPtr: type=MtrPosCal_DataType, direction=IN
        arg Mtr2CalDataPtr: type=MtrPos2Cal_DataType, direction=IN
    SCom_AnaMSBArbn_MtrPos3
      operation ReadEOLMtrCals
        arg Mtr3CalDataPtr: type=MtrPos3Cal_DataType, direction=OUT
      operation SetEOLMtrCals
        arg Mtr3CalDataPtr: type=MtrPos3Cal_DataType, direction=IN
    SystemTime: is-service=true
      6 x operation:
        DtrmnElapsedTime_mS_u16  # Nexteer SystemTime Service
          arg InitialTime: type=UInt32, direction=IN
          arg ElapsedTime: type=UInt16, direction=OUT
        DtrmnElapsedTime_mS_u32
          arg InitialTime: type=UInt32, direction=IN
          arg ElapsedTime: type=UInt32, direction=OUT
        DtrmnElapsedTime_uS_u16
          arg InitialTime: type=UInt32, direction=IN
          arg ElapsedTime: type=UInt16, direction=OUT
        DtrmnElapsedTime_uS_u32
          arg InitialTime: type=UInt32, direction=IN
          arg ElapsedTime: type=UInt32, direction=OUT
        GetSystemTime_mS_u32
          arg CurrentTime: type=UInt32, direction=OUT
        GetSystemTime_uS_u32
          arg CurrentTime: type=UInt32, direction=OUT
  81 x sender receiver interface:
    APA_State_enum
      data State_enum: sw-calibration-access=READ-ONLY, type=APA_State_enum
    ApaAbortSt_State_enum
      data State_enum: sw-calibration-access=READ-ONLY, type=ApaAbortSt_State_enum
    ApaReqSt_State_enum
      data State_enum: sw-calibration-access=READ-ONLY, type=ApaReqSt_State_enum
    Authority_Uls_f32
      data Uls_f32: sw-calibration-access=READ-ONLY, type=Float
    BattSwdVltgCorrSts_Cnt_enum
      data Cnt_enum: sw-calibration-access=READ-ONLY, type=BattSwdVltgCorrSts_Cnt_enum
    BattVltgSt_Cnt_enum
      data Cnt_enum: sw-calibration-access=READ-ONLY, type=BattVltgSt_Cnt_enum
    BoolStatusFlag_Cnt_lgc
      data Cnt_lgc: sw-calibration-access=READ-ONLY, type=Boolean
    Circumference_mm_u16
      data mm_u16: sw-calibration-access=READ-ONLY, type=UInt16
    Count_Cnt_s08
      data Cnt_s08: sw-calibration-access=READ-ONLY, type=SInt8
    Count_Cnt_s16
      data Cnt_s16: sw-calibration-access=READ-ONLY, type=SInt16
    Count_Cnt_s32
      data Cnt_s32: sw-calibration-access=READ-ONLY, type=SInt32
    Count_Cnt_u08
      data Cnt_u08: sw-calibration-access=READ-ONLY, type=UInt8
    Count_Cnt_u16
      data Cnt_u16: sw-calibration-access=READ-ONLY, type=UInt16
    Count_Cnt_u32
      data Cnt_u32: sw-calibration-access=READ-ONLY, type=UInt32
    Current_Amp_f32
      data Amp_f32: sw-calibration-access=READ-ONLY, type=Float
    Direction_Cnt_s08
      data Cnt_s08: sw-calibration-access=READ-ONLY, type=SInt8
    Distance_mm_f32
      data mm_f32: sw-calibration-access=READ-ONLY, type=Float
    DrvgDynIfSt_State_enum
      data State_enum: sw-calibration-access=READ-ONLY, type=BmwDrvgDynIfSt_State_enum
    DrvrModCtrl_enum
      data Cnt_enum: sw-calibration-access=READ-ONLY, type=DrvrModCtrl_enum
    Enable_Cnt_lgc
      data Cnt_lgc: sw-calibration-access=READ-ONLY, type=Boolean
    ESC_State_enum
      data State_enum: sw-calibration-access=READ-ONLY, type=ESC_State_enum
    Force_kN_f32
      data kN_f32: sw-calibration-access=READ-ONLY, type=Float
    Force_N_f32
      data N_f32: sw-calibration-access=READ-ONLY, type=Float
    Frequency_Hz_f32
      data Hz_f32: sw-calibration-access=READ-ONLY, type=Float
    GmStrtStopSt_State_enum
      data State_enum: sw-calibration-access=READ-ONLY, type=GmStrtStopSt_State_enum
    Haptic_State_enum
      data State_enum: sw-calibration-access=READ-ONLY, type=Haptic_State_enum
    HwAccel_HwDegpSecSqr_f32
      data HwDegpSecSqr_f32: sw-calibration-access=READ-ONLY, type=Float
    HwPos_HwDeg_f32
      data HwDeg_f32: sw-calibration-access=READ-ONLY, type=Float
    HwPosnComp_HwDeg_str
      data HwDeg_str: sw-calibration-access=READ-ONLY, type=SysOutpCpbySig_Str
    HwTrq_HwNm_f32
      data HwNm_f32: sw-calibration-access=READ-ONLY, type=Float
    HwTrqRate_HwNmpS_f32
      data HwNmpS_f32: sw-calibration-access=READ-ONLY, type=Float
    HwVel_HwDegpSec_f32
      data HwDegpSec_f32: sw-calibration-access=READ-ONLY, type=Float
    HwVel_HwRadpS_f32
      data HwRadpS_f32: sw-calibration-access=READ-ONLY, type=Float
    ImcSystemStateValidity_Cnt_enum
      data Cnt_enum: sw-calibration-access=READ-ONLY, type=ImcArbrRxSts_enum
    Inductance_Henry_f32
      data Henry_f32: sw-calibration-access=READ-ONLY, type=Float
    LdwSt_State_enum
      data State_enum: sw-calibration-access=READ-ONLY, type=LdwSt_State_enum
    LKA_State_enum
      data State_enum: sw-calibration-access=READ-ONLY, type=LKA_State_enum
    LkaSt_State_enum
      data State_enum: sw-calibration-access=READ-ONLY, type=LkaSt_State_enum
    LOA_State_enum
      data State_enum: sw-calibration-access=READ-ONLY, type=LOA_State_enum
    ManufModes_Cnt_enum
      data Cnt_enum: sw-calibration-access=READ-ONLY, type=ManufModeType
    MtrPos_Deg_f32
      data Deg_f32: sw-calibration-access=READ-ONLY, type=Float
    MtrPos_Rad_f32
      data Rad_f32: sw-calibration-access=READ-ONLY, type=Float
    MtrPos_Rev_f32
      data Rev_f32: sw-calibration-access=READ-ONLY, type=Float
    MtrPos_Rev_u0p16
      data Rev_u0p16: sw-calibration-access=READ-ONLY, type=UInt16
    MtrQuad_Cnt_u08
      data Cnt_u08: sw-calibration-access=READ-ONLY, type=UInt8
    MtrRampRate_MtrNmpS_f32
      data MtrNmpS_f32: sw-calibration-access=READ-ONLY, type=Float
    MtrTrq_MtrNm_f32
      data MtrNm_f32: sw-calibration-access=READ-ONLY, type=Float
    MtrTrq_MtrNm_s5p10
      data MtrNm_s5p10: sw-calibration-access=READ-ONLY, type=SInt16
    MtrVel_MtrRadpS_f32
      data MtrRadpS_f32: sw-calibration-access=READ-ONLY, type=Float
    MtrVltConstant_VpRadpS_f32
      data VpRadpS_f32: sw-calibration-access=READ-ONLY, type=Float
    PhsAdv_Cnt_s16
      data Cnt_s16: sw-calibration-access=READ-ONLY, type=SInt16
    PkCurr_AmpSq_f32
      data AmpSq_f32: sw-calibration-access=READ-ONLY, type=Float
    Power_Watt_f32
      data Watt_f32: sw-calibration-access=READ-ONLY, type=Float
    PsaApaSt_Cnt_enum
      data Cnt_enum: sw-calibration-access=READ-ONLY, type=PsaApaSt_Cnt_enum
    PsaApaTranCause_Cnt_enum
      data Cnt_enum: sw-calibration-access=READ-ONLY, type=PsaApaTranCause_Cnt_enum
    PsaEpsSt_Cnt_enum
      data Cnt_enum: sw-calibration-access=READ-ONLY, type=PsaEpsSt_Cnt_enum
    PsaEpsStLxa_Cnt_enum
      data Cnt_enum: sw-calibration-access=READ-ONLY, type=PsaEpsStLxa_Cnt_enum
    PsaLxaSt_Cnt_enum
      data Cnt_enum: sw-calibration-access=READ-ONLY, type=PsaLxaSt_Cnt_enum
    PsaTunModSt_Cnt_enum
      data Cnt_enum: sw-calibration-access=READ-ONLY, type=PsaTunModSt_Cnt_enum
    RampRate_UlspS_f32
      data UlspS_f32: sw-calibration-access=READ-ONLY, type=Float
    RampRate_XpmS_f32
      data XpmS_f32: sw-calibration-access=READ-ONLY, type=Float
    Resistance_Ohm_f32
      data Ohm_f32: sw-calibration-access=READ-ONLY, type=Float
    ScaleFactor_Uls_f32
      data Uls_f32: sw-calibration-access=READ-ONLY, type=Float
    SigQlfr_State_enum
      data State_enum: sw-calibration-access=READ-ONLY, type=SigQlfr_State_enum
    SS_State_enum
      data State_enum: sw-calibration-access=READ-ONLY, type=SS_State_enum
    SteerMod_enum
      data Cnt_enum: sw-calibration-access=READ-ONLY, type=SteerMod_enum
    SysPrfmncSt_Cnt_enum
      data Cnt_enum: sw-calibration-access=READ-ONLY, type=SysPrfmncSt_Cnt_enum
    SystemState
      mode declaration group prototype Mode: type=StaMd_Mode
    Temperature_DegC_f32
      data DegC_f32: sw-calibration-access=READ-ONLY, type=Float
    Time_USec_u32
      data USec_u32: sw-calibration-access=READ-ONLY, type=UInt32
    TuningSessionActPtr
      data Cnt_u8: sw-calibration-access=READ-ONLY, type=TuningSessionAddrPtrEnum
    UnityScalar_Uls_f32
      data Uls_f32: sw-calibration-access=READ-ONLY, type=Float
    Validity_Cnt_lgc
      data Cnt_lgc: sw-calibration-access=READ-ONLY, type=Boolean
    Vecu_Volt_f32
      data Volt_f32: sw-calibration-access=READ-ONLY, range raw >5..<31, type=Float  # This port prototype is inteded to communicate voltage signals that represent the ecu supplied voltage. This signal has a lower limit, which is non-zero, to allow users of the signal to use it as a denominator in an expression without requiring a divide by 0 check.
    VehAccel_KphpS_f32
      data KphpS_f32: sw-calibration-access=READ-ONLY, type=Float
    VehAccel_MpSecSq_f32
      data MpSecSq_f32: sw-calibration-access=READ-ONLY, type=Float
    VehSpd_Kph_f32
      data Kph_f32: sw-calibration-access=READ-ONLY, type=Float
    VltgCtrlTerm_Uls_f32
      data Uls_f32: sw-calibration-access=READ-ONLY, type=Float
    Voltage_Volt_f32
      data Volt_f32: sw-calibration-access=READ-ONLY, range raw >0..<31, type=Float  # This signal is intended to communicate any type voltage signal measured by the ecu. This signal has a lower limit of 0 which reequires users of the signal to provide divide by 0 protection if it is used as a denominator in a calculation. See Vecu port prototype if a port with a lower limit is desired.
    Voltage_Volt_u3p13
      data Volt_u3p13: sw-calibration-access=READ-ONLY, type=UInt16
    YawRate_DegpS_f32
      data DegpS_f32: sw-calibration-access=READ-ONLY, type=Float
