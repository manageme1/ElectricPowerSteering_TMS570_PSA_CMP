AUTOSAR XML (schema 314)
package /Constant
  5 x constant specification:
    D_FOUR_CNT_U08
      value:
        integer literal D_FOUR_CNT_U08: type=UInt8, value=4
    D_SIGQLFRNORES_CNT_ENUM
      value:
        integer literal D_SIGQLFRNORES_CNT_ENUM: type=SigQlfr_State_enum, value=0
    D_THREE_CNT_U16
      value:
        integer literal D_THREE_CNT_U16: type=UInt16, value=3
    D_ZERO_CNT_U8
      value:
        integer literal D_ZERO_CNT_U8: type=UInt8, value=0
    D_ZERO_ULS_F32
      value:
        real literal D_ZERO_ULS_F32: type=Float, value=0
