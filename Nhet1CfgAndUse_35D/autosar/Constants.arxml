AUTOSAR XML (schema 314)
package /Constant
  4 x constant specification:
    D_SIGQLFRNORES_CNT_ENUM
      value:
        integer literal D_SIGQLFRNORES_CNT_ENUM: type=SigQlfr_State_enum, value=0
    D_ZERO_CNT_S8
      value:
        integer literal D_ZERO_CNT_S8: type=SInt8, value=0
    D_ZERO_CNT_U8
      value:
        integer literal D_ZERO_CNT_U8: type=UInt8, value=0
    D_ZERO_ULS_F32
      value:
        real literal D_ZERO_ULS_F32: type=Float, value=0
