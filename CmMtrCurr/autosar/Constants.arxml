AUTOSAR XML (schema 314)
package /Constant
  10 x constant specification:
    D_2MS_SEC_F32
      value:
        real literal D_2MS_SEC_F32: type=Float, value=0.002
    D_2PI_ULS_F32
      value:
        real literal D_2PI_ULS_F32: type=Float, value=6.2831853071796
    D_FALSE_CNT_LGC
      value:
        boolean literal D_FALSE_CNT_LGC: type=Boolean, value=false
    D_FLOATZERO_ULS_F32
      value:
        real literal D_FLOATZERO_ULS_F32: type=Float, value=0
    D_MANUFMODEINIT_CNT_ENUM
      value:
        integer literal D_MANUFMODEINIT_CNT_ENUM: type=ManufModeType, value=0
    D_MTRPOLESDIV2_CNT_U8
      value:
        integer literal D_MTRPOLESDIV2_CNT_U8: type=UInt8, value=3
    D_VECUMIN_VOLTS_F32
      value:
        real literal D_VECUMIN_VOLTS_F32: type=Float, value=5
    D_ZERO_CNT_U16
      value:
        integer literal D_ZERO_CNT_U16: type=UInt16, value=0
    D_ZERO_CNT_U32
      value:
        integer literal D_ZERO_CNT_U32: type=UInt32, value=0
    D_ZERO_ULS_F32
      value:
        real literal D_ZERO_ULS_F32: type=Float, value=0
