AUTOSAR XML (schema 314)
package /ModeDclrGroup
  mode declaration group StaMd_Mode: initial-mode=WARMINIT  # EPS System State mode declaration
    4 x mode:
      DISABLE
      OFF
      OPERATE
      WARMINIT
package /PortInterface
  client server interface NxtrDiagMgr
    4 x operation, all with possible-error=E_NOT_OK:
      GetNTCActive
        arg NTC_Cnt_T_enum: type=NTCNumber, direction=IN
        arg NTCActive_Ptr_T_lgc: type=Boolean, direction=OUT
      GetNTCFailed
        arg NTC_Cnt_T_enum: type=NTCNumber, direction=IN
        arg NTCFailed_Ptr_T_lgc: type=Boolean, direction=OUT
      GetNTCStatus
        arg NTC_Cnt_T_enum: type=NTCNumber, direction=IN
        arg Status_Ptr_T_u08: type=UInt8, direction=OUT
      SetNTCStatus
        arg NTC_Cnt_T_enum: type=NTCNumber, direction=IN
        arg Param_Cnt_T_u08: type=UInt8, direction=IN
        arg Status_Cnt_T_enum: type=NxtrDiagMgrStatus, direction=IN
    error E_NOT_OK: error-code=1
  client server interface SystemTime: is-service=true
    6 x operation:
      DtrmnElapsedTime_mS_u16  # Nexteer SystemTime Service
        arg InitialTime: type=UInt32, direction=IN
        arg ElapsedTime: type=UInt16, direction=OUT
      DtrmnElapsedTime_mS_u32
        arg InitialTime: type=UInt32, direction=IN
        arg ElapsedTime: type=UInt32, direction=OUT
      DtrmnElapsedTime_uS_u16
        arg InitialTime: type=UInt32, direction=IN
        arg ElapsedTime: type=UInt16, direction=OUT
      DtrmnElapsedTime_uS_u32
        arg InitialTime: type=UInt32, direction=IN
        arg ElapsedTime: type=UInt32, direction=OUT
      GetSystemTime_mS_u32
        arg CurrentTime: type=UInt32, direction=OUT
      GetSystemTime_uS_u32
        arg CurrentTime: type=UInt32, direction=OUT
  16 x sender receiver interface:
    Authority_Uls_f32
      data Uls_f32: sw-calibration-access=READ-ONLY, type=Float
    BoolStatusFlag_Cnt_lgc
      data Cnt_lgc: sw-calibration-access=READ-ONLY, type=Boolean
    Count_Cnt_s08
      data Cnt_s08: sw-calibration-access=READ-ONLY, type=SInt8
    HwPos_HwDeg_f32
      data HwDeg_f32: sw-calibration-access=READ-ONLY, type=Float
    HwTrq_HwNm_f32
      data HwNm_f32: sw-calibration-access=READ-ONLY, type=Float
    HwTrqRate_HwNmpS_f32
      data HwNmpS_f32: sw-calibration-access=READ-ONLY, type=Float
    HwVel_HwRadpS_f32
      data HwRadpS_f32: sw-calibration-access=READ-ONLY, type=Float
    MtrTrq_MtrNm_f32
      data MtrNm_f32: sw-calibration-access=READ-ONLY, type=Float
    PsaApaSt_Cnt_enum
      data Cnt_enum: sw-calibration-access=READ-ONLY, type=PsaApaSt_Cnt_enum
    PsaApaTranCause_Cnt_enum
      data Cnt_enum: sw-calibration-access=READ-ONLY, type=PsaApaTranCause_Cnt_enum
    PsaEpsStLxa_Cnt_enum
      data Cnt_enum: sw-calibration-access=READ-ONLY, type=PsaEpsStLxa_Cnt_enum
    PsaLxaSt_Cnt_enum
      data Cnt_enum: sw-calibration-access=READ-ONLY, type=PsaLxaSt_Cnt_enum
    ScaleFactor_Uls_f32
      data Uls_f32: sw-calibration-access=READ-ONLY, type=Float
    SystemState
      mode declaration group prototype Mode: type=StaMd_Mode
    UnityScalar_Uls_f32
      data Uls_f32: sw-calibration-access=READ-ONLY, type=Float
    VehSpd_Kph_f32
      data Kph_f32: sw-calibration-access=READ-ONLY, type=Float
