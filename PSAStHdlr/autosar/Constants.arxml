AUTOSAR XML (schema 314)
package /Constant
  15 x constant specification:
    D_2MS_SEC_F32
      value:
        real literal D_2MS_SEC_F32: type=Float, value=0.002
    D_FALSE_CNT_LGC
      value:
        boolean literal D_FALSE_CNT_LGC: type=Boolean, value=false
    D_MSECPERSEC_ULS_F32
      value:
        real literal D_MSECPERSEC_ULS_F32: type=Float, value=1000
    D_MTRTRQCMDHILMT_MTRNM_F32
      value:
        real literal D_MTRTRQCMDHILMT_MTRNM_F32: type=Float, value=8.8
    D_ONE_CNT_U8
      value:
        integer literal D_ONE_CNT_U8: type=UInt8, value=1
    D_ONE_ULS_F32
      value:
        real literal D_ONE_ULS_F32: type=Float, value=1
    D_PSAAPASTINIT_CNT_ENUM
      value:
        integer literal D_PSAAPASTINIT_CNT_ENUM: type=PsaApaSt_Cnt_enum, value=0
    D_PSAAPATRANCAUSEINIT_CNT_ENUM
      value:
        integer literal D_PSAAPATRANCAUSEINIT_CNT_ENUM: type=PsaApaTranCause_Cnt_enum, value=0
    D_PSAEPSSTLXAINIT_CNT_ENUM
      value:
        integer literal D_PSAEPSSTLXAINIT_CNT_ENUM: type=PsaEpsStLxa_Cnt_enum, value=0
    D_PSALXASTINIT_CNT_ENUM
      value:
        integer literal D_PSALXASTINIT_CNT_ENUM: type=PsaLxaSt_Cnt_enum, value=0
    D_TRUE_CNT_LGC
      value:
        boolean literal D_TRUE_CNT_LGC: type=Boolean, value=true
    D_ZERO_CNT_S8
      value:
        integer literal D_ZERO_CNT_S8: type=SInt8, value=0
    D_ZERO_CNT_U16
      value:
        integer literal D_ZERO_CNT_U16: type=UInt16, value=0
    D_ZERO_CNT_U8
      value:
        integer literal D_ZERO_CNT_U8: type=UInt8, value=0
    D_ZERO_ULS_F32
      value:
        real literal D_ZERO_ULS_F32: type=Float, value=0
