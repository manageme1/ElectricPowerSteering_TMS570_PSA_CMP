AUTOSAR XML (schema 314)
standard types defined: Boolean, SInt8, UInt16, UInt32, UInt8, Float
package /DataType
  integer type LOA_State_enum: compu {0=LOAST_NORM, 1=LOAST_REDCD, 2=LOAST_SWBASDMTGTN, 3=LOAST_FADEOUT, 4=LOAST_CTRLDSHTDWNREQD, 5=LOAST_RPDSHTDWNREQD}, lower-limit=0, upper-limit=5
