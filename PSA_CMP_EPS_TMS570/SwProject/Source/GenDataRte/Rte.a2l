/begin MEASUREMENT Rte_Return_ReturnCmd_MtrNm_f32 "MICROSAR RTE" FLOAT32_IEEE NO_COMPU_METHOD 0 0 1.175494351e-38 3.402823466e+38 ECU_ADDRESS 0 /end MEASUREMENT
/begin MEASUREMENT Rte_Return_ReturnDDFactor_Uls_f32 "MICROSAR RTE" FLOAT32_IEEE NO_COMPU_METHOD 0 0 1.175494351e-38 3.402823466e+38 ECU_ADDRESS 0 /end MEASUREMENT
/begin MEASUREMENT Rte_Return_ReturnOffset_HwDeg_f32 "MICROSAR RTE" FLOAT32_IEEE NO_COMPU_METHOD 0 0 1.175494351e-38 3.402823466e+38 ECU_ADDRESS 0 /end MEASUREMENT
/begin MEASUREMENT Rte_SignlCondn_SrlCom_VehicleLonAccel_KphpS_f32 "MICROSAR RTE" FLOAT32_IEEE NO_COMPU_METHOD 0 0 1.175494351e-38 3.402823466e+38 ECU_ADDRESS 0 /end MEASUREMENT
/begin MEASUREMENT Rte_SrlComDriver_AccelLat_Cnt_s16 "MICROSAR RTE" SWORD NO_COMPU_METHOD 0 0 -32768 32767 ECU_ADDRESS 0 /end MEASUREMENT
/begin MEASUREMENT Rte_SrlComDriver_AnneeEcoule_Cnt_u08 "MICROSAR RTE" UBYTE NO_COMPU_METHOD 0 0 0 255 ECU_ADDRESS 0 /end MEASUREMENT
/begin MEASUREMENT Rte_SrlComDriver_ColumnAngleSetpoint_Cnt_u16 "MICROSAR RTE" UWORD NO_COMPU_METHOD 0 0 0 65535 ECU_ADDRESS 0 /end MEASUREMENT
/begin MEASUREMENT Rte_SrlComDriver_CompteurTemporelVehicule_Cnt_u32 "MICROSAR RTE" ULONG NO_COMPU_METHOD 0 0 0 4294967295 ECU_ADDRESS 0 /end MEASUREMENT
/begin MEASUREMENT Rte_SrlComDriver_ComputerRazGCT_Cnt_u08 "MICROSAR RTE" UBYTE NO_COMPU_METHOD 0 0 0 255 ECU_ADDRESS 0 /end MEASUREMENT
/begin MEASUREMENT Rte_SrlComDriver_ConfigVhl_Cnt_u08 "MICROSAR RTE" UBYTE NO_COMPU_METHOD 0 0 0 255 ECU_ADDRESS 0 /end MEASUREMENT
/begin MEASUREMENT Rte_SrlComDriver_DiagIntegraElec_Cnt_u08 "MICROSAR RTE" UBYTE NO_COMPU_METHOD 0 0 0 255 ECU_ADDRESS 0 /end MEASUREMENT
/begin MEASUREMENT Rte_SrlComDriver_DiagMuxOn_Cnt_u08 "MICROSAR RTE" UBYTE NO_COMPU_METHOD 0 0 0 255 ECU_ADDRESS 0 /end MEASUREMENT
/begin MEASUREMENT Rte_SrlComDriver_DmdDelestDA_Cnt_u08 "MICROSAR RTE" UBYTE NO_COMPU_METHOD 0 0 0 255 ECU_ADDRESS 0 /end MEASUREMENT
/begin MEASUREMENT Rte_SrlComDriver_ESPDeconnecte_Cnt_u08 "MICROSAR RTE" UBYTE NO_COMPU_METHOD 0 0 0 255 ECU_ADDRESS 0 /end MEASUREMENT
/begin MEASUREMENT Rte_SrlComDriver_EffacDefaultDiag_Cnt_u08 "MICROSAR RTE" UBYTE NO_COMPU_METHOD 0 0 0 255 ECU_ADDRESS 0 /end MEASUREMENT
/begin MEASUREMENT Rte_SrlComDriver_EtatMT_Cnt_u08 "MICROSAR RTE" UBYTE NO_COMPU_METHOD 0 0 0 255 ECU_ADDRESS 0 /end MEASUREMENT
/begin MEASUREMENT Rte_SrlComDriver_EtatPrincipSev_Cnt_u08 "MICROSAR RTE" UBYTE NO_COMPU_METHOD 0 0 0 255 ECU_ADDRESS 0 /end MEASUREMENT
/begin MEASUREMENT Rte_SrlComDriver_EtatReseauElec_Cnt_u08 "MICROSAR RTE" UBYTE NO_COMPU_METHOD 0 0 0 255 ECU_ADDRESS 0 /end MEASUREMENT
/begin MEASUREMENT Rte_SrlComDriver_ISDAT4V2BSI552MsgDLCError_Cnt_u08 "MICROSAR RTE" UBYTE NO_COMPU_METHOD 0 0 0 255 ECU_ADDRESS 0 /end MEASUREMENT
/begin MEASUREMENT Rte_SrlComDriver_ISDATABR50DMsgDLCError_Cnt_u08 "MICROSAR RTE" UBYTE NO_COMPU_METHOD 0 0 0 255 ECU_ADDRESS 0 /end MEASUREMENT
/begin MEASUREMENT Rte_SrlComDriver_ISDATBSI3F2MsgDLCError_Cnt_u08 "MICROSAR RTE" UBYTE NO_COMPU_METHOD 0 0 0 255 ECU_ADDRESS 0 /end MEASUREMENT
/begin MEASUREMENT Rte_SrlComDriver_ISDATBSI412MsgDLCError_Cnt_u08 "MICROSAR RTE" UBYTE NO_COMPU_METHOD 0 0 0 255 ECU_ADDRESS 0 /end MEASUREMENT
/begin MEASUREMENT Rte_SrlComDriver_ISDATBSI432MsgDLCError_Cnt_u08 "MICROSAR RTE" UBYTE NO_COMPU_METHOD 0 0 0 255 ECU_ADDRESS 0 /end MEASUREMENT
/begin MEASUREMENT Rte_SrlComDriver_ISDATBSI572MsgDLCError_Cnt_u08 "MICROSAR RTE" UBYTE NO_COMPU_METHOD 0 0 0 255 ECU_ADDRESS 0 /end MEASUREMENT
/begin MEASUREMENT Rte_SrlComDriver_ISDATDIRAMsgTxInProgress_Cnt_lgc "MICROSAR RTE" UBYTE RTE_CM_BOOLEAN 0 0 0 255 ECU_ADDRESS 0 /end MEASUREMENT
/begin MEASUREMENT Rte_SrlComDriver_ISDYN2CMMMsgDLCError_Cnt_u08 "MICROSAR RTE" UBYTE NO_COMPU_METHOD 0 0 0 255 ECU_ADDRESS 0 /end MEASUREMENT
/begin MEASUREMENT Rte_SrlComDriver_ISDYN2FRE3CDMsgDLCError_Cnt_u08 "MICROSAR RTE" UBYTE NO_COMPU_METHOD 0 0 0 255 ECU_ADDRESS 0 /end MEASUREMENT
/begin MEASUREMENT Rte_SrlComDriver_ISDYNAASMsgDLCError_Cnt_u08 "MICROSAR RTE" UBYTE NO_COMPU_METHOD 0 0 0 255 ECU_ADDRESS 0 /end MEASUREMENT
/begin MEASUREMENT Rte_SrlComDriver_ISDYNABRMsgDLCError_Cnt_u08 "MICROSAR RTE" UBYTE NO_COMPU_METHOD 0 0 0 255 ECU_ADDRESS 0 /end MEASUREMENT
/begin MEASUREMENT Rte_SrlComDriver_ISDYNCDS34DMsgDLCError_Cnt_u08 "MICROSAR RTE" UBYTE NO_COMPU_METHOD 0 0 0 255 ECU_ADDRESS 0 /end MEASUREMENT
/begin MEASUREMENT Rte_SrlComDriver_ISDYNCMM208MsgDLCError_Cnt_u08 "MICROSAR RTE" UBYTE NO_COMPU_METHOD 0 0 0 255 ECU_ADDRESS 0 /end MEASUREMENT
/begin MEASUREMENT Rte_SrlComDriver_ISDYNCMM388MsgDLCError_Cnt_u08 "MICROSAR RTE" UBYTE NO_COMPU_METHOD 0 0 0 255 ECU_ADDRESS 0 /end MEASUREMENT
/begin MEASUREMENT Rte_SrlComDriver_ISDYNVOLMsgDLCError_Cnt_u08 "MICROSAR RTE" UBYTE NO_COMPU_METHOD 0 0 0 255 ECU_ADDRESS 0 /end MEASUREMENT
/begin MEASUREMENT Rte_SrlComDriver_JourEcoule_Cnt_u16 "MICROSAR RTE" UWORD NO_COMPU_METHOD 0 0 0 65535 ECU_ADDRESS 0 /end MEASUREMENT
/begin MEASUREMENT Rte_SrlComDriver_LKAState_Cnt_u08 "MICROSAR RTE" UBYTE NO_COMPU_METHOD 0 0 0 255 ECU_ADDRESS 0 /end MEASUREMENT
/begin MEASUREMENT Rte_SrlComDriver_LKATrqFactReq_Cnt_u08 "MICROSAR RTE" UBYTE NO_COMPU_METHOD 0 0 0 255 ECU_ADDRESS 0 /end MEASUREMENT
/begin MEASUREMENT Rte_SrlComDriver_LXAActivation_Cnt_u08 "MICROSAR RTE" UBYTE NO_COMPU_METHOD 0 0 0 255 ECU_ADDRESS 0 /end MEASUREMENT
/begin MEASUREMENT Rte_SrlComDriver_ModeDiag_Cnt_u08 "MICROSAR RTE" UBYTE NO_COMPU_METHOD 0 0 0 255 ECU_ADDRESS 0 /end MEASUREMENT
/begin MEASUREMENT Rte_SrlComDriver_PROTOHS1DYNUCF5CDMsgDLCError_Cnt_u08 "MICROSAR RTE" UBYTE NO_COMPU_METHOD 0 0 0 255 ECU_ADDRESS 0 /end MEASUREMENT
/begin MEASUREMENT Rte_SrlComDriver_PowerSupplies_Cnt_u08 "MICROSAR RTE" UBYTE NO_COMPU_METHOD 0 0 0 255 ECU_ADDRESS 0 /end MEASUREMENT
/begin MEASUREMENT Rte_SrlComDriver_RegulABR_Cnt_u08 "MICROSAR RTE" UBYTE NO_COMPU_METHOD 0 0 0 255 ECU_ADDRESS 0 /end MEASUREMENT
/begin MEASUREMENT Rte_SrlComDriver_RegulESP_Cnt_u08 "MICROSAR RTE" UBYTE NO_COMPU_METHOD 0 0 0 255 ECU_ADDRESS 0 /end MEASUREMENT
/begin MEASUREMENT Rte_SrlComDriver_ReqLampeDefEsp_Cnt_u08 "MICROSAR RTE" UBYTE NO_COMPU_METHOD 0 0 0 255 ECU_ADDRESS 0 /end MEASUREMENT
/begin MEASUREMENT Rte_SrlComDriver_ReqModeDA_Cnt_u08 "MICROSAR RTE" UBYTE NO_COMPU_METHOD 0 0 0 255 ECU_ADDRESS 0 /end MEASUREMENT
/begin MEASUREMENT Rte_SrlComDriver_SecondeEcoulee_Cnt_u32 "MICROSAR RTE" ULONG NO_COMPU_METHOD 0 0 0 4294967295 ECU_ADDRESS 0 /end MEASUREMENT
/begin MEASUREMENT Rte_SrlComDriver_ShuntPosition_Cnt_u08 "MICROSAR RTE" UBYTE NO_COMPU_METHOD 0 0 0 255 ECU_ADDRESS 0 /end MEASUREMENT
/begin MEASUREMENT Rte_SrlComInput_VVHType_Cnt_u08 "MICROSAR RTE" UBYTE NO_COMPU_METHOD 0 0 0 255 ECU_ADDRESS 0 /end MEASUREMENT
/begin MEASUREMENT Rte_SrlComDriver_VitesseVehicleBV_Cnt_u16 "MICROSAR RTE" UWORD NO_COMPU_METHOD 0 0 0 65535 ECU_ADDRESS 0 /end MEASUREMENT
/begin MEASUREMENT Rte_SrlComInput_AngleVolant_HwDeg_f32 "MICROSAR RTE" FLOAT32_IEEE NO_COMPU_METHOD 0 0 1.175494351e-38 3.402823466e+38 ECU_ADDRESS 0 /end MEASUREMENT
/begin MEASUREMENT Rte_SrlComInput_CONSANGLECPK_Cnt_s16 "MICROSAR RTE" SWORD NO_COMPU_METHOD 0 0 -32768 32767 ECU_ADDRESS 0 /end MEASUREMENT
/begin MEASUREMENT Rte_SrlComInput_DMDFCTCPK_Cnt_u08 "MICROSAR RTE" UBYTE NO_COMPU_METHOD 0 0 0 255 ECU_ADDRESS 0 /end MEASUREMENT
/begin MEASUREMENT Rte_SrlComInput_DmdDelestDaVld_Cnt_lgc "MICROSAR RTE" UBYTE RTE_CM_BOOLEAN 0 0 0 255 ECU_ADDRESS 0 /end MEASUREMENT
/begin MEASUREMENT Rte_SrlComInput_ElecIntData "MICROSAR RTE" UBYTE RTE_CM_BOOLEAN 0 0 0 255 ECU_ADDRESS 0 READ_WRITE /end MEASUREMENT
/begin MEASUREMENT Rte_SrlComInput_IgnTimeOff_Cnt_u32 "MICROSAR RTE" ULONG NO_COMPU_METHOD 0 0 0 4294967295 ECU_ADDRESS 0 /end MEASUREMENT
/begin MEASUREMENT Rte_SrlComInput_SerialComAngleValid_Cnt_lgc "MICROSAR RTE" UBYTE RTE_CM_BOOLEAN 0 0 0 255 ECU_ADDRESS 0 /end MEASUREMENT
/begin MEASUREMENT Rte_SrlComInput_ShutdownTimeData.Time_Sec_u32 "MICROSAR RTE" ULONG NO_COMPU_METHOD 0 0 0 4294967295 ECU_ADDRESS 0 READ_WRITE /end MEASUREMENT
/begin MEASUREMENT Rte_SrlComInput_ShutdownTimeData.Valid_Cnt_lgc "MICROSAR RTE" UBYTE RTE_CM_BOOLEAN 0 0 0 255 ECU_ADDRESS 0 READ_WRITE /end MEASUREMENT
/begin MEASUREMENT Rte_SrlComInput_VVHTYPEData "MICROSAR RTE" UBYTE NO_COMPU_METHOD 0 0 0 255 ECU_ADDRESS 0 READ_WRITE /end MEASUREMENT
/begin MEASUREMENT Rte_SrlComInput_VehTimeValid_Cnt_lgc "MICROSAR RTE" UBYTE RTE_CM_BOOLEAN 0 0 0 255 ECU_ADDRESS 0 /end MEASUREMENT
/begin MEASUREMENT Rte_SrlComInput_VehicleLatAccelValid_Cnt_lgc "MICROSAR RTE" UBYTE RTE_CM_BOOLEAN 0 0 0 255 ECU_ADDRESS 0 /end MEASUREMENT
/begin MEASUREMENT Rte_SrlComOutput_PimIsDatDiraMsg.AutorArretMotDa "MICROSAR RTE" UBYTE RTE_CM_BOOLEAN 0 0 0 255 ECU_ADDRESS 0 READ_WRITE /end MEASUREMENT
/begin MEASUREMENT Rte_SrlComOutput_PimIsDatDiraMsg.CpleVolant "MICROSAR RTE" SBYTE RTE_CM_CPLE_VOLANT 0 0 -8 8 ECU_ADDRESS 0 READ_WRITE /end MEASUREMENT
/begin MEASUREMENT Rte_SrlComOutput_PimIsDatDiraMsg.DdeRedemDa "MICROSAR RTE" UBYTE RTE_CM_BOOLEAN 0 0 0 255 ECU_ADDRESS 0 READ_WRITE /end MEASUREMENT
/begin MEASUREMENT Rte_SrlComOutput_PimIsDatDiraMsg.EpsStateLka "MICROSAR RTE" UBYTE RTE_CM_EPS_STATE_LKA 0 0 0 4 ECU_ADDRESS 0 READ_WRITE /end MEASUREMENT
/begin MEASUREMENT Rte_SrlComOutput_PimIsDatDiraMsg.EtatDa2004 "MICROSAR RTE" UBYTE RTE_CM_ETAT_DA_2004 0 0 0 3 ECU_ADDRESS 0 READ_WRITE /end MEASUREMENT
/begin MEASUREMENT Rte_SrlComOutput_PimIsDatDiraMsg.EtatDa2010 "MICROSAR RTE" UBYTE RTE_CM_ETAT_DA_2010 0 0 0 3 ECU_ADDRESS 0 READ_WRITE /end MEASUREMENT
/begin MEASUREMENT Rte_SrlComOutput_PimIsDatDiraMsg.EtatDaDyn "MICROSAR RTE" UBYTE RTE_CM_ETAT_DA_DYN 0 0 0 3 ECU_ADDRESS 0 READ_WRITE /end MEASUREMENT
/begin MEASUREMENT Rte_SrlComOutput_PimIsDatDiraMsg.SteerwhlHoldByDrv "MICROSAR RTE" UBYTE RTE_CM_BOOLEAN 0 0 0 255 ECU_ADDRESS 0 READ_WRITE /end MEASUREMENT
/begin MEASUREMENT Rte_SrlComOutput_PimIsDatDiraMsg.TrqLimitState "MICROSAR RTE" UBYTE RTE_CM_BOOLEAN 0 0 0 255 ECU_ADDRESS 0 READ_WRITE /end MEASUREMENT
/begin MEASUREMENT Rte_SrlComOutput_PimIsDynDaeMsg.AngleColonne "MICROSAR RTE" SWORD RTE_CM_ANGLE_COLONNE 0 0 -163 163 ECU_ADDRESS 0 READ_WRITE /end MEASUREMENT
/begin MEASUREMENT Rte_SrlComOutput_PimIsDynDaeMsg.CauseDesactivCpk "MICROSAR RTE" UBYTE RTE_CM_CAUSE_DESACTIV_CPK 0 0 0 7 ECU_ADDRESS 0 READ_WRITE /end MEASUREMENT
/begin MEASUREMENT Rte_SrlComOutput_PimIsDynDaeMsg.ChksumTrmeDynDae "MICROSAR RTE" UBYTE NO_COMPU_METHOD 0 0 0 15 ECU_ADDRESS 0 READ_WRITE /end MEASUREMENT
/begin MEASUREMENT Rte_SrlComOutput_PimIsDynDaeMsg.CpleVolantOptimse "MICROSAR RTE" SBYTE RTE_CM_CPLE_VOLANT_OPTMSE 0 0 -1 1 ECU_ADDRESS 0 READ_WRITE /end MEASUREMENT
/begin MEASUREMENT Rte_SrlComOutput_PimIsDynDaeMsg.CptProcess4bDae "MICROSAR RTE" UBYTE NO_COMPU_METHOD 0 0 0 15 ECU_ADDRESS 0 READ_WRITE /end MEASUREMENT
/begin MEASUREMENT Rte_SrlComOutput_PimIsDynDaeMsg.EtatDaeCav3Virtuel "MICROSAR RTE" UBYTE RTE_CM_ETAT_DAE_CAV3_VIRTUEL 0 0 0 7 ECU_ADDRESS 0 READ_WRITE /end MEASUREMENT
/begin MEASUREMENT Rte_SrlComOutput_PimIsDynDaeMsg.EtatDaeCpk "MICROSAR RTE" UBYTE RTE_CM_ETAT_DAE_CPK 0 0 0 3 ECU_ADDRESS 0 READ_WRITE /end MEASUREMENT
/begin MEASUREMENT Rte_SrlComOutput_PimIsDynDaeMsg.EtatSecuAngleCol "MICROSAR RTE" UBYTE RTE_CM_BOOLEAN 0 0 0 255 ECU_ADDRESS 0 READ_WRITE /end MEASUREMENT
/begin MEASUREMENT Rte_SrlComOutput_PimIsDynDaeMsg.VitesseColonne "MICROSAR RTE" SWORD RTE_CM_VITESSE_COLONNE 0 0 -2000 2000 ECU_ADDRESS 0 READ_WRITE /end MEASUREMENT
/begin MEASUREMENT Rte_SrlComOutput_PimIsDynVolAddMsg.AngleVolantOrigine "MICROSAR RTE" UBYTE RTE_CM_ANGLE_VOLANT_ORIGINE 0 0 0 3 ECU_ADDRESS 0 READ_WRITE /end MEASUREMENT
/begin MEASUREMENT Rte_SrlComOutput_PimIsDynVolAddMsg.CalibrationVol "MICROSAR RTE" UBYTE RTE_CM_BOOLEAN 0 0 0 255 ECU_ADDRESS 0 READ_WRITE /end MEASUREMENT
/begin MEASUREMENT Rte_SrlComOutput_PimIsDynVolAddMsg.CodeDefaultVol "MICROSAR RTE" UBYTE RTE_CM_CODE_DEFAUT_VOL 0 0 0 4 ECU_ADDRESS 0 READ_WRITE /end MEASUREMENT
/begin MEASUREMENT Rte_SrlComOutput_PimIsDynVolAddMsg.EtatCaptVol "MICROSAR RTE" UBYTE RTE_CM_BOOLEAN 0 0 0 255 ECU_ADDRESS 0 READ_WRITE /end MEASUREMENT
/begin MEASUREMENT Rte_SrlComOutput_PimIsDynVolAddMsg.FlgAvolIcn "MICROSAR RTE" UBYTE RTE_CM_BOOLEAN 0 0 0 255 ECU_ADDRESS 0 READ_WRITE /end MEASUREMENT
/begin MEASUREMENT Rte_SrlComOutput_PimIsDynVolAddMsg.FlgInitAvol "MICROSAR RTE" UBYTE RTE_CM_BOOLEAN 0 0 0 255 ECU_ADDRESS 0 READ_WRITE /end MEASUREMENT
/begin MEASUREMENT Rte_SrlComOutput_PimIsDynVolAddMsg.TrimVol "MICROSAR RTE" UBYTE RTE_CM_BOOLEAN 0 0 0 255 ECU_ADDRESS 0 READ_WRITE /end MEASUREMENT
/begin MEASUREMENT Rte_SrlComOutput_PimIsDynVolAddMsg.VitesseRotVolOptimise "MICROSAR RTE" UBYTE RTE_CM_VITESSE_ROT_VOL_OPTIMISE 0 0 0 4064 ECU_ADDRESS 0 READ_WRITE /end MEASUREMENT
/begin MEASUREMENT Rte_SrlComOutput_PimIsDynVolBaseMsg.AngleVolant "MICROSAR RTE" SWORD RTE_CM_ANGLE_VOLANT 0 0 -78 78 ECU_ADDRESS 0 READ_WRITE /end MEASUREMENT
/begin MEASUREMENT Rte_SrlComOutput_PimIsDynVolBaseMsg.ChksumVol "MICROSAR RTE" UBYTE NO_COMPU_METHOD 0 0 0 15 ECU_ADDRESS 0 READ_WRITE /end MEASUREMENT
/begin MEASUREMENT Rte_SrlComOutput_PimIsDynVolBaseMsg.CptProcess4bAVol "MICROSAR RTE" UBYTE NO_COMPU_METHOD 0 0 0 15 ECU_ADDRESS 0 READ_WRITE /end MEASUREMENT
/begin MEASUREMENT Rte_SrlComOutput_PimIsDynVolBaseMsg.SensRotVol "MICROSAR RTE" UBYTE RTE_CM_BOOLEAN 0 0 0 255 ECU_ADDRESS 0 READ_WRITE /end MEASUREMENT
/begin MEASUREMENT Rte_SrlComOutput_PimIsDynVolBaseMsg.VitesseRotVol "MICROSAR RTE" UBYTE RTE_CM_VITESSE_ROT_VOL 0 0 0 4064 ECU_ADDRESS 0 READ_WRITE /end MEASUREMENT
/begin MEASUREMENT Rte_SrlComOutput_PimIsSupvDiraMsg.CodeDefaut "MICROSAR RTE" UBYTE RTE_CM_CODE_DEFAUT 0 0 0 1 ECU_ADDRESS 0 READ_WRITE /end MEASUREMENT
/begin MEASUREMENT Rte_SrlComOutput_PimIsSupvDiraMsg.EtatAssistDa "MICROSAR RTE" UBYTE RTE_CM_ETAT_ASSIST_DA 0 0 0 7 ECU_ADDRESS 0 READ_WRITE /end MEASUREMENT
/begin MEASUREMENT Rte_SrlComOutput_PimIsSupvDiraMsg.EtatLigneApc "MICROSAR RTE" UBYTE RTE_CM_BOOLEAN 0 0 0 255 ECU_ADDRESS 0 READ_WRITE /end MEASUREMENT
/begin MEASUREMENT Rte_SrlComOutput_PimIsSupvDiraMsg.StatusConfabsent "MICROSAR RTE" ULONG NO_COMPU_METHOD 0 0 0 4294967295 ECU_ADDRESS 0 READ_WRITE /end MEASUREMENT
/begin MEASUREMENT Rte_StOpCtrl_SysStReqDi_Cnt_lgc "MICROSAR RTE" UBYTE RTE_CM_BOOLEAN 0 0 0 255 ECU_ADDRESS 0 /end MEASUREMENT
/begin MEASUREMENT Rte_VehPwrMd_OperRampRate_XpmS_f32 "MICROSAR RTE" FLOAT32_IEEE NO_COMPU_METHOD 0 0 1.175494351e-38 3.402823466e+38 ECU_ADDRESS 0 /end MEASUREMENT
/begin MEASUREMENT Rte_VehPwrMd_OperRampValue_Uls_f32 "MICROSAR RTE" FLOAT32_IEEE NO_COMPU_METHOD 0 0 1.175494351e-38 3.402823466e+38 ECU_ADDRESS 0 /end MEASUREMENT
/begin MEASUREMENT Rte_StOpCtrl_StrtStopRateLimit_UlspS_f32 "MICROSAR RTE" FLOAT32_IEEE NO_COMPU_METHOD 0 0 1.175494351e-38 3.402823466e+38 ECU_ADDRESS 0 /end MEASUREMENT
/begin MEASUREMENT Rte_StOpCtrl_StrtStopScaleFctr_Uls_f32 "MICROSAR RTE" FLOAT32_IEEE NO_COMPU_METHOD 0 0 1.175494351e-38 3.402823466e+38 ECU_ADDRESS 0 /end MEASUREMENT
/begin MEASUREMENT Rte_VehPwrMd_ATermActive_Cnt_lgc "MICROSAR RTE" UBYTE RTE_CM_BOOLEAN 0 0 0 255 ECU_ADDRESS 0 /end MEASUREMENT
/begin MEASUREMENT Rte_TranlDampg_CntrlDampComp_Cnt_lgc "MICROSAR RTE" UBYTE RTE_CM_BOOLEAN 0 0 0 255 ECU_ADDRESS 0 /end MEASUREMENT
/begin MEASUREMENT Rte_StaMd_PwrDnFastWriteComplete_Cnt_lgc "MICROSAR RTE" UBYTE RTE_CM_BOOLEAN 0 0 0 255 ECU_ADDRESS 0 /end MEASUREMENT
/begin MEASUREMENT Rte_StabilityComp_AssistDDFactor_Uls_f32 "MICROSAR RTE" FLOAT32_IEEE NO_COMPU_METHOD 0 0 1.175494351e-38 3.402823466e+38 ECU_ADDRESS 0 /end MEASUREMENT
/begin MEASUREMENT Rte_StabilityComp2_SysAssistCmd_MtrNm_f32 "MICROSAR RTE" FLOAT32_IEEE NO_COMPU_METHOD 0 0 1.175494351e-38 3.402823466e+38 ECU_ADDRESS 0 /end MEASUREMENT
/begin MEASUREMENT Rte_StabilityComp2_AssistDDFactor_Uls_f32 "MICROSAR RTE" FLOAT32_IEEE NO_COMPU_METHOD 0 0 1.175494351e-38 3.402823466e+38 ECU_ADDRESS 0 /end MEASUREMENT
/begin MEASUREMENT Rte_Sweep2_OutputMtrTrq_MtrNm_f32 "MICROSAR RTE" FLOAT32_IEEE NO_COMPU_METHOD 0 0 1.175494351e-38 3.402823466e+38 ECU_ADDRESS 0 /end MEASUREMENT
/begin MEASUREMENT Rte_ThrmlDutyCycle_ThrmlDutyCycle_FltStVal.Filt3Val_Cnt_u8 "MICROSAR RTE" UBYTE NO_COMPU_METHOD 0 0 0 255 ECU_ADDRESS 0 READ_WRITE /end MEASUREMENT
/begin MEASUREMENT Rte_ThrmlDutyCycle_ThrmlDutyCycle_FltStVal.Filt4Val_Cnt_u8 "MICROSAR RTE" UBYTE NO_COMPU_METHOD 0 0 0 255 ECU_ADDRESS 0 READ_WRITE /end MEASUREMENT
/begin MEASUREMENT Rte_ThrmlDutyCycle_ThrmlDutyCycle_FltStVal.Filt5Val_Cnt_u8 "MICROSAR RTE" UBYTE NO_COMPU_METHOD 0 0 0 255 ECU_ADDRESS 0 READ_WRITE /end MEASUREMENT
/begin MEASUREMENT Rte_ThrmlDutyCycle_ThrmlDutyCycle_FltStVal.Filt6Val_Cnt_u8 "MICROSAR RTE" UBYTE NO_COMPU_METHOD 0 0 0 255 ECU_ADDRESS 0 READ_WRITE /end MEASUREMENT
/begin MEASUREMENT Rte_TranlDampg_SysC_CRFMtrTrqCmd_MtrNm_f32 "MICROSAR RTE" FLOAT32_IEEE NO_COMPU_METHOD 0 0 1.175494351e-38 3.402823466e+38 ECU_ADDRESS 0 /end MEASUREMENT
/begin MEASUREMENT Rte_TranlDampg_SysC_MRFMtrTrqCmd_MtrNm_f32 "MICROSAR RTE" FLOAT32_IEEE NO_COMPU_METHOD 0 0 1.175494351e-38 3.402823466e+38 ECU_ADDRESS 0 /end MEASUREMENT
/begin MEASUREMENT Rte_TrqCanc_CogTrqCal "MICROSAR RTE" UWORD NO_COMPU_METHOD 0 0 0 65535 MATRIX_DIM 512 1 1 ECU_ADDRESS 0 READ_WRITE /end MEASUREMENT
/begin MEASUREMENT Rte_TrqCanc_CogTrqRplComp "MICROSAR RTE" UWORD NO_COMPU_METHOD 0 0 0 65535 MATRIX_DIM 9 1 1 ECU_ADDRESS 0 READ_WRITE /end MEASUREMENT
/begin MEASUREMENT Rte_TrqCmdScl_TorqueCmdSF_Uls_f32 "MICROSAR RTE" FLOAT32_IEEE NO_COMPU_METHOD 0 0 1.175494351e-38 3.402823466e+38 ECU_ADDRESS 0 READ_WRITE /end MEASUREMENT
/begin MEASUREMENT Rte_TrqLOA_TrqLoaDi_Cnt_lgc "MICROSAR RTE" UBYTE RTE_CM_BOOLEAN 0 0 0 255 ECU_ADDRESS 0 /end MEASUREMENT
/begin MEASUREMENT Rte_TrqLOA_VehWhlBas_mm_f32 "MICROSAR RTE" FLOAT32_IEEE NO_COMPU_METHOD 0 0 1.175494351e-38 3.402823466e+38 ECU_ADDRESS 0 /end MEASUREMENT
/begin MEASUREMENT Rte_TrqLOA_VehWhlBasVld_Cnt_lgc "MICROSAR RTE" UBYTE RTE_CM_BOOLEAN 0 0 0 255 ECU_ADDRESS 0 /end MEASUREMENT
/begin MEASUREMENT Rte_VehDyn_MotPosReset.NVMStoredLastPosValid_Cnt_lgc "MICROSAR RTE" UBYTE RTE_CM_BOOLEAN 0 0 0 255 ECU_ADDRESS 0 READ_WRITE /end MEASUREMENT
/begin MEASUREMENT Rte_VehDyn_MotPosReset.NVMStoredLastPos_HwDeg_f32 "MICROSAR RTE" FLOAT32_IEEE NO_COMPU_METHOD 0 0 1.175494351e-38 3.402823466e+38 ECU_ADDRESS 0 READ_WRITE /end MEASUREMENT
/begin GROUP Return.PAReturnSclFct.Uls_f32 "MICROSAR RTE" /begin SUB_GROUP /end SUB_GROUP /begin FUNCTION_LIST /end FUNCTION_LIST /begin REF_CHARACTERISTIC /end REF_CHARACTERISTIC /end GROUP
/begin GROUP Return.ReceiverPorts "MICROSAR RTE"
 /begin SUB_GROUP Return.AssistMechTempEst.DegC_f32 Return.DefeatReturnSvc.Cnt_lgc Return.DiagStsHwPosDis.Cnt_lgc Return.HandwheelAuthority.Uls_f32 Return.HandwheelPosition.HwDeg_f32 Return.HandwheelVel.HwRadpS_f32 Return.HwTorque.HwNm_f32 Return.PAReturnSclFct.Uls_f32 Return.ReturnDDFactor.Uls_f32 Return.ReturnOffset.HwDeg_f32 Return.VehicleSpeed.Kph_f32 /end SUB_GROUP
 /begin FUNCTION_LIST /end FUNCTION_LIST
 /begin REF_CHARACTERISTIC /end REF_CHARACTERISTIC
 /begin REF_MEASUREMENT /end REF_MEASUREMENT
/end GROUP
/begin GROUP Return.ReturnCmd.MtrNm_f32 "MICROSAR RTE" /begin SUB_GROUP /end SUB_GROUP /begin FUNCTION_LIST /end FUNCTION_LIST /begin REF_CHARACTERISTIC /end REF_CHARACTERISTIC /begin REF_MEASUREMENT Rte_Return_ReturnCmd_MtrNm_f32 /end REF_MEASUREMENT /end GROUP
/begin GROUP Return.ReturnDDFactor.Uls_f32 "MICROSAR RTE" /begin SUB_GROUP /end SUB_GROUP /begin FUNCTION_LIST /end FUNCTION_LIST /begin REF_CHARACTERISTIC /end REF_CHARACTERISTIC /begin REF_MEASUREMENT Rte_Return_ReturnDDFactor_Uls_f32 /end REF_MEASUREMENT /end GROUP
/begin GROUP Return.ReturnOffset.HwDeg_f32 "MICROSAR RTE" /begin SUB_GROUP /end SUB_GROUP /begin FUNCTION_LIST /end FUNCTION_LIST /begin REF_CHARACTERISTIC /end REF_CHARACTERISTIC /begin REF_MEASUREMENT Rte_Return_ReturnOffset_HwDeg_f32 /end REF_MEASUREMENT /end GROUP
/begin GROUP Return.SenderPorts "MICROSAR RTE" /begin SUB_GROUP Return.ReturnCmd.MtrNm_f32 /end SUB_GROUP /begin FUNCTION_LIST /end FUNCTION_LIST /begin REF_CHARACTERISTIC /end REF_CHARACTERISTIC /begin REF_MEASUREMENT /end REF_MEASUREMENT /end GROUP
/begin GROUP Return.VehicleSpeed.Kph_f32 "MICROSAR RTE" /begin SUB_GROUP /end SUB_GROUP /begin FUNCTION_LIST /end FUNCTION_LIST /begin REF_CHARACTERISTIC /end REF_CHARACTERISTIC /end GROUP
/begin GROUP ReturnFirewall "MICROSAR RTE" /begin SUB_GROUP ReturnFirewall.ReceiverPorts ReturnFirewall.SenderPorts /end SUB_GROUP /begin FUNCTION_LIST /end FUNCTION_LIST /begin REF_CHARACTERISTIC /end REF_CHARACTERISTIC /begin REF_MEASUREMENT /end REF_MEASUREMENT /end GROUP
/begin GROUP ReturnFirewall.Defeat_Return_Svc.Cnt_lgc "MICROSAR RTE" /begin SUB_GROUP /end SUB_GROUP /begin FUNCTION_LIST /end FUNCTION_LIST /begin REF_CHARACTERISTIC /end REF_CHARACTERISTIC /end GROUP
/begin GROUP ReturnFirewall.HandwheelPosition.HwDeg_f32 "MICROSAR RTE" /begin SUB_GROUP /end SUB_GROUP /begin FUNCTION_LIST /end FUNCTION_LIST /begin REF_CHARACTERISTIC /end REF_CHARACTERISTIC /end GROUP
/begin GROUP ReturnFirewall.LimitedReturn.MtrNm_f32 "MICROSAR RTE" /begin SUB_GROUP /end SUB_GROUP /begin FUNCTION_LIST /end FUNCTION_LIST /begin REF_CHARACTERISTIC /end REF_CHARACTERISTIC /end GROUP
/begin GROUP ReturnFirewall.MEC_Counter.Cnt_enum "MICROSAR RTE" /begin SUB_GROUP /end SUB_GROUP /begin FUNCTION_LIST /end FUNCTION_LIST /begin REF_CHARACTERISTIC /end REF_CHARACTERISTIC /end GROUP
/begin GROUP ReturnFirewall.ReceiverPorts "MICROSAR RTE"
 /begin SUB_GROUP ReturnFirewall.Defeat_Return_Svc.Cnt_lgc ReturnFirewall.HandwheelPosition.HwDeg_f32 ReturnFirewall.MEC_Counter.Cnt_enum ReturnFirewall.ReturnCmd.MtrNm_f32 ReturnFirewall.VehicleSpeed.Kph_f32 /end SUB_GROUP
 /begin FUNCTION_LIST /end FUNCTION_LIST
 /begin REF_CHARACTERISTIC /end REF_CHARACTERISTIC
 /begin REF_MEASUREMENT /end REF_MEASUREMENT
/end GROUP
/begin GROUP ReturnFirewall.ReturnCmd.MtrNm_f32 "MICROSAR RTE" /begin SUB_GROUP /end SUB_GROUP /begin FUNCTION_LIST /end FUNCTION_LIST /begin REF_CHARACTERISTIC /end REF_CHARACTERISTIC /begin REF_MEASUREMENT Rte_Return_ReturnCmd_MtrNm_f32 /end REF_MEASUREMENT /end GROUP
/begin GROUP ReturnFirewall.SenderPorts "MICROSAR RTE" /begin SUB_GROUP ReturnFirewall.LimitedReturn.MtrNm_f32 /end SUB_GROUP /begin FUNCTION_LIST /end FUNCTION_LIST /begin REF_CHARACTERISTIC /end REF_CHARACTERISTIC /begin REF_MEASUREMENT /end REF_MEASUREMENT /end GROUP
/begin GROUP ReturnFirewall.VehicleSpeed.Kph_f32 "MICROSAR RTE" /begin SUB_GROUP /end SUB_GROUP /begin FUNCTION_LIST /end FUNCTION_LIST /begin REF_CHARACTERISTIC /end REF_CHARACTERISTIC /end GROUP
/begin GROUP RteErrata10 "MICROSAR RTE" /begin SUB_GROUP RteErrata10.ModeRequirePorts /end SUB_GROUP /begin FUNCTION_LIST /end FUNCTION_LIST /begin REF_CHARACTERISTIC /end REF_CHARACTERISTIC /begin REF_MEASUREMENT /end REF_MEASUREMENT /end GROUP
/begin GROUP RteErrata10.ModeRequirePorts "MICROSAR RTE" /begin SUB_GROUP RteErrata10.SystemState.Mode /end SUB_GROUP /begin FUNCTION_LIST /end FUNCTION_LIST /begin REF_CHARACTERISTIC /end REF_CHARACTERISTIC /begin REF_MEASUREMENT /end REF_MEASUREMENT /end GROUP
/begin GROUP RteErrata10.SystemState.Mode "MICROSAR RTE" /begin SUB_GROUP /end SUB_GROUP /begin FUNCTION_LIST /end FUNCTION_LIST /begin REF_CHARACTERISTIC /end REF_CHARACTERISTIC /end GROUP
/begin GROUP RteErrata11 "MICROSAR RTE" /begin SUB_GROUP RteErrata11.ModeRequirePorts /end SUB_GROUP /begin FUNCTION_LIST /end FUNCTION_LIST /begin REF_CHARACTERISTIC /end REF_CHARACTERISTIC /begin REF_MEASUREMENT /end REF_MEASUREMENT /end GROUP
/begin GROUP RteErrata11.ModeRequirePorts "MICROSAR RTE" /begin SUB_GROUP RteErrata11.SystemState.Mode /end SUB_GROUP /begin FUNCTION_LIST /end FUNCTION_LIST /begin REF_CHARACTERISTIC /end REF_CHARACTERISTIC /begin REF_MEASUREMENT /end REF_MEASUREMENT /end GROUP
/begin GROUP RteErrata11.SystemState.Mode "MICROSAR RTE" /begin SUB_GROUP /end SUB_GROUP /begin FUNCTION_LIST /end FUNCTION_LIST /begin REF_CHARACTERISTIC /end REF_CHARACTERISTIC /end GROUP
/begin GROUP RteErrata6 "MICROSAR RTE" /begin SUB_GROUP RteErrata6.ModeRequirePorts /end SUB_GROUP /begin FUNCTION_LIST /end FUNCTION_LIST /begin REF_CHARACTERISTIC /end REF_CHARACTERISTIC /begin REF_MEASUREMENT /end REF_MEASUREMENT /end GROUP
/begin GROUP RteErrata6.ModeRequirePorts "MICROSAR RTE" /begin SUB_GROUP RteErrata6.SystemState.Mode /end SUB_GROUP /begin FUNCTION_LIST /end FUNCTION_LIST /begin REF_CHARACTERISTIC /end REF_CHARACTERISTIC /begin REF_MEASUREMENT /end REF_MEASUREMENT /end GROUP
/begin GROUP RteErrata6.SystemState.Mode "MICROSAR RTE" /begin SUB_GROUP /end SUB_GROUP /begin FUNCTION_LIST /end FUNCTION_LIST /begin REF_CHARACTERISTIC /end REF_CHARACTERISTIC /end GROUP
/begin GROUP RteErrata9 "MICROSAR RTE" /begin SUB_GROUP RteErrata9.ModeRequirePorts /end SUB_GROUP /begin FUNCTION_LIST /end FUNCTION_LIST /begin REF_CHARACTERISTIC /end REF_CHARACTERISTIC /begin REF_MEASUREMENT /end REF_MEASUREMENT /end GROUP
/begin GROUP RteErrata9.ModeRequirePorts "MICROSAR RTE" /begin SUB_GROUP RteErrata9.SystemState.Mode /end SUB_GROUP /begin FUNCTION_LIST /end FUNCTION_LIST /begin REF_CHARACTERISTIC /end REF_CHARACTERISTIC /begin REF_MEASUREMENT /end REF_MEASUREMENT /end GROUP
/begin GROUP RteErrata9.SystemState.Mode "MICROSAR RTE" /begin SUB_GROUP /end SUB_GROUP /begin FUNCTION_LIST /end FUNCTION_LIST /begin REF_CHARACTERISTIC /end REF_CHARACTERISTIC /end GROUP
/begin GROUP SWCs "MICROSAR RTE"
 /begin SUB_GROUP AbsHwPos ActivePull ApXcp Ap_CtrlPolarityBrshlss Assist AssistFirewall AstLmt AvgFricLrn BVDiag BatteryVoltage BkCpPc CDDInterface10 CDDInterface11 CDDInterface6 CDDInterface9 CmMtrCurr ComplErr CtrlTemp CurrCmd CurrParamComp CustBattDiag Damping DampingFirewall DemIf DiagMgr10 DiagMgr11 DiagMgr6 DiagMgr9 DiagSvc DigMSB DigPhsReasDiag EOTActuatorMng ElePwr EtDmpFw FaultLog FltInjection FrqDepDmpnInrtCmp HOWDetect HiLoadStall HighFreqAssist HwPwUp HwTqArbn HwTqCorrln HystComp IoHwAb10 LmtCod LoaMgr LrnEOT MtrDrvDiag MtrTempEst MtrVel MtrVel2 Nhet1CfgAndUse OvrVoltMon PICurrCntrl PSADMQ PSADSG PSASH PSATA PeakCurrEst PhaseAbcFdbkMeas PosServo PsaAgArbn PwrLmtFuncCr QuadDet Return ReturnFirewall RteErrata10 RteErrata11 RteErrata6 RteErrata9 SignlCondn SrlComDriver SrlComInput SrlComOutput StOpCtrl StaMd StaMd11 StaMd6 StaMd9 StabilityComp StabilityComp2 Sweep Sweep2 ThrmlDutyCycle TmprlMon TqRsDg TranlDampg TrqCanc TrqCmdScl TrqLOA TuningSelAuth VehDyn VehPwrMd VehSpdLmt ePWM2 /end SUB_GROUP
 /begin FUNCTION_LIST /end FUNCTION_LIST
 /begin REF_CHARACTERISTIC /end REF_CHARACTERISTIC
 /begin REF_MEASUREMENT /end REF_MEASUREMENT
/end GROUP
/begin GROUP SignlCondn "MICROSAR RTE" /begin SUB_GROUP SignlCondn.ReceiverPorts SignlCondn.SenderPorts /end SUB_GROUP /begin FUNCTION_LIST /end FUNCTION_LIST /begin REF_CHARACTERISTIC /end REF_CHARACTERISTIC /begin REF_MEASUREMENT /end REF_MEASUREMENT /end GROUP
/begin GROUP SignlCondn.ReceiverPorts "MICROSAR RTE"
 /begin SUB_GROUP SignlCondn.SrlComVehSpeed.Kph_f32 SignlCondn.SrlCom_VehicleLonAccel.KphpS_f32 /end SUB_GROUP
 /begin FUNCTION_LIST /end FUNCTION_LIST
 /begin REF_CHARACTERISTIC /end REF_CHARACTERISTIC
 /begin REF_MEASUREMENT /end REF_MEASUREMENT
/end GROUP
/begin GROUP SignlCondn.SenderPorts "MICROSAR RTE"
 /begin SUB_GROUP SignlCondn.VehicleSpeed.Kph_f32 SignlCondn.Vehicle_LonAccel.KphpS_f32 /end SUB_GROUP
 /begin FUNCTION_LIST /end FUNCTION_LIST
 /begin REF_CHARACTERISTIC /end REF_CHARACTERISTIC
 /begin REF_MEASUREMENT /end REF_MEASUREMENT
/end GROUP
/begin GROUP SignlCondn.SrlComVehSpeed.Kph_f32 "MICROSAR RTE" /begin SUB_GROUP /end SUB_GROUP /begin FUNCTION_LIST /end FUNCTION_LIST /begin REF_CHARACTERISTIC /end REF_CHARACTERISTIC /end GROUP
/begin GROUP SignlCondn.SrlCom_VehicleLonAccel.KphpS_f32 "MICROSAR RTE" /begin SUB_GROUP /end SUB_GROUP /begin FUNCTION_LIST /end FUNCTION_LIST /begin REF_CHARACTERISTIC /end REF_CHARACTERISTIC /begin REF_MEASUREMENT Rte_SignlCondn_SrlCom_VehicleLonAccel_KphpS_f32 /end REF_MEASUREMENT /end GROUP
/begin GROUP SignlCondn.VehicleSpeed.Kph_f32 "MICROSAR RTE" /begin SUB_GROUP /end SUB_GROUP /begin FUNCTION_LIST /end FUNCTION_LIST /begin REF_CHARACTERISTIC /end REF_CHARACTERISTIC /end GROUP
/begin GROUP SignlCondn.Vehicle_LonAccel.KphpS_f32 "MICROSAR RTE" /begin SUB_GROUP /end SUB_GROUP /begin FUNCTION_LIST /end FUNCTION_LIST /begin REF_CHARACTERISTIC /end REF_CHARACTERISTIC /end GROUP
/begin GROUP SrlComDriver "MICROSAR RTE"
 /begin SUB_GROUP SrlComDriver.ModeRequirePorts SrlComDriver.ReceiverPorts SrlComDriver.SenderPorts /end SUB_GROUP
 /begin FUNCTION_LIST /end FUNCTION_LIST
 /begin REF_CHARACTERISTIC /end REF_CHARACTERISTIC
 /begin REF_MEASUREMENT /end REF_MEASUREMENT
/end GROUP
/begin GROUP SrlComDriver.AccelLat.Cnt_s16 "MICROSAR RTE" /begin SUB_GROUP /end SUB_GROUP /begin FUNCTION_LIST /end FUNCTION_LIST /begin REF_CHARACTERISTIC /end REF_CHARACTERISTIC /begin REF_MEASUREMENT Rte_SrlComDriver_AccelLat_Cnt_s16 /end REF_MEASUREMENT /end GROUP
/begin GROUP SrlComDriver.AnneeEcoule.Cnt_u08 "MICROSAR RTE" /begin SUB_GROUP /end SUB_GROUP /begin FUNCTION_LIST /end FUNCTION_LIST /begin REF_CHARACTERISTIC /end REF_CHARACTERISTIC /begin REF_MEASUREMENT Rte_SrlComDriver_AnneeEcoule_Cnt_u08 /end REF_MEASUREMENT /end GROUP
/begin GROUP SrlComDriver.BusOff.Cnt_lgc "MICROSAR RTE" /begin SUB_GROUP /end SUB_GROUP /begin FUNCTION_LIST /end FUNCTION_LIST /begin REF_CHARACTERISTIC /end REF_CHARACTERISTIC /end GROUP
/begin GROUP SrlComDriver.CAVHCSelected.Cnt_lgc "MICROSAR RTE" /begin SUB_GROUP /end SUB_GROUP /begin FUNCTION_LIST /end FUNCTION_LIST /begin REF_CHARACTERISTIC /end REF_CHARACTERISTIC /end GROUP
/begin GROUP SrlComDriver.CityParkSelected.Cnt_lgc "MICROSAR RTE" /begin SUB_GROUP /end SUB_GROUP /begin FUNCTION_LIST /end FUNCTION_LIST /begin REF_CHARACTERISTIC /end REF_CHARACTERISTIC /end GROUP
/begin GROUP SrlComDriver.ColumnAngleSetpoint.Cnt_u16 "MICROSAR RTE" /begin SUB_GROUP /end SUB_GROUP /begin FUNCTION_LIST /end FUNCTION_LIST /begin REF_CHARACTERISTIC /end REF_CHARACTERISTIC /begin REF_MEASUREMENT Rte_SrlComDriver_ColumnAngleSetpoint_Cnt_u16 /end REF_MEASUREMENT /end GROUP
/begin GROUP SrlComDriver.CompteurTemporelVehicule.Cnt_u32 "MICROSAR RTE" /begin SUB_GROUP /end SUB_GROUP /begin FUNCTION_LIST /end FUNCTION_LIST /begin REF_CHARACTERISTIC /end REF_CHARACTERISTIC /begin REF_MEASUREMENT Rte_SrlComDriver_CompteurTemporelVehicule_Cnt_u32 /end REF_MEASUREMENT /end GROUP
/begin GROUP SrlComDriver.ComputerRazGCT.Cnt_u08 "MICROSAR RTE" /begin SUB_GROUP /end SUB_GROUP /begin FUNCTION_LIST /end FUNCTION_LIST /begin REF_CHARACTERISTIC /end REF_CHARACTERISTIC /begin REF_MEASUREMENT Rte_SrlComDriver_ComputerRazGCT_Cnt_u08 /end REF_MEASUREMENT /end GROUP
/begin GROUP SrlComDriver.ConfigVhl.Cnt_u08 "MICROSAR RTE" /begin SUB_GROUP /end SUB_GROUP /begin FUNCTION_LIST /end FUNCTION_LIST /begin REF_CHARACTERISTIC /end REF_CHARACTERISTIC /begin REF_MEASUREMENT Rte_SrlComDriver_ConfigVhl_Cnt_u08 /end REF_MEASUREMENT /end GROUP
/begin GROUP SrlComDriver.DiagIntegraElec.Cnt_u08 "MICROSAR RTE" /begin SUB_GROUP /end SUB_GROUP /begin FUNCTION_LIST /end FUNCTION_LIST /begin REF_CHARACTERISTIC /end REF_CHARACTERISTIC /begin REF_MEASUREMENT Rte_SrlComDriver_DiagIntegraElec_Cnt_u08 /end REF_MEASUREMENT /end GROUP
/begin GROUP SrlComDriver.DiagMuxOn.Cnt_u08 "MICROSAR RTE" /begin SUB_GROUP /end SUB_GROUP /begin FUNCTION_LIST /end FUNCTION_LIST /begin REF_CHARACTERISTIC /end REF_CHARACTERISTIC /begin REF_MEASUREMENT Rte_SrlComDriver_DiagMuxOn_Cnt_u08 /end REF_MEASUREMENT /end GROUP
/begin GROUP SrlComDriver.DmdDelestDA.Cnt_u08 "MICROSAR RTE" /begin SUB_GROUP /end SUB_GROUP /begin FUNCTION_LIST /end FUNCTION_LIST /begin REF_CHARACTERISTIC /end REF_CHARACTERISTIC /begin REF_MEASUREMENT Rte_SrlComDriver_DmdDelestDA_Cnt_u08 /end REF_MEASUREMENT /end GROUP
/begin GROUP SrlComDriver.ESCOffsCfgSeld.Cnt_lgc "MICROSAR RTE" /begin SUB_GROUP /end SUB_GROUP /begin FUNCTION_LIST /end FUNCTION_LIST /begin REF_CHARACTERISTIC /end REF_CHARACTERISTIC /end GROUP
/begin GROUP SrlComDriver.ESPDeconnecte.Cnt_u08 "MICROSAR RTE" /begin SUB_GROUP /end SUB_GROUP /begin FUNCTION_LIST /end FUNCTION_LIST /begin REF_CHARACTERISTIC /end REF_CHARACTERISTIC /begin REF_MEASUREMENT Rte_SrlComDriver_ESPDeconnecte_Cnt_u08 /end REF_MEASUREMENT /end GROUP
/begin GROUP SrlComDriver.EffacDefaultDiag.Cnt_u08 "MICROSAR RTE" /begin SUB_GROUP /end SUB_GROUP /begin FUNCTION_LIST /end FUNCTION_LIST /begin REF_CHARACTERISTIC /end REF_CHARACTERISTIC /begin REF_MEASUREMENT Rte_SrlComDriver_EffacDefaultDiag_Cnt_u08 /end REF_MEASUREMENT /end GROUP
/begin GROUP SrlComDriver.ElectronicIntegration.Cnt_lgc "MICROSAR RTE" /begin SUB_GROUP /end SUB_GROUP /begin FUNCTION_LIST /end FUNCTION_LIST /begin REF_CHARACTERISTIC /end REF_CHARACTERISTIC /end GROUP
/begin GROUP SrlComDriver.EtatMT.Cnt_u08 "MICROSAR RTE" /begin SUB_GROUP /end SUB_GROUP /begin FUNCTION_LIST /end FUNCTION_LIST /begin REF_CHARACTERISTIC /end REF_CHARACTERISTIC /begin REF_MEASUREMENT Rte_SrlComDriver_EtatMT_Cnt_u08 /end REF_MEASUREMENT /end GROUP
/begin GROUP SrlComDriver.EtatPrincipSev.Cnt_u08 "MICROSAR RTE" /begin SUB_GROUP /end SUB_GROUP /begin FUNCTION_LIST /end FUNCTION_LIST /begin REF_CHARACTERISTIC /end REF_CHARACTERISTIC /begin REF_MEASUREMENT Rte_SrlComDriver_EtatPrincipSev_Cnt_u08 /end REF_MEASUREMENT /end GROUP
/begin GROUP SrlComDriver.EtatReseauElec.Cnt_u08 "MICROSAR RTE" /begin SUB_GROUP /end SUB_GROUP /begin FUNCTION_LIST /end FUNCTION_LIST /begin REF_CHARACTERISTIC /end REF_CHARACTERISTIC /begin REF_MEASUREMENT Rte_SrlComDriver_EtatReseauElec_Cnt_u08 /end REF_MEASUREMENT /end GROUP
/begin GROUP SrlComDriver.ISDAT4V2BSI552MsgDLCError.Cnt_u08 "MICROSAR RTE" /begin SUB_GROUP /end SUB_GROUP /begin FUNCTION_LIST /end FUNCTION_LIST /begin REF_CHARACTERISTIC /end REF_CHARACTERISTIC /begin REF_MEASUREMENT Rte_SrlComDriver_ISDAT4V2BSI552MsgDLCError_Cnt_u08 /end REF_MEASUREMENT /end GROUP
/begin GROUP SrlComDriver.ISDATABR50DMsgDLCError.Cnt_u08 "MICROSAR RTE" /begin SUB_GROUP /end SUB_GROUP /begin FUNCTION_LIST /end FUNCTION_LIST /begin REF_CHARACTERISTIC /end REF_CHARACTERISTIC /begin REF_MEASUREMENT Rte_SrlComDriver_ISDATABR50DMsgDLCError_Cnt_u08 /end REF_MEASUREMENT /end GROUP
/begin GROUP SrlComDriver.ISDATBSI3F2MsgDLCError.Cnt_u08 "MICROSAR RTE" /begin SUB_GROUP /end SUB_GROUP /begin FUNCTION_LIST /end FUNCTION_LIST /begin REF_CHARACTERISTIC /end REF_CHARACTERISTIC /begin REF_MEASUREMENT Rte_SrlComDriver_ISDATBSI3F2MsgDLCError_Cnt_u08 /end REF_MEASUREMENT /end GROUP
/begin GROUP SrlComDriver.ISDATBSI412MsgDLCError.Cnt_u08 "MICROSAR RTE" /begin SUB_GROUP /end SUB_GROUP /begin FUNCTION_LIST /end FUNCTION_LIST /begin REF_CHARACTERISTIC /end REF_CHARACTERISTIC /begin REF_MEASUREMENT Rte_SrlComDriver_ISDATBSI412MsgDLCError_Cnt_u08 /end REF_MEASUREMENT /end GROUP
/begin GROUP SrlComDriver.ISDATBSI432MsgDLCError.Cnt_u08 "MICROSAR RTE" /begin SUB_GROUP /end SUB_GROUP /begin FUNCTION_LIST /end FUNCTION_LIST /begin REF_CHARACTERISTIC /end REF_CHARACTERISTIC /begin REF_MEASUREMENT Rte_SrlComDriver_ISDATBSI432MsgDLCError_Cnt_u08 /end REF_MEASUREMENT /end GROUP
/begin GROUP SrlComDriver.ISDATBSI572MsgDLCError.Cnt_u08 "MICROSAR RTE" /begin SUB_GROUP /end SUB_GROUP /begin FUNCTION_LIST /end FUNCTION_LIST /begin REF_CHARACTERISTIC /end REF_CHARACTERISTIC /begin REF_MEASUREMENT Rte_SrlComDriver_ISDATBSI572MsgDLCError_Cnt_u08 /end REF_MEASUREMENT /end GROUP
/begin GROUP SrlComDriver.ISDATDIRAMsgTxInProgress.Cnt_lgc "MICROSAR RTE" /begin SUB_GROUP /end SUB_GROUP /begin FUNCTION_LIST /end FUNCTION_LIST /begin REF_CHARACTERISTIC /end REF_CHARACTERISTIC /begin REF_MEASUREMENT Rte_SrlComDriver_ISDATDIRAMsgTxInProgress_Cnt_lgc /end REF_MEASUREMENT /end GROUP
/begin GROUP SrlComDriver.ISDYN2CMMMsgDLCError.Cnt_u08 "MICROSAR RTE" /begin SUB_GROUP /end SUB_GROUP /begin FUNCTION_LIST /end FUNCTION_LIST /begin REF_CHARACTERISTIC /end REF_CHARACTERISTIC /begin REF_MEASUREMENT Rte_SrlComDriver_ISDYN2CMMMsgDLCError_Cnt_u08 /end REF_MEASUREMENT /end GROUP
/begin GROUP SrlComDriver.ISDYN2FRE3CDMsgDLCError.Cnt_u08 "MICROSAR RTE" /begin SUB_GROUP /end SUB_GROUP /begin FUNCTION_LIST /end FUNCTION_LIST /begin REF_CHARACTERISTIC /end REF_CHARACTERISTIC /begin REF_MEASUREMENT Rte_SrlComDriver_ISDYN2FRE3CDMsgDLCError_Cnt_u08 /end REF_MEASUREMENT /end GROUP
/begin GROUP SrlComDriver.ISDYNAASMsgDLCError.Cnt_u08 "MICROSAR RTE" /begin SUB_GROUP /end SUB_GROUP /begin FUNCTION_LIST /end FUNCTION_LIST /begin REF_CHARACTERISTIC /end REF_CHARACTERISTIC /begin REF_MEASUREMENT Rte_SrlComDriver_ISDYNAASMsgDLCError_Cnt_u08 /end REF_MEASUREMENT /end GROUP
/begin GROUP SrlComDriver.ISDYNABRMsgDLCError.Cnt_u08 "MICROSAR RTE" /begin SUB_GROUP /end SUB_GROUP /begin FUNCTION_LIST /end FUNCTION_LIST /begin REF_CHARACTERISTIC /end REF_CHARACTERISTIC /begin REF_MEASUREMENT Rte_SrlComDriver_ISDYNABRMsgDLCError_Cnt_u08 /end REF_MEASUREMENT /end GROUP
/begin GROUP SrlComDriver.ISDYNCDS34DMsgDLCError.Cnt_u08 "MICROSAR RTE" /begin SUB_GROUP /end SUB_GROUP /begin FUNCTION_LIST /end FUNCTION_LIST /begin REF_CHARACTERISTIC /end REF_CHARACTERISTIC /begin REF_MEASUREMENT Rte_SrlComDriver_ISDYNCDS34DMsgDLCError_Cnt_u08 /end REF_MEASUREMENT /end GROUP
/begin GROUP SrlComDriver.ISDYNCMM208MsgDLCError.Cnt_u08 "MICROSAR RTE" /begin SUB_GROUP /end SUB_GROUP /begin FUNCTION_LIST /end FUNCTION_LIST /begin REF_CHARACTERISTIC /end REF_CHARACTERISTIC /begin REF_MEASUREMENT Rte_SrlComDriver_ISDYNCMM208MsgDLCError_Cnt_u08 /end REF_MEASUREMENT /end GROUP
/begin GROUP SrlComDriver.ISDYNCMM388MsgDLCError.Cnt_u08 "MICROSAR RTE" /begin SUB_GROUP /end SUB_GROUP /begin FUNCTION_LIST /end FUNCTION_LIST /begin REF_CHARACTERISTIC /end REF_CHARACTERISTIC /begin REF_MEASUREMENT Rte_SrlComDriver_ISDYNCMM388MsgDLCError_Cnt_u08 /end REF_MEASUREMENT /end GROUP
/begin GROUP SrlComDriver.ISDYNVOLMsgDLCError.Cnt_u08 "MICROSAR RTE" /begin SUB_GROUP /end SUB_GROUP /begin FUNCTION_LIST /end FUNCTION_LIST /begin REF_CHARACTERISTIC /end REF_CHARACTERISTIC /begin REF_MEASUREMENT Rte_SrlComDriver_ISDYNVOLMsgDLCError_Cnt_u08 /end REF_MEASUREMENT /end GROUP
/begin GROUP SrlComDriver.JourEcoule.Cnt_u16 "MICROSAR RTE" /begin SUB_GROUP /end SUB_GROUP /begin FUNCTION_LIST /end FUNCTION_LIST /begin REF_CHARACTERISTIC /end REF_CHARACTERISTIC /begin REF_MEASUREMENT Rte_SrlComDriver_JourEcoule_Cnt_u16 /end REF_MEASUREMENT /end GROUP
/begin GROUP SrlComDriver.Kilometrage.Cnt_u32 "MICROSAR RTE" /begin SUB_GROUP /end SUB_GROUP /begin FUNCTION_LIST /end FUNCTION_LIST /begin REF_CHARACTERISTIC /end REF_CHARACTERISTIC /end GROUP
/begin GROUP SrlComDriver.LKAState.Cnt_u08 "MICROSAR RTE" /begin SUB_GROUP /end SUB_GROUP /begin FUNCTION_LIST /end FUNCTION_LIST /begin REF_CHARACTERISTIC /end REF_CHARACTERISTIC /begin REF_MEASUREMENT Rte_SrlComDriver_LKAState_Cnt_u08 /end REF_MEASUREMENT /end GROUP
/begin GROUP SrlComDriver.LKATrqFactReq.Cnt_u08 "MICROSAR RTE" /begin SUB_GROUP /end SUB_GROUP /begin FUNCTION_LIST /end FUNCTION_LIST /begin REF_CHARACTERISTIC /end REF_CHARACTERISTIC /begin REF_MEASUREMENT Rte_SrlComDriver_LKATrqFactReq_Cnt_u08 /end REF_MEASUREMENT /end GROUP
/begin GROUP SrlComDriver.LXAActivation.Cnt_u08 "MICROSAR RTE" /begin SUB_GROUP /end SUB_GROUP /begin FUNCTION_LIST /end FUNCTION_LIST /begin REF_CHARACTERISTIC /end REF_CHARACTERISTIC /begin REF_MEASUREMENT Rte_SrlComDriver_LXAActivation_Cnt_u08 /end REF_MEASUREMENT /end GROUP
/begin GROUP SrlComDriver.LXASelected.Cnt_lgc "MICROSAR RTE" /begin SUB_GROUP /end SUB_GROUP /begin FUNCTION_LIST /end FUNCTION_LIST /begin REF_CHARACTERISTIC /end REF_CHARACTERISTIC /end GROUP
/begin GROUP SrlComDriver.ModeDiag.Cnt_u08 "MICROSAR RTE" /begin SUB_GROUP /end SUB_GROUP /begin FUNCTION_LIST /end FUNCTION_LIST /begin REF_CHARACTERISTIC /end REF_CHARACTERISTIC /begin REF_MEASUREMENT Rte_SrlComDriver_ModeDiag_Cnt_u08 /end REF_MEASUREMENT /end GROUP
/begin GROUP SrlComDriver.ModeRequirePorts "MICROSAR RTE" /begin SUB_GROUP SrlComDriver.SystemState.Mode /end SUB_GROUP /begin FUNCTION_LIST /end FUNCTION_LIST /begin REF_CHARACTERISTIC /end REF_CHARACTERISTIC /begin REF_MEASUREMENT /end REF_MEASUREMENT /end GROUP
/begin GROUP SrlComDriver.MultimodeSelected.Cnt_lgc "MICROSAR RTE" /begin SUB_GROUP /end SUB_GROUP /begin FUNCTION_LIST /end FUNCTION_LIST /begin REF_CHARACTERISTIC /end REF_CHARACTERISTIC /end GROUP
/begin GROUP SrlComDriver.PROTOHS1DYNUCF5CDMsgDLCError.Cnt_u08 "MICROSAR RTE" /begin SUB_GROUP /end SUB_GROUP /begin FUNCTION_LIST /end FUNCTION_LIST /begin REF_CHARACTERISTIC /end REF_CHARACTERISTIC /begin REF_MEASUREMENT Rte_SrlComDriver_PROTOHS1DYNUCF5CDMsgDLCError_Cnt_u08 /end REF_MEASUREMENT /end GROUP
/begin GROUP SrlComDriver.PowerSupplies.Cnt_u08 "MICROSAR RTE" /begin SUB_GROUP /end SUB_GROUP /begin FUNCTION_LIST /end FUNCTION_LIST /begin REF_CHARACTERISTIC /end REF_CHARACTERISTIC /begin REF_MEASUREMENT Rte_SrlComDriver_PowerSupplies_Cnt_u08 /end REF_MEASUREMENT /end GROUP
/begin GROUP SrlComDriver.ReceiverPorts "MICROSAR RTE"
 /begin SUB_GROUP SrlComDriver.CAVHCSelected.Cnt_lgc SrlComDriver.CityParkSelected.Cnt_lgc SrlComDriver.ESCOffsCfgSeld.Cnt_lgc SrlComDriver.ElectronicIntegration.Cnt_lgc SrlComDriver.LXASelected.Cnt_lgc SrlComDriver.MultimodeSelected.Cnt_lgc SrlComDriver.STTdSelected.Cnt_lgc SrlComDriver.TMFTestComplete.Cnt_lgc SrlComDriver.VVHType.Cnt_u08 /end SUB_GROUP
 /begin FUNCTION_LIST /end FUNCTION_LIST
 /begin REF_CHARACTERISTIC /end REF_CHARACTERISTIC
 /begin REF_MEASUREMENT /end REF_MEASUREMENT
/end GROUP
/begin GROUP SrlComDriver.RegulABR.Cnt_u08 "MICROSAR RTE" /begin SUB_GROUP /end SUB_GROUP /begin FUNCTION_LIST /end FUNCTION_LIST /begin REF_CHARACTERISTIC /end REF_CHARACTERISTIC /begin REF_MEASUREMENT Rte_SrlComDriver_RegulABR_Cnt_u08 /end REF_MEASUREMENT /end GROUP
/begin GROUP SrlComDriver.RegulESP.Cnt_u08 "MICROSAR RTE" /begin SUB_GROUP /end SUB_GROUP /begin FUNCTION_LIST /end FUNCTION_LIST /begin REF_CHARACTERISTIC /end REF_CHARACTERISTIC /begin REF_MEASUREMENT Rte_SrlComDriver_RegulESP_Cnt_u08 /end REF_MEASUREMENT /end GROUP
/begin GROUP SrlComDriver.ReqLampeDefEsp.Cnt_u08 "MICROSAR RTE" /begin SUB_GROUP /end SUB_GROUP /begin FUNCTION_LIST /end FUNCTION_LIST /begin REF_CHARACTERISTIC /end REF_CHARACTERISTIC /begin REF_MEASUREMENT Rte_SrlComDriver_ReqLampeDefEsp_Cnt_u08 /end REF_MEASUREMENT /end GROUP
/begin GROUP SrlComDriver.ReqModeDA.Cnt_u08 "MICROSAR RTE" /begin SUB_GROUP /end SUB_GROUP /begin FUNCTION_LIST /end FUNCTION_LIST /begin REF_CHARACTERISTIC /end REF_CHARACTERISTIC /begin REF_MEASUREMENT Rte_SrlComDriver_ReqModeDA_Cnt_u08 /end REF_MEASUREMENT /end GROUP
/begin GROUP SrlComDriver.STTdSelected.Cnt_lgc "MICROSAR RTE" /begin SUB_GROUP /end SUB_GROUP /begin FUNCTION_LIST /end FUNCTION_LIST /begin REF_CHARACTERISTIC /end REF_CHARACTERISTIC /end GROUP
/begin GROUP SrlComDriver.SecondeEcoulee.Cnt_u32 "MICROSAR RTE" /begin SUB_GROUP /end SUB_GROUP /begin FUNCTION_LIST /end FUNCTION_LIST /begin REF_CHARACTERISTIC /end REF_CHARACTERISTIC /begin REF_MEASUREMENT Rte_SrlComDriver_SecondeEcoulee_Cnt_u32 /end REF_MEASUREMENT /end GROUP
/begin GROUP SrlComDriver.SenderPorts "MICROSAR RTE"
 /begin SUB_GROUP SrlComDriver.AccelLat.Cnt_s16 SrlComDriver.AnneeEcoule.Cnt_u08 SrlComDriver.BusOff.Cnt_lgc SrlComDriver.ColumnAngleSetpoint.Cnt_u16 SrlComDriver.CompteurTemporelVehicule.Cnt_u32 SrlComDriver.ComputerRazGCT.Cnt_u08 SrlComDriver.ConfigVhl.Cnt_u08 SrlComDriver.DiagIntegraElec.Cnt_u08 SrlComDriver.DiagMuxOn.Cnt_u08 SrlComDriver.DmdDelestDA.Cnt_u08 SrlComDriver.ESPDeconnecte.Cnt_u08 SrlComDriver.EffacDefaultDiag.Cnt_u08 SrlComDriver.EtatMT.Cnt_u08 SrlComDriver.EtatPrincipSev.Cnt_u08 SrlComDriver.EtatReseauElec.Cnt_u08 SrlComDriver.ISDAT4V2BSI552MsgDLCError.Cnt_u08 SrlComDriver.ISDATABR50DMsgDLCError.Cnt_u08 SrlComDriver.ISDATBSI3F2MsgDLCError.Cnt_u08 SrlComDriver.ISDATBSI412MsgDLCError.Cnt_u08 SrlComDriver.ISDATBSI432MsgDLCError.Cnt_u08 SrlComDriver.ISDATBSI572MsgDLCError.Cnt_u08 SrlComDriver.ISDATDIRAMsgTxInProgress.Cnt_lgc SrlComDriver.ISDYN2CMMMsgDLCError.Cnt_u08 SrlComDriver.ISDYN2FRE3CDMsgDLCError.Cnt_u08 SrlComDriver.ISDYNAASMsgDLCError.Cnt_u08 SrlComDriver.ISDYNABRMsgDLCError.Cnt_u08 SrlComDriver.ISDYNCDS34DMsgDLCError.Cnt_u08 SrlComDriver.ISDYNCMM208MsgDLCError.Cnt_u08 SrlComDriver.ISDYNCMM388MsgDLCError.Cnt_u08 SrlComDriver.ISDYNVOLMsgDLCError.Cnt_u08 SrlComDriver.JourEcoule.Cnt_u16 SrlComDriver.Kilometrage.Cnt_u32 SrlComDriver.LKAState.Cnt_u08 SrlComDriver.LKATrqFactReq.Cnt_u08 SrlComDriver.LXAActivation.Cnt_u08 SrlComDriver.ModeDiag.Cnt_u08 SrlComDriver.PROTOHS1DYNUCF5CDMsgDLCError.Cnt_u08 SrlComDriver.PowerSupplies.Cnt_u08 SrlComDriver.RegulABR.Cnt_u08 SrlComDriver.RegulESP.Cnt_u08 SrlComDriver.ReqLampeDefEsp.Cnt_u08 SrlComDriver.ReqModeDA.Cnt_u08 SrlComDriver.SecondeEcoulee.Cnt_u32 SrlComDriver.ShuntPosition.Cnt_u08 SrlComDriver.TxEnabled.Cnt_lgc SrlComDriver.VitesseVehicleBV.Cnt_u16 /end SUB_GROUP
 /begin FUNCTION_LIST /end FUNCTION_LIST
 /begin REF_CHARACTERISTIC /end REF_CHARACTERISTIC
 /begin REF_MEASUREMENT /end REF_MEASUREMENT
/end GROUP
/begin GROUP SrlComDriver.ShuntPosition.Cnt_u08 "MICROSAR RTE" /begin SUB_GROUP /end SUB_GROUP /begin FUNCTION_LIST /end FUNCTION_LIST /begin REF_CHARACTERISTIC /end REF_CHARACTERISTIC /begin REF_MEASUREMENT Rte_SrlComDriver_ShuntPosition_Cnt_u08 /end REF_MEASUREMENT /end GROUP
/begin GROUP SrlComDriver.SystemState.Mode "MICROSAR RTE" /begin SUB_GROUP /end SUB_GROUP /begin FUNCTION_LIST /end FUNCTION_LIST /begin REF_CHARACTERISTIC /end REF_CHARACTERISTIC /end GROUP
/begin GROUP SrlComDriver.TMFTestComplete.Cnt_lgc "MICROSAR RTE" /begin SUB_GROUP /end SUB_GROUP /begin FUNCTION_LIST /end FUNCTION_LIST /begin REF_CHARACTERISTIC /end REF_CHARACTERISTIC /end GROUP
/begin GROUP SrlComDriver.TxEnabled.Cnt_lgc "MICROSAR RTE" /begin SUB_GROUP /end SUB_GROUP /begin FUNCTION_LIST /end FUNCTION_LIST /begin REF_CHARACTERISTIC /end REF_CHARACTERISTIC /end GROUP
/begin GROUP SrlComDriver.VVHType.Cnt_u08 "MICROSAR RTE" /begin SUB_GROUP /end SUB_GROUP /begin FUNCTION_LIST /end FUNCTION_LIST /begin REF_CHARACTERISTIC /end REF_CHARACTERISTIC /begin REF_MEASUREMENT Rte_SrlComInput_VVHType_Cnt_u08 /end REF_MEASUREMENT /end GROUP
/begin GROUP SrlComDriver.VitesseVehicleBV.Cnt_u16 "MICROSAR RTE" /begin SUB_GROUP /end SUB_GROUP /begin FUNCTION_LIST /end FUNCTION_LIST /begin REF_CHARACTERISTIC /end REF_CHARACTERISTIC /begin REF_MEASUREMENT Rte_SrlComDriver_VitesseVehicleBV_Cnt_u16 /end REF_MEASUREMENT /end GROUP
/begin GROUP SrlComInput "MICROSAR RTE"
 /begin SUB_GROUP SrlComInput.ModeRequirePorts SrlComInput.PerInstanceMemories SrlComInput.ReceiverPorts SrlComInput.SenderPorts /end SUB_GROUP
 /begin FUNCTION_LIST /end FUNCTION_LIST
 /begin REF_CHARACTERISTIC /end REF_CHARACTERISTIC
 /begin REF_MEASUREMENT /end REF_MEASUREMENT
/end GROUP
/begin GROUP SrlComInput.APAAuthn.Cnt_lgc "MICROSAR RTE" /begin SUB_GROUP /end SUB_GROUP /begin FUNCTION_LIST /end FUNCTION_LIST /begin REF_CHARACTERISTIC /end REF_CHARACTERISTIC /end GROUP
/begin GROUP SrlComInput.APARequest.Cnt_lgc "MICROSAR RTE" /begin SUB_GROUP /end SUB_GROUP /begin FUNCTION_LIST /end FUNCTION_LIST /begin REF_CHARACTERISTIC /end REF_CHARACTERISTIC /end GROUP
/begin GROUP SrlComInput.AbsActv.Cnt_lgc "MICROSAR RTE" /begin SUB_GROUP /end SUB_GROUP /begin FUNCTION_LIST /end FUNCTION_LIST /begin REF_CHARACTERISTIC /end REF_CHARACTERISTIC /end GROUP
/begin GROUP SrlComInput.AccelLat.Cnt_s16 "MICROSAR RTE" /begin SUB_GROUP /end SUB_GROUP /begin FUNCTION_LIST /end FUNCTION_LIST /begin REF_CHARACTERISTIC /end REF_CHARACTERISTIC /begin REF_MEASUREMENT Rte_SrlComDriver_AccelLat_Cnt_s16 /end REF_MEASUREMENT /end GROUP
/begin GROUP SrlComInput.AngleVolant.HwDeg_f32 "MICROSAR RTE" /begin SUB_GROUP /end SUB_GROUP /begin FUNCTION_LIST /end FUNCTION_LIST /begin REF_CHARACTERISTIC /end REF_CHARACTERISTIC /begin REF_MEASUREMENT Rte_SrlComInput_AngleVolant_HwDeg_f32 /end REF_MEASUREMENT /end GROUP
/begin GROUP SrlComInput.AnneeEcoule.Cnt_u08 "MICROSAR RTE" /begin SUB_GROUP /end SUB_GROUP /begin FUNCTION_LIST /end FUNCTION_LIST /begin REF_CHARACTERISTIC /end REF_CHARACTERISTIC /begin REF_MEASUREMENT Rte_SrlComDriver_AnneeEcoule_Cnt_u08 /end REF_MEASUREMENT /end GROUP
/begin GROUP SrlComInput.ApaRelaxReq.Cnt_lgc "MICROSAR RTE" /begin SUB_GROUP /end SUB_GROUP /begin FUNCTION_LIST /end FUNCTION_LIST /begin REF_CHARACTERISTIC /end REF_CHARACTERISTIC /end GROUP
/begin GROUP SrlComInput.ApaVehicleSpeedValid.Cnt_lgc "MICROSAR RTE" /begin SUB_GROUP /end SUB_GROUP /begin FUNCTION_LIST /end FUNCTION_LIST /begin REF_CHARACTERISTIC /end REF_CHARACTERISTIC /end GROUP
/begin GROUP SrlComInput.BSIDataMissing.Cnt_lgc "MICROSAR RTE" /begin SUB_GROUP /end SUB_GROUP /begin FUNCTION_LIST /end FUNCTION_LIST /begin REF_CHARACTERISTIC /end REF_CHARACTERISTIC /end GROUP
/begin GROUP SrlComInput.Batt.Volt_f32 "MICROSAR RTE" /begin SUB_GROUP /end SUB_GROUP /begin FUNCTION_LIST /end FUNCTION_LIST /begin REF_CHARACTERISTIC /end REF_CHARACTERISTIC /end GROUP
/begin GROUP SrlComInput.BusOff.Cnt_lgc "MICROSAR RTE" /begin SUB_GROUP /end SUB_GROUP /begin FUNCTION_LIST /end FUNCTION_LIST /begin REF_CHARACTERISTIC /end REF_CHARACTERISTIC /end GROUP
/begin GROUP SrlComInput.CAVHCSelected.Cnt_lgc "MICROSAR RTE" /begin SUB_GROUP /end SUB_GROUP /begin FUNCTION_LIST /end FUNCTION_LIST /begin REF_CHARACTERISTIC /end REF_CHARACTERISTIC /end GROUP
/begin GROUP SrlComInput.CMMDataMissing.Cnt_lgc "MICROSAR RTE" /begin SUB_GROUP /end SUB_GROUP /begin FUNCTION_LIST /end FUNCTION_LIST /begin REF_CHARACTERISTIC /end REF_CHARACTERISTIC /end GROUP
/begin GROUP SrlComInput.CONSANGLECPK.Cnt_s16 "MICROSAR RTE" /begin SUB_GROUP /end SUB_GROUP /begin FUNCTION_LIST /end FUNCTION_LIST /begin REF_CHARACTERISTIC /end REF_CHARACTERISTIC /begin REF_MEASUREMENT Rte_SrlComInput_CONSANGLECPK_Cnt_s16 /end REF_MEASUREMENT /end GROUP
/begin GROUP SrlComInput.CPKOK.Cnt_lgc "MICROSAR RTE" /begin SUB_GROUP /end SUB_GROUP /begin FUNCTION_LIST /end FUNCTION_LIST /begin REF_CHARACTERISTIC /end REF_CHARACTERISTIC /end GROUP
/begin GROUP SrlComInput.CTermActive.Cnt_lgc "MICROSAR RTE" /begin SUB_GROUP /end SUB_GROUP /begin FUNCTION_LIST /end FUNCTION_LIST /begin REF_CHARACTERISTIC /end REF_CHARACTERISTIC /end GROUP
/begin GROUP SrlComInput.CityParkSelected.Cnt_lgc "MICROSAR RTE" /begin SUB_GROUP /end SUB_GROUP /begin FUNCTION_LIST /end FUNCTION_LIST /begin REF_CHARACTERISTIC /end REF_CHARACTERISTIC /end GROUP
/begin GROUP SrlComInput.ColAngleSetpoint.HwDeg_f32 "MICROSAR RTE" /begin SUB_GROUP /end SUB_GROUP /begin FUNCTION_LIST /end FUNCTION_LIST /begin REF_CHARACTERISTIC /end REF_CHARACTERISTIC /end GROUP
/begin GROUP SrlComInput.ColumnAngleSetpoint.Cnt_u16 "MICROSAR RTE" /begin SUB_GROUP /end SUB_GROUP /begin FUNCTION_LIST /end FUNCTION_LIST /begin REF_CHARACTERISTIC /end REF_CHARACTERISTIC /begin REF_MEASUREMENT Rte_SrlComDriver_ColumnAngleSetpoint_Cnt_u16 /end REF_MEASUREMENT /end GROUP
/begin GROUP SrlComInput.CompteurTemporelVehicule.Cnt_u32 "MICROSAR RTE" /begin SUB_GROUP /end SUB_GROUP /begin FUNCTION_LIST /end FUNCTION_LIST /begin REF_CHARACTERISTIC /end REF_CHARACTERISTIC /begin REF_MEASUREMENT Rte_SrlComDriver_CompteurTemporelVehicule_Cnt_u32 /end REF_MEASUREMENT /end GROUP
/begin GROUP SrlComInput.CompteurTemporelVehiculeRaw.Cnt_u32 "MICROSAR RTE" /begin SUB_GROUP /end SUB_GROUP /begin FUNCTION_LIST /end FUNCTION_LIST /begin REF_CHARACTERISTIC /end REF_CHARACTERISTIC /end GROUP
/begin GROUP SrlComInput.ComputerRazGCT.Cnt_u08 "MICROSAR RTE" /begin SUB_GROUP /end SUB_GROUP /begin FUNCTION_LIST /end FUNCTION_LIST /begin REF_CHARACTERISTIC /end REF_CHARACTERISTIC /begin REF_MEASUREMENT Rte_SrlComDriver_ComputerRazGCT_Cnt_u08 /end REF_MEASUREMENT /end GROUP
/begin GROUP SrlComInput.ComputerRazGCTRaw.Cnt_u08 "MICROSAR RTE" /begin SUB_GROUP /end SUB_GROUP /begin FUNCTION_LIST /end FUNCTION_LIST /begin REF_CHARACTERISTIC /end REF_CHARACTERISTIC /end GROUP
/begin GROUP SrlComInput.ConfigVhl.Cnt_u08 "MICROSAR RTE" /begin SUB_GROUP /end SUB_GROUP /begin FUNCTION_LIST /end FUNCTION_LIST /begin REF_CHARACTERISTIC /end REF_CHARACTERISTIC /begin REF_MEASUREMENT Rte_SrlComDriver_ConfigVhl_Cnt_u08 /end REF_MEASUREMENT /end GROUP
/begin GROUP SrlComInput.DMDFCTCPK.Cnt_u08 "MICROSAR RTE" /begin SUB_GROUP /end SUB_GROUP /begin FUNCTION_LIST /end FUNCTION_LIST /begin REF_CHARACTERISTIC /end REF_CHARACTERISTIC /begin REF_MEASUREMENT Rte_SrlComInput_DMDFCTCPK_Cnt_u08 /end REF_MEASUREMENT /end GROUP
/begin GROUP SrlComInput.DefaultVehSpd.Cnt_lgc "MICROSAR RTE" /begin SUB_GROUP /end SUB_GROUP /begin FUNCTION_LIST /end FUNCTION_LIST /begin REF_CHARACTERISTIC /end REF_CHARACTERISTIC /end GROUP
/begin GROUP SrlComInput.DiagIntegraElec.Cnt_u08 "MICROSAR RTE" /begin SUB_GROUP /end SUB_GROUP /begin FUNCTION_LIST /end FUNCTION_LIST /begin REF_CHARACTERISTIC /end REF_CHARACTERISTIC /begin REF_MEASUREMENT Rte_SrlComDriver_DiagIntegraElec_Cnt_u08 /end REF_MEASUREMENT /end GROUP
/begin GROUP SrlComInput.DiagMuxOn.Cnt_u08 "MICROSAR RTE" /begin SUB_GROUP /end SUB_GROUP /begin FUNCTION_LIST /end FUNCTION_LIST /begin REF_CHARACTERISTIC /end REF_CHARACTERISTIC /begin REF_MEASUREMENT Rte_SrlComDriver_DiagMuxOn_Cnt_u08 /end REF_MEASUREMENT /end GROUP
/begin GROUP SrlComInput.DmdDelestDA.Cnt_u08 "MICROSAR RTE" /begin SUB_GROUP /end SUB_GROUP /begin FUNCTION_LIST /end FUNCTION_LIST /begin REF_CHARACTERISTIC /end REF_CHARACTERISTIC /begin REF_MEASUREMENT Rte_SrlComDriver_DmdDelestDA_Cnt_u08 /end REF_MEASUREMENT /end GROUP
/begin GROUP SrlComInput.DmdDelestDaSts.Cnt_u08 "MICROSAR RTE" /begin SUB_GROUP /end SUB_GROUP /begin FUNCTION_LIST /end FUNCTION_LIST /begin REF_CHARACTERISTIC /end REF_CHARACTERISTIC /end GROUP
/begin GROUP SrlComInput.DmdDelestDaVld.Cnt_lgc "MICROSAR RTE" /begin SUB_GROUP /end SUB_GROUP /begin FUNCTION_LIST /end FUNCTION_LIST /begin REF_CHARACTERISTIC /end REF_CHARACTERISTIC /begin REF_MEASUREMENT Rte_SrlComInput_DmdDelestDaVld_Cnt_lgc /end REF_MEASUREMENT /end GROUP
/begin GROUP SrlComInput.ESCOffsCfgSeld.Cnt_lgc "MICROSAR RTE" /begin SUB_GROUP /end SUB_GROUP /begin FUNCTION_LIST /end FUNCTION_LIST /begin REF_CHARACTERISTIC /end REF_CHARACTERISTIC /end GROUP
/begin GROUP SrlComInput.ESPDeconnecte.Cnt_u08 "MICROSAR RTE" /begin SUB_GROUP /end SUB_GROUP /begin FUNCTION_LIST /end FUNCTION_LIST /begin REF_CHARACTERISTIC /end REF_CHARACTERISTIC /begin REF_MEASUREMENT Rte_SrlComDriver_ESPDeconnecte_Cnt_u08 /end REF_MEASUREMENT /end GROUP
/begin GROUP SrlComInput.EffacDefaultDiag.Cnt_u08 "MICROSAR RTE" /begin SUB_GROUP /end SUB_GROUP /begin FUNCTION_LIST /end FUNCTION_LIST /begin REF_CHARACTERISTIC /end REF_CHARACTERISTIC /begin REF_MEASUREMENT Rte_SrlComDriver_EffacDefaultDiag_Cnt_u08 /end REF_MEASUREMENT /end GROUP
/begin GROUP SrlComInput.ElecIntData "MICROSAR RTE" /begin SUB_GROUP /end SUB_GROUP /begin FUNCTION_LIST /end FUNCTION_LIST /begin REF_CHARACTERISTIC /end REF_CHARACTERISTIC /begin REF_MEASUREMENT Rte_SrlComInput_ElecIntData /end REF_MEASUREMENT /end GROUP
/begin GROUP SrlComInput.ElectronicIntegration.Cnt_lgc "MICROSAR RTE" /begin SUB_GROUP /end SUB_GROUP /begin FUNCTION_LIST /end FUNCTION_LIST /begin REF_CHARACTERISTIC /end REF_CHARACTERISTIC /end GROUP
/begin GROUP SrlComInput.EngOn.Cnt_lgc "MICROSAR RTE" /begin SUB_GROUP /end SUB_GROUP /begin FUNCTION_LIST /end FUNCTION_LIST /begin REF_CHARACTERISTIC /end REF_CHARACTERISTIC /end GROUP
/begin GROUP SrlComInput.EscAckFromSerlCom.Cnt_lgc "MICROSAR RTE" /begin SUB_GROUP /end SUB_GROUP /begin FUNCTION_LIST /end FUNCTION_LIST /begin REF_CHARACTERISTIC /end REF_CHARACTERISTIC /end GROUP
/begin GROUP SrlComInput.EscActv.Cnt_lgc "MICROSAR RTE" /begin SUB_GROUP /end SUB_GROUP /begin FUNCTION_LIST /end FUNCTION_LIST /begin REF_CHARACTERISTIC /end REF_CHARACTERISTIC /end GROUP
/begin GROUP SrlComInput.EscDataVldFromSerlCom.Cnt_lgc "MICROSAR RTE" /begin SUB_GROUP /end SUB_GROUP /begin FUNCTION_LIST /end FUNCTION_LIST /begin REF_CHARACTERISTIC /end REF_CHARACTERISTIC /end GROUP
/begin GROUP SrlComInput.EscEna.Cnt_lgc "MICROSAR RTE" /begin SUB_GROUP /end SUB_GROUP /begin FUNCTION_LIST /end FUNCTION_LIST /begin REF_CHARACTERISTIC /end REF_CHARACTERISTIC /end GROUP
/begin GROUP SrlComInput.EscFltPrsnt.Cnt_lgc "MICROSAR RTE" /begin SUB_GROUP /end SUB_GROUP /begin FUNCTION_LIST /end FUNCTION_LIST /begin REF_CHARACTERISTIC /end REF_CHARACTERISTIC /end GROUP
/begin GROUP SrlComInput.EscOffsFromSerlCom.HwDeg_f32 "MICROSAR RTE" /begin SUB_GROUP /end SUB_GROUP /begin FUNCTION_LIST /end FUNCTION_LIST /begin REF_CHARACTERISTIC /end REF_CHARACTERISTIC /end GROUP
/begin GROUP SrlComInput.EscPrecisionFromSerlCom.HwDeg_f32 "MICROSAR RTE" /begin SUB_GROUP /end SUB_GROUP /begin FUNCTION_LIST /end FUNCTION_LIST /begin REF_CHARACTERISTIC /end REF_CHARACTERISTIC /end GROUP
/begin GROUP SrlComInput.EtatMT.Cnt_u08 "MICROSAR RTE" /begin SUB_GROUP /end SUB_GROUP /begin FUNCTION_LIST /end FUNCTION_LIST /begin REF_CHARACTERISTIC /end REF_CHARACTERISTIC /begin REF_MEASUREMENT Rte_SrlComDriver_EtatMT_Cnt_u08 /end REF_MEASUREMENT /end GROUP
/begin GROUP SrlComInput.EtatMTRaw.Cnt_u08 "MICROSAR RTE" /begin SUB_GROUP /end SUB_GROUP /begin FUNCTION_LIST /end FUNCTION_LIST /begin REF_CHARACTERISTIC /end REF_CHARACTERISTIC /end GROUP
/begin GROUP SrlComInput.EtatPrincipSev.Cnt_u08 "MICROSAR RTE" /begin SUB_GROUP /end SUB_GROUP /begin FUNCTION_LIST /end FUNCTION_LIST /begin REF_CHARACTERISTIC /end REF_CHARACTERISTIC /end GROUP
/begin GROUP SrlComInput.EtatPrincipSevIn.Cnt_u08 "MICROSAR RTE" /begin SUB_GROUP /end SUB_GROUP /begin FUNCTION_LIST /end FUNCTION_LIST /begin REF_CHARACTERISTIC /end REF_CHARACTERISTIC /begin REF_MEASUREMENT Rte_SrlComDriver_EtatPrincipSev_Cnt_u08 /end REF_MEASUREMENT /end GROUP
/begin GROUP SrlComInput.EtatReseauElec.Cnt_u08 "MICROSAR RTE" /begin SUB_GROUP /end SUB_GROUP /begin FUNCTION_LIST /end FUNCTION_LIST /begin REF_CHARACTERISTIC /end REF_CHARACTERISTIC /end GROUP
/begin GROUP SrlComInput.EtatReseauElecIn.Cnt_u08 "MICROSAR RTE" /begin SUB_GROUP /end SUB_GROUP /begin FUNCTION_LIST /end FUNCTION_LIST /begin REF_CHARACTERISTIC /end REF_CHARACTERISTIC /begin REF_MEASUREMENT Rte_SrlComDriver_EtatReseauElec_Cnt_u08 /end REF_MEASUREMENT /end GROUP
/begin GROUP SrlComInput.ISDAT4V2BSI552MsgDLCError.Cnt_u08 "MICROSAR RTE" /begin SUB_GROUP /end SUB_GROUP /begin FUNCTION_LIST /end FUNCTION_LIST /begin REF_CHARACTERISTIC /end REF_CHARACTERISTIC /begin REF_MEASUREMENT Rte_SrlComDriver_ISDAT4V2BSI552MsgDLCError_Cnt_u08 /end REF_MEASUREMENT /end GROUP
/begin GROUP SrlComInput.ISDATABR50DMsgDLCError.Cnt_u08 "MICROSAR RTE" /begin SUB_GROUP /end SUB_GROUP /begin FUNCTION_LIST /end FUNCTION_LIST /begin REF_CHARACTERISTIC /end REF_CHARACTERISTIC /begin REF_MEASUREMENT Rte_SrlComDriver_ISDATABR50DMsgDLCError_Cnt_u08 /end REF_MEASUREMENT /end GROUP
/begin GROUP SrlComInput.ISDATBSI3F2MsgDLCError.Cnt_u08 "MICROSAR RTE" /begin SUB_GROUP /end SUB_GROUP /begin FUNCTION_LIST /end FUNCTION_LIST /begin REF_CHARACTERISTIC /end REF_CHARACTERISTIC /begin REF_MEASUREMENT Rte_SrlComDriver_ISDATBSI3F2MsgDLCError_Cnt_u08 /end REF_MEASUREMENT /end GROUP
/begin GROUP SrlComInput.ISDATBSI412MsgDLCError.Cnt_u08 "MICROSAR RTE" /begin SUB_GROUP /end SUB_GROUP /begin FUNCTION_LIST /end FUNCTION_LIST /begin REF_CHARACTERISTIC /end REF_CHARACTERISTIC /begin REF_MEASUREMENT Rte_SrlComDriver_ISDATBSI412MsgDLCError_Cnt_u08 /end REF_MEASUREMENT /end GROUP
/begin GROUP SrlComInput.ISDATBSI432MsgDLCError.Cnt_u08 "MICROSAR RTE" /begin SUB_GROUP /end SUB_GROUP /begin FUNCTION_LIST /end FUNCTION_LIST /begin REF_CHARACTERISTIC /end REF_CHARACTERISTIC /begin REF_MEASUREMENT Rte_SrlComDriver_ISDATBSI432MsgDLCError_Cnt_u08 /end REF_MEASUREMENT /end GROUP
/begin GROUP SrlComInput.ISDATBSI572MsgDLCError.Cnt_u08 "MICROSAR RTE" /begin SUB_GROUP /end SUB_GROUP /begin FUNCTION_LIST /end FUNCTION_LIST /begin REF_CHARACTERISTIC /end REF_CHARACTERISTIC /begin REF_MEASUREMENT Rte_SrlComDriver_ISDATBSI572MsgDLCError_Cnt_u08 /end REF_MEASUREMENT /end GROUP
/begin GROUP SrlComInput.ISDATDIRAMsgTxInProgress.Cnt_lgc "MICROSAR RTE" /begin SUB_GROUP /end SUB_GROUP /begin FUNCTION_LIST /end FUNCTION_LIST /begin REF_CHARACTERISTIC /end REF_CHARACTERISTIC /begin REF_MEASUREMENT Rte_SrlComDriver_ISDATDIRAMsgTxInProgress_Cnt_lgc /end REF_MEASUREMENT /end GROUP
/begin GROUP SrlComInput.ISDYN2CMMMsgDLCError.Cnt_u08 "MICROSAR RTE" /begin SUB_GROUP /end SUB_GROUP /begin FUNCTION_LIST /end FUNCTION_LIST /begin REF_CHARACTERISTIC /end REF_CHARACTERISTIC /begin REF_MEASUREMENT Rte_SrlComDriver_ISDYN2CMMMsgDLCError_Cnt_u08 /end REF_MEASUREMENT /end GROUP
/begin GROUP SrlComInput.ISDYN2FRE3CDMsgDLCError.Cnt_u08 "MICROSAR RTE" /begin SUB_GROUP /end SUB_GROUP /begin FUNCTION_LIST /end FUNCTION_LIST /begin REF_CHARACTERISTIC /end REF_CHARACTERISTIC /begin REF_MEASUREMENT Rte_SrlComDriver_ISDYN2FRE3CDMsgDLCError_Cnt_u08 /end REF_MEASUREMENT /end GROUP
/begin GROUP SrlComInput.ISDYNAASMsgDLCError.Cnt_u08 "MICROSAR RTE" /begin SUB_GROUP /end SUB_GROUP /begin FUNCTION_LIST /end FUNCTION_LIST /begin REF_CHARACTERISTIC /end REF_CHARACTERISTIC /begin REF_MEASUREMENT Rte_SrlComDriver_ISDYNAASMsgDLCError_Cnt_u08 /end REF_MEASUREMENT /end GROUP
/begin GROUP SrlComInput.ISDYNABRMsgDLCError.Cnt_u08 "MICROSAR RTE" /begin SUB_GROUP /end SUB_GROUP /begin FUNCTION_LIST /end FUNCTION_LIST /begin REF_CHARACTERISTIC /end REF_CHARACTERISTIC /begin REF_MEASUREMENT Rte_SrlComDriver_ISDYNABRMsgDLCError_Cnt_u08 /end REF_MEASUREMENT /end GROUP
/begin GROUP SrlComInput.ISDYNCDS34DMsgDLCError.Cnt_u08 "MICROSAR RTE" /begin SUB_GROUP /end SUB_GROUP /begin FUNCTION_LIST /end FUNCTION_LIST /begin REF_CHARACTERISTIC /end REF_CHARACTERISTIC /begin REF_MEASUREMENT Rte_SrlComDriver_ISDYNCDS34DMsgDLCError_Cnt_u08 /end REF_MEASUREMENT /end GROUP
/begin GROUP SrlComInput.ISDYNCMM208MsgDLCError.Cnt_u08 "MICROSAR RTE" /begin SUB_GROUP /end SUB_GROUP /begin FUNCTION_LIST /end FUNCTION_LIST /begin REF_CHARACTERISTIC /end REF_CHARACTERISTIC /begin REF_MEASUREMENT Rte_SrlComDriver_ISDYNCMM208MsgDLCError_Cnt_u08 /end REF_MEASUREMENT /end GROUP
/begin GROUP SrlComInput.ISDYNCMM388MsgDLCError.Cnt_u08 "MICROSAR RTE" /begin SUB_GROUP /end SUB_GROUP /begin FUNCTION_LIST /end FUNCTION_LIST /begin REF_CHARACTERISTIC /end REF_CHARACTERISTIC /begin REF_MEASUREMENT Rte_SrlComDriver_ISDYNCMM388MsgDLCError_Cnt_u08 /end REF_MEASUREMENT /end GROUP
/begin GROUP SrlComInput.ISDYNVOLMsgDLCError.Cnt_u08 "MICROSAR RTE" /begin SUB_GROUP /end SUB_GROUP /begin FUNCTION_LIST /end FUNCTION_LIST /begin REF_CHARACTERISTIC /end REF_CHARACTERISTIC /begin REF_MEASUREMENT Rte_SrlComDriver_ISDYNVOLMsgDLCError_Cnt_u08 /end REF_MEASUREMENT /end GROUP
/begin GROUP SrlComInput.IgnTimeOff.Cnt_u32 "MICROSAR RTE" /begin SUB_GROUP /end SUB_GROUP /begin FUNCTION_LIST /end FUNCTION_LIST /begin REF_CHARACTERISTIC /end REF_CHARACTERISTIC /begin REF_MEASUREMENT Rte_SrlComInput_IgnTimeOff_Cnt_u32 /end REF_MEASUREMENT /end GROUP
/begin GROUP SrlComInput.JourEcoule.Cnt_u16 "MICROSAR RTE" /begin SUB_GROUP /end SUB_GROUP /begin FUNCTION_LIST /end FUNCTION_LIST /begin REF_CHARACTERISTIC /end REF_CHARACTERISTIC /begin REF_MEASUREMENT Rte_SrlComDriver_JourEcoule_Cnt_u16 /end REF_MEASUREMENT /end GROUP
/begin GROUP SrlComInput.Kilometrage.Cnt_u32 "MICROSAR RTE" /begin SUB_GROUP /end SUB_GROUP /begin FUNCTION_LIST /end FUNCTION_LIST /begin REF_CHARACTERISTIC /end REF_CHARACTERISTIC /end GROUP
/begin GROUP SrlComInput.KilometrageIn.Cnt_u32 "MICROSAR RTE" /begin SUB_GROUP /end SUB_GROUP /begin FUNCTION_LIST /end FUNCTION_LIST /begin REF_CHARACTERISTIC /end REF_CHARACTERISTIC /end GROUP
/begin GROUP SrlComInput.LKAState.Cnt_u08 "MICROSAR RTE" /begin SUB_GROUP /end SUB_GROUP /begin FUNCTION_LIST /end FUNCTION_LIST /begin REF_CHARACTERISTIC /end REF_CHARACTERISTIC /begin REF_MEASUREMENT Rte_SrlComDriver_LKAState_Cnt_u08 /end REF_MEASUREMENT /end GROUP
/begin GROUP SrlComInput.LKATrqFactReq.Cnt_u08 "MICROSAR RTE" /begin SUB_GROUP /end SUB_GROUP /begin FUNCTION_LIST /end FUNCTION_LIST /begin REF_CHARACTERISTIC /end REF_CHARACTERISTIC /begin REF_MEASUREMENT Rte_SrlComDriver_LKATrqFactReq_Cnt_u08 /end REF_MEASUREMENT /end GROUP
/begin GROUP SrlComInput.LXAActivation.Cnt_u08 "MICROSAR RTE" /begin SUB_GROUP /end SUB_GROUP /begin FUNCTION_LIST /end FUNCTION_LIST /begin REF_CHARACTERISTIC /end REF_CHARACTERISTIC /begin REF_MEASUREMENT Rte_SrlComDriver_LXAActivation_Cnt_u08 /end REF_MEASUREMENT /end GROUP
/begin GROUP SrlComInput.LXASelected.Cnt_lgc "MICROSAR RTE" /begin SUB_GROUP /end SUB_GROUP /begin FUNCTION_LIST /end FUNCTION_LIST /begin REF_CHARACTERISTIC /end REF_CHARACTERISTIC /end GROUP
/begin GROUP SrlComInput.LxaInpVld.Cnt_lgc "MICROSAR RTE" /begin SUB_GROUP /end SUB_GROUP /begin FUNCTION_LIST /end FUNCTION_LIST /begin REF_CHARACTERISTIC /end REF_CHARACTERISTIC /end GROUP
/begin GROUP SrlComInput.LxaSeln.Cnt_lgc "MICROSAR RTE" /begin SUB_GROUP /end SUB_GROUP /begin FUNCTION_LIST /end FUNCTION_LIST /begin REF_CHARACTERISTIC /end REF_CHARACTERISTIC /end GROUP
/begin GROUP SrlComInput.LxaStateFilt.Cnt_enum "MICROSAR RTE" /begin SUB_GROUP /end SUB_GROUP /begin FUNCTION_LIST /end FUNCTION_LIST /begin REF_CHARACTERISTIC /end REF_CHARACTERISTIC /end GROUP
/begin GROUP SrlComInput.LxaTqFacReq.Uls_f32 "MICROSAR RTE" /begin SUB_GROUP /end SUB_GROUP /begin FUNCTION_LIST /end FUNCTION_LIST /begin REF_CHARACTERISTIC /end REF_CHARACTERISTIC /end GROUP
/begin GROUP SrlComInput.ModeDiag.Cnt_u08 "MICROSAR RTE" /begin SUB_GROUP /end SUB_GROUP /begin FUNCTION_LIST /end FUNCTION_LIST /begin REF_CHARACTERISTIC /end REF_CHARACTERISTIC /begin REF_MEASUREMENT Rte_SrlComDriver_ModeDiag_Cnt_u08 /end REF_MEASUREMENT /end GROUP
/begin GROUP SrlComInput.ModeRequirePorts "MICROSAR RTE" /begin SUB_GROUP SrlComInput.SystemState.Mode /end SUB_GROUP /begin FUNCTION_LIST /end FUNCTION_LIST /begin REF_CHARACTERISTIC /end REF_CHARACTERISTIC /begin REF_MEASUREMENT /end REF_MEASUREMENT /end GROUP
/begin GROUP SrlComInput.MultiModeVld.Cnt_lgc "MICROSAR RTE" /begin SUB_GROUP /end SUB_GROUP /begin FUNCTION_LIST /end FUNCTION_LIST /begin REF_CHARACTERISTIC /end REF_CHARACTERISTIC /end GROUP
/begin GROUP SrlComInput.MultimodeSelected.Cnt_lgc "MICROSAR RTE" /begin SUB_GROUP /end SUB_GROUP /begin FUNCTION_LIST /end FUNCTION_LIST /begin REF_CHARACTERISTIC /end REF_CHARACTERISTIC /end GROUP
/begin GROUP SrlComInput.PROTOHS1DYNUCF5CDMsgDLCError.Cnt_u08 "MICROSAR RTE" /begin SUB_GROUP /end SUB_GROUP /begin FUNCTION_LIST /end FUNCTION_LIST /begin REF_CHARACTERISTIC /end REF_CHARACTERISTIC /begin REF_MEASUREMENT Rte_SrlComDriver_PROTOHS1DYNUCF5CDMsgDLCError_Cnt_u08 /end REF_MEASUREMENT /end GROUP
/begin GROUP SrlComInput.PerInstanceMemories "MICROSAR RTE"
 /begin SUB_GROUP SrlComInput.ElecIntData SrlComInput.ShutdownTimeData SrlComInput.VVHTYPEData /end SUB_GROUP
 /begin FUNCTION_LIST /end FUNCTION_LIST
 /begin REF_CHARACTERISTIC /end REF_CHARACTERISTIC
 /begin REF_MEASUREMENT /end REF_MEASUREMENT
/end GROUP
/begin GROUP SrlComInput.PosSrvoHwAngle.HwDeg_f32 "MICROSAR RTE" /begin SUB_GROUP /end SUB_GROUP /begin FUNCTION_LIST /end FUNCTION_LIST /begin REF_CHARACTERISTIC /end REF_CHARACTERISTIC /end GROUP
/begin GROUP SrlComInput.PowerSupplies.Cnt_u08 "MICROSAR RTE" /begin SUB_GROUP /end SUB_GROUP /begin FUNCTION_LIST /end FUNCTION_LIST /begin REF_CHARACTERISTIC /end REF_CHARACTERISTIC /end GROUP
/begin GROUP SrlComInput.PowerSuppliesIn.Cnt_u08 "MICROSAR RTE" /begin SUB_GROUP /end SUB_GROUP /begin FUNCTION_LIST /end FUNCTION_LIST /begin REF_CHARACTERISTIC /end REF_CHARACTERISTIC /begin REF_MEASUREMENT Rte_SrlComDriver_PowerSupplies_Cnt_u08 /end REF_MEASUREMENT /end GROUP
/begin GROUP SrlComInput.ReceiverPorts "MICROSAR RTE"
 /begin SUB_GROUP SrlComInput.AccelLat.Cnt_s16 SrlComInput.AnneeEcoule.Cnt_u08 SrlComInput.Batt.Volt_f32 SrlComInput.BusOff.Cnt_lgc SrlComInput.CAVHCSelected.Cnt_lgc SrlComInput.CTermActive.Cnt_lgc SrlComInput.CityParkSelected.Cnt_lgc SrlComInput.ColumnAngleSetpoint.Cnt_u16 SrlComInput.CompteurTemporelVehicule.Cnt_u32 SrlComInput.ComputerRazGCT.Cnt_u08 SrlComInput.ConfigVhl.Cnt_u08 SrlComInput.DefaultVehSpd.Cnt_lgc SrlComInput.DiagIntegraElec.Cnt_u08 SrlComInput.DiagMuxOn.Cnt_u08 SrlComInput.DmdDelestDA.Cnt_u08 SrlComInput.ESCOffsCfgSeld.Cnt_lgc SrlComInput.ESPDeconnecte.Cnt_u08 SrlComInput.EffacDefaultDiag.Cnt_u08 SrlComInput.EtatMT.Cnt_u08 SrlComInput.EtatPrincipSevIn.Cnt_u08 SrlComInput.EtatReseauElecIn.Cnt_u08 SrlComInput.ISDAT4V2BSI552MsgDLCError.Cnt_u08 SrlComInput.ISDATABR50DMsgDLCError.Cnt_u08 SrlComInput.ISDATBSI3F2MsgDLCError.Cnt_u08 SrlComInput.ISDATBSI412MsgDLCError.Cnt_u08 SrlComInput.ISDATBSI432MsgDLCError.Cnt_u08 SrlComInput.ISDATBSI572MsgDLCError.Cnt_u08 SrlComInput.ISDATDIRAMsgTxInProgress.Cnt_lgc SrlComInput.ISDYN2CMMMsgDLCError.Cnt_u08 SrlComInput.ISDYN2FRE3CDMsgDLCError.Cnt_u08 SrlComInput.ISDYNAASMsgDLCError.Cnt_u08 SrlComInput.ISDYNABRMsgDLCError.Cnt_u08 SrlComInput.ISDYNCDS34DMsgDLCError.Cnt_u08 SrlComInput.ISDYNCMM208MsgDLCError.Cnt_u08 SrlComInput.ISDYNCMM388MsgDLCError.Cnt_u08 SrlComInput.ISDYNVOLMsgDLCError.Cnt_u08 SrlComInput.JourEcoule.Cnt_u16 SrlComInput.KilometrageIn.Cnt_u32 SrlComInput.LKAState.Cnt_u08 SrlComInput.LKATrqFactReq.Cnt_u08 SrlComInput.LXAActivation.Cnt_u08 SrlComInput.LXASelected.Cnt_lgc SrlComInput.ModeDiag.Cnt_u08 SrlComInput.MultimodeSelected.Cnt_lgc SrlComInput.PROTOHS1DYNUCF5CDMsgDLCError.Cnt_u08 SrlComInput.PowerSuppliesIn.Cnt_u08 SrlComInput.RegulAbr.Cnt_u08 SrlComInput.RegulEsp.Cnt_u08 SrlComInput.ReqLampeDefEsp.Cnt_u08 SrlComInput.ReqModeDA.Cnt_u08 SrlComInput.RxMsgsSrlComSvcDft.Cnt_lgc SrlComInput.STTdSelected.Cnt_lgc SrlComInput.SecondeEcoulee.Cnt_u32 SrlComInput.ShuntPositionIn.Cnt_u08 SrlComInput.VehicleSpeed.Kph_f32 SrlComInput.VitesseVehicleBV.Cnt_u16 /end SUB_GROUP
 /begin FUNCTION_LIST /end FUNCTION_LIST
 /begin REF_CHARACTERISTIC /end REF_CHARACTERISTIC
 /begin REF_MEASUREMENT /end REF_MEASUREMENT
/end GROUP
/begin GROUP SrlComInput.RegulAbr.Cnt_u08 "MICROSAR RTE" /begin SUB_GROUP /end SUB_GROUP /begin FUNCTION_LIST /end FUNCTION_LIST /begin REF_CHARACTERISTIC /end REF_CHARACTERISTIC /begin REF_MEASUREMENT Rte_SrlComDriver_RegulABR_Cnt_u08 /end REF_MEASUREMENT /end GROUP
/begin GROUP SrlComInput.RegulEsp.Cnt_u08 "MICROSAR RTE" /begin SUB_GROUP /end SUB_GROUP /begin FUNCTION_LIST /end FUNCTION_LIST /begin REF_CHARACTERISTIC /end REF_CHARACTERISTIC /begin REF_MEASUREMENT Rte_SrlComDriver_RegulESP_Cnt_u08 /end REF_MEASUREMENT /end GROUP
/begin GROUP SrlComInput.ReqLampeDefEsp.Cnt_u08 "MICROSAR RTE" /begin SUB_GROUP /end SUB_GROUP /begin FUNCTION_LIST /end FUNCTION_LIST /begin REF_CHARACTERISTIC /end REF_CHARACTERISTIC /begin REF_MEASUREMENT Rte_SrlComDriver_ReqLampeDefEsp_Cnt_u08 /end REF_MEASUREMENT /end GROUP
/begin GROUP SrlComInput.ReqModeDA.Cnt_u08 "MICROSAR RTE" /begin SUB_GROUP /end SUB_GROUP /begin FUNCTION_LIST /end FUNCTION_LIST /begin REF_CHARACTERISTIC /end REF_CHARACTERISTIC /begin REF_MEASUREMENT Rte_SrlComDriver_ReqModeDA_Cnt_u08 /end REF_MEASUREMENT /end GROUP
/begin GROUP SrlComInput.ReqModeDAFinal.Cnt_enum "MICROSAR RTE" /begin SUB_GROUP /end SUB_GROUP /begin FUNCTION_LIST /end FUNCTION_LIST /begin REF_CHARACTERISTIC /end REF_CHARACTERISTIC /end GROUP
/begin GROUP SrlComInput.RxMsgsSrlComSvcDft.Cnt_lgc "MICROSAR RTE" /begin SUB_GROUP /end SUB_GROUP /begin FUNCTION_LIST /end FUNCTION_LIST /begin REF_CHARACTERISTIC /end REF_CHARACTERISTIC /end GROUP
/begin GROUP SrlComInput.STTdSelected.Cnt_lgc "MICROSAR RTE" /begin SUB_GROUP /end SUB_GROUP /begin FUNCTION_LIST /end FUNCTION_LIST /begin REF_CHARACTERISTIC /end REF_CHARACTERISTIC /end GROUP
/begin GROUP SrlComInput.SecondeEcoulee.Cnt_u32 "MICROSAR RTE" /begin SUB_GROUP /end SUB_GROUP /begin FUNCTION_LIST /end FUNCTION_LIST /begin REF_CHARACTERISTIC /end REF_CHARACTERISTIC /begin REF_MEASUREMENT Rte_SrlComDriver_SecondeEcoulee_Cnt_u32 /end REF_MEASUREMENT /end GROUP
/begin GROUP SrlComInput.SenderPorts "MICROSAR RTE"
 /begin SUB_GROUP SrlComInput.APAAuthn.Cnt_lgc SrlComInput.APARequest.Cnt_lgc SrlComInput.AbsActv.Cnt_lgc SrlComInput.AngleVolant.HwDeg_f32 SrlComInput.ApaRelaxReq.Cnt_lgc SrlComInput.ApaVehicleSpeedValid.Cnt_lgc SrlComInput.BSIDataMissing.Cnt_lgc SrlComInput.CMMDataMissing.Cnt_lgc SrlComInput.CONSANGLECPK.Cnt_s16 SrlComInput.CPKOK.Cnt_lgc SrlComInput.ColAngleSetpoint.HwDeg_f32 SrlComInput.CompteurTemporelVehiculeRaw.Cnt_u32 SrlComInput.ComputerRazGCTRaw.Cnt_u08 SrlComInput.DMDFCTCPK.Cnt_u08 SrlComInput.DmdDelestDaSts.Cnt_u08 SrlComInput.DmdDelestDaVld.Cnt_lgc SrlComInput.ElectronicIntegration.Cnt_lgc SrlComInput.EngOn.Cnt_lgc SrlComInput.EscAckFromSerlCom.Cnt_lgc SrlComInput.EscActv.Cnt_lgc SrlComInput.EscDataVldFromSerlCom.Cnt_lgc SrlComInput.EscEna.Cnt_lgc SrlComInput.EscFltPrsnt.Cnt_lgc SrlComInput.EscOffsFromSerlCom.HwDeg_f32 SrlComInput.EscPrecisionFromSerlCom.HwDeg_f32 SrlComInput.EtatMTRaw.Cnt_u08 SrlComInput.EtatPrincipSev.Cnt_u08 SrlComInput.EtatReseauElec.Cnt_u08 SrlComInput.IgnTimeOff.Cnt_u32 SrlComInput.Kilometrage.Cnt_u32 SrlComInput.LxaInpVld.Cnt_lgc SrlComInput.LxaSeln.Cnt_lgc SrlComInput.LxaStateFilt.Cnt_enum SrlComInput.LxaTqFacReq.Uls_f32 SrlComInput.MultiModeVld.Cnt_lgc SrlComInput.PosSrvoHwAngle.HwDeg_f32 SrlComInput.PowerSupplies.Cnt_u08 SrlComInput.ReqModeDAFinal.Cnt_enum SrlComInput.SerialComAngleValid.Cnt_lgc SrlComInput.ShuntPosition.Cnt_u08 SrlComInput.SrlComVehSpd.Kph_f32 SrlComInput.VVHType.Cnt_u08 SrlComInput.ValidEngineStatus.Cnt_lgc SrlComInput.VehTimeValid.Cnt_lgc SrlComInput.VehicleLatAccel.MpSecSq_f32 SrlComInput.VehicleLatAccelValid.Cnt_lgc SrlComInput.VehicleSpeedValid.Cnt_lgc /end SUB_GROUP
 /begin FUNCTION_LIST /end FUNCTION_LIST
 /begin REF_CHARACTERISTIC /end REF_CHARACTERISTIC
 /begin REF_MEASUREMENT /end REF_MEASUREMENT
/end GROUP
/begin GROUP SrlComInput.SerialComAngleValid.Cnt_lgc "MICROSAR RTE" /begin SUB_GROUP /end SUB_GROUP /begin FUNCTION_LIST /end FUNCTION_LIST /begin REF_CHARACTERISTIC /end REF_CHARACTERISTIC /begin REF_MEASUREMENT Rte_SrlComInput_SerialComAngleValid_Cnt_lgc /end REF_MEASUREMENT /end GROUP
/begin GROUP SrlComInput.ShuntPosition.Cnt_u08 "MICROSAR RTE" /begin SUB_GROUP /end SUB_GROUP /begin FUNCTION_LIST /end FUNCTION_LIST /begin REF_CHARACTERISTIC /end REF_CHARACTERISTIC /end GROUP
/begin GROUP SrlComInput.ShuntPositionIn.Cnt_u08 "MICROSAR RTE" /begin SUB_GROUP /end SUB_GROUP /begin FUNCTION_LIST /end FUNCTION_LIST /begin REF_CHARACTERISTIC /end REF_CHARACTERISTIC /begin REF_MEASUREMENT Rte_SrlComDriver_ShuntPosition_Cnt_u08 /end REF_MEASUREMENT /end GROUP
/begin GROUP SrlComInput.ShutdownTimeData "MICROSAR RTE" /begin SUB_GROUP /end SUB_GROUP /begin FUNCTION_LIST /end FUNCTION_LIST /begin REF_CHARACTERISTIC /end REF_CHARACTERISTIC
 /begin REF_MEASUREMENT Rte_SrlComInput_ShutdownTimeData.Time_Sec_u32 Rte_SrlComInput_ShutdownTimeData.Valid_Cnt_lgc /end REF_MEASUREMENT
/end GROUP
/begin GROUP SrlComInput.SrlComVehSpd.Kph_f32 "MICROSAR RTE" /begin SUB_GROUP /end SUB_GROUP /begin FUNCTION_LIST /end FUNCTION_LIST /begin REF_CHARACTERISTIC /end REF_CHARACTERISTIC /end GROUP
/begin GROUP SrlComInput.SystemState.Mode "MICROSAR RTE" /begin SUB_GROUP /end SUB_GROUP /begin FUNCTION_LIST /end FUNCTION_LIST /begin REF_CHARACTERISTIC /end REF_CHARACTERISTIC /end GROUP
/begin GROUP SrlComInput.VVHTYPEData "MICROSAR RTE" /begin SUB_GROUP /end SUB_GROUP /begin FUNCTION_LIST /end FUNCTION_LIST /begin REF_CHARACTERISTIC /end REF_CHARACTERISTIC /begin REF_MEASUREMENT Rte_SrlComInput_VVHTYPEData /end REF_MEASUREMENT /end GROUP
/begin GROUP SrlComInput.VVHType.Cnt_u08 "MICROSAR RTE" /begin SUB_GROUP /end SUB_GROUP /begin FUNCTION_LIST /end FUNCTION_LIST /begin REF_CHARACTERISTIC /end REF_CHARACTERISTIC /begin REF_MEASUREMENT Rte_SrlComInput_VVHType_Cnt_u08 /end REF_MEASUREMENT /end GROUP
/begin GROUP SrlComInput.ValidEngineStatus.Cnt_lgc "MICROSAR RTE" /begin SUB_GROUP /end SUB_GROUP /begin FUNCTION_LIST /end FUNCTION_LIST /begin REF_CHARACTERISTIC /end REF_CHARACTERISTIC /end GROUP
/begin GROUP SrlComInput.VehTimeValid.Cnt_lgc "MICROSAR RTE" /begin SUB_GROUP /end SUB_GROUP /begin FUNCTION_LIST /end FUNCTION_LIST /begin REF_CHARACTERISTIC /end REF_CHARACTERISTIC /begin REF_MEASUREMENT Rte_SrlComInput_VehTimeValid_Cnt_lgc /end REF_MEASUREMENT /end GROUP
/begin GROUP SrlComInput.VehicleLatAccel.MpSecSq_f32 "MICROSAR RTE" /begin SUB_GROUP /end SUB_GROUP /begin FUNCTION_LIST /end FUNCTION_LIST /begin REF_CHARACTERISTIC /end REF_CHARACTERISTIC /end GROUP
/begin GROUP SrlComInput.VehicleLatAccelValid.Cnt_lgc "MICROSAR RTE" /begin SUB_GROUP /end SUB_GROUP /begin FUNCTION_LIST /end FUNCTION_LIST /begin REF_CHARACTERISTIC /end REF_CHARACTERISTIC /begin REF_MEASUREMENT Rte_SrlComInput_VehicleLatAccelValid_Cnt_lgc /end REF_MEASUREMENT /end GROUP
/begin GROUP SrlComInput.VehicleSpeed.Kph_f32 "MICROSAR RTE" /begin SUB_GROUP /end SUB_GROUP /begin FUNCTION_LIST /end FUNCTION_LIST /begin REF_CHARACTERISTIC /end REF_CHARACTERISTIC /end GROUP
/begin GROUP SrlComInput.VehicleSpeedValid.Cnt_lgc "MICROSAR RTE" /begin SUB_GROUP /end SUB_GROUP /begin FUNCTION_LIST /end FUNCTION_LIST /begin REF_CHARACTERISTIC /end REF_CHARACTERISTIC /end GROUP
/begin GROUP SrlComInput.VitesseVehicleBV.Cnt_u16 "MICROSAR RTE" /begin SUB_GROUP /end SUB_GROUP /begin FUNCTION_LIST /end FUNCTION_LIST /begin REF_CHARACTERISTIC /end REF_CHARACTERISTIC /begin REF_MEASUREMENT Rte_SrlComDriver_VitesseVehicleBV_Cnt_u16 /end REF_MEASUREMENT /end GROUP
/begin GROUP SrlComOutput "MICROSAR RTE"
 /begin SUB_GROUP SrlComOutput.ModeRequirePorts SrlComOutput.PerInstanceMemories SrlComOutput.ReceiverPorts /end SUB_GROUP
 /begin FUNCTION_LIST /end FUNCTION_LIST
 /begin REF_CHARACTERISTIC /end REF_CHARACTERISTIC
 /begin REF_MEASUREMENT /end REF_MEASUREMENT
/end GROUP
/begin GROUP SrlComOutput.APAState.Cnt_enum "MICROSAR RTE" /begin SUB_GROUP /end SUB_GROUP /begin FUNCTION_LIST /end FUNCTION_LIST /begin REF_CHARACTERISTIC /end REF_CHARACTERISTIC /end GROUP
/begin GROUP SrlComOutput.APAStateTransitionCause.Cnt_enum "MICROSAR RTE" /begin SUB_GROUP /end SUB_GROUP /begin FUNCTION_LIST /end FUNCTION_LIST /begin REF_CHARACTERISTIC /end REF_CHARACTERISTIC /end GROUP
/begin GROUP SrlComOutput.AVASelected.Cnt_lgc "MICROSAR RTE" /begin SUB_GROUP /end SUB_GROUP /begin FUNCTION_LIST /end FUNCTION_LIST /begin REF_CHARACTERISTIC /end REF_CHARACTERISTIC /end GROUP
/begin GROUP SrlComOutput.AbsltHwPosn.HwDeg_f32 "MICROSAR RTE" /begin SUB_GROUP /end SUB_GROUP /begin FUNCTION_LIST /end FUNCTION_LIST /begin REF_CHARACTERISTIC /end REF_CHARACTERISTIC /end GROUP
/begin GROUP SrlComOutput.AbsltHwPosnLvl1.Cnt_lgc "MICROSAR RTE" /begin SUB_GROUP /end SUB_GROUP /begin FUNCTION_LIST /end FUNCTION_LIST /begin REF_CHARACTERISTIC /end REF_CHARACTERISTIC /end GROUP
/begin GROUP SrlComOutput.AbsltHwPosnLvl2.Cnt_lgc "MICROSAR RTE" /begin SUB_GROUP /end SUB_GROUP /begin FUNCTION_LIST /end FUNCTION_LIST /begin REF_CHARACTERISTIC /end REF_CHARACTERISTIC /end GROUP
/begin GROUP SrlComOutput.AbsltHwPosnVld.Cnt_lgc "MICROSAR RTE" /begin SUB_GROUP /end SUB_GROUP /begin FUNCTION_LIST /end FUNCTION_LIST /begin REF_CHARACTERISTIC /end REF_CHARACTERISTIC /end GROUP
/begin GROUP SrlComOutput.AgArbnStToSerlCom.Cnt_enum "MICROSAR RTE" /begin SUB_GROUP /end SUB_GROUP /begin FUNCTION_LIST /end FUNCTION_LIST /begin REF_CHARACTERISTIC /end REF_CHARACTERISTIC /end GROUP
/begin GROUP SrlComOutput.CAVHCSelected.Cnt_lgc "MICROSAR RTE" /begin SUB_GROUP /end SUB_GROUP /begin FUNCTION_LIST /end FUNCTION_LIST /begin REF_CHARACTERISTIC /end REF_CHARACTERISTIC /end GROUP
/begin GROUP SrlComOutput.CTCFailed.Cnt_lgc "MICROSAR RTE" /begin SUB_GROUP /end SUB_GROUP /begin FUNCTION_LIST /end FUNCTION_LIST /begin REF_CHARACTERISTIC /end REF_CHARACTERISTIC /end GROUP
/begin GROUP SrlComOutput.CityParkSelected.Cnt_lgc "MICROSAR RTE" /begin SUB_GROUP /end SUB_GROUP /begin FUNCTION_LIST /end FUNCTION_LIST /begin REF_CHARACTERISTIC /end REF_CHARACTERISTIC /end GROUP
/begin GROUP SrlComOutput.DefaultHwaSCommExportValue.Cnt_lgc "MICROSAR RTE" /begin SUB_GROUP /end SUB_GROUP /begin FUNCTION_LIST /end FUNCTION_LIST /begin REF_CHARACTERISTIC /end REF_CHARACTERISTIC /end GROUP
/begin GROUP SrlComOutput.DmdDelestDaVld.Cnt_lgc "MICROSAR RTE" /begin SUB_GROUP /end SUB_GROUP /begin FUNCTION_LIST /end FUNCTION_LIST /begin REF_CHARACTERISTIC /end REF_CHARACTERISTIC /begin REF_MEASUREMENT Rte_SrlComInput_DmdDelestDaVld_Cnt_lgc /end REF_MEASUREMENT /end GROUP
/begin GROUP SrlComOutput.DrvrIntvDetd.Cnt_lgc "MICROSAR RTE" /begin SUB_GROUP /end SUB_GROUP /begin FUNCTION_LIST /end FUNCTION_LIST /begin REF_CHARACTERISTIC /end REF_CHARACTERISTIC /end GROUP
/begin GROUP SrlComOutput.EPSStateForLxa.Cnt_enum "MICROSAR RTE" /begin SUB_GROUP /end SUB_GROUP /begin FUNCTION_LIST /end FUNCTION_LIST /begin REF_CHARACTERISTIC /end REF_CHARACTERISTIC /end GROUP
/begin GROUP SrlComOutput.ESCOffsCfgSeld.Cnt_lgc "MICROSAR RTE" /begin SUB_GROUP /end SUB_GROUP /begin FUNCTION_LIST /end FUNCTION_LIST /begin REF_CHARACTERISTIC /end REF_CHARACTERISTIC /end GROUP
/begin GROUP SrlComOutput.ETATDADYN.Cnt_enum "MICROSAR RTE" /begin SUB_GROUP /end SUB_GROUP /begin FUNCTION_LIST /end FUNCTION_LIST /begin REF_CHARACTERISTIC /end REF_CHARACTERISTIC /end GROUP
/begin GROUP SrlComOutput.EtatMT.Cnt_u08 "MICROSAR RTE" /begin SUB_GROUP /end SUB_GROUP /begin FUNCTION_LIST /end FUNCTION_LIST /begin REF_CHARACTERISTIC /end REF_CHARACTERISTIC /end GROUP
/begin GROUP SrlComOutput.HandwheelAuthority.Uls_f32 "MICROSAR RTE" /begin SUB_GROUP /end SUB_GROUP /begin FUNCTION_LIST /end FUNCTION_LIST /begin REF_CHARACTERISTIC /end REF_CHARACTERISTIC /end GROUP
/begin GROUP SrlComOutput.HandwheelPosition.HwDeg_f32 "MICROSAR RTE" /begin SUB_GROUP /end SUB_GROUP /begin FUNCTION_LIST /end FUNCTION_LIST /begin REF_CHARACTERISTIC /end REF_CHARACTERISTIC /end GROUP
/begin GROUP SrlComOutput.HandwheelTorque.HwNm_f32 "MICROSAR RTE" /begin SUB_GROUP /end SUB_GROUP /begin FUNCTION_LIST /end FUNCTION_LIST /begin REF_CHARACTERISTIC /end REF_CHARACTERISTIC /end GROUP
/begin GROUP SrlComOutput.HandwheelVelocity.HwRadpS_f32 "MICROSAR RTE" /begin SUB_GROUP /end SUB_GROUP /begin FUNCTION_LIST /end FUNCTION_LIST /begin REF_CHARACTERISTIC /end REF_CHARACTERISTIC /end GROUP
/begin GROUP SrlComOutput.LXASelected.Cnt_lgc "MICROSAR RTE" /begin SUB_GROUP /end SUB_GROUP /begin FUNCTION_LIST /end FUNCTION_LIST /begin REF_CHARACTERISTIC /end REF_CHARACTERISTIC /end GROUP
/begin GROUP SrlComOutput.LxaTqLimnActv.Cnt_lgc "MICROSAR RTE" /begin SUB_GROUP /end SUB_GROUP /begin FUNCTION_LIST /end FUNCTION_LIST /begin REF_CHARACTERISTIC /end REF_CHARACTERISTIC /end GROUP
/begin GROUP SrlComOutput.ModeRequirePorts "MICROSAR RTE" /begin SUB_GROUP SrlComOutput.SystemState.Mode /end SUB_GROUP /begin FUNCTION_LIST /end FUNCTION_LIST /begin REF_CHARACTERISTIC /end REF_CHARACTERISTIC /begin REF_MEASUREMENT /end REF_MEASUREMENT /end GROUP
/begin GROUP SrlComOutput.OutputRampMult.Uls_f32 "MICROSAR RTE" /begin SUB_GROUP /end SUB_GROUP /begin FUNCTION_LIST /end FUNCTION_LIST /begin REF_CHARACTERISTIC /end REF_CHARACTERISTIC /end GROUP
/begin GROUP SrlComOutput.PerInstanceMemories "MICROSAR RTE"
 /begin SUB_GROUP SrlComOutput.PimIsDatDiraMsg SrlComOutput.PimIsDynDaeMsg SrlComOutput.PimIsDynVolAddMsg SrlComOutput.PimIsDynVolBaseMsg SrlComOutput.PimIsSupvDiraMsg /end SUB_GROUP
 /begin FUNCTION_LIST /end FUNCTION_LIST
 /begin REF_CHARACTERISTIC /end REF_CHARACTERISTIC
 /begin REF_MEASUREMENT /end REF_MEASUREMENT
/end GROUP
/begin GROUP SrlComOutput.PimIsDatDiraMsg "MICROSAR RTE" /begin SUB_GROUP /end SUB_GROUP /begin FUNCTION_LIST /end FUNCTION_LIST /begin REF_CHARACTERISTIC /end REF_CHARACTERISTIC
 /begin REF_MEASUREMENT Rte_SrlComOutput_PimIsDatDiraMsg.AutorArretMotDa Rte_SrlComOutput_PimIsDatDiraMsg.CpleVolant Rte_SrlComOutput_PimIsDatDiraMsg.DdeRedemDa Rte_SrlComOutput_PimIsDatDiraMsg.EpsStateLka Rte_SrlComOutput_PimIsDatDiraMsg.EtatDa2004 Rte_SrlComOutput_PimIsDatDiraMsg.EtatDa2010 Rte_SrlComOutput_PimIsDatDiraMsg.EtatDaDyn Rte_SrlComOutput_PimIsDatDiraMsg.SteerwhlHoldByDrv Rte_SrlComOutput_PimIsDatDiraMsg.TrqLimitState /end REF_MEASUREMENT
/end GROUP
/begin GROUP SrlComOutput.PimIsDynDaeMsg "MICROSAR RTE" /begin SUB_GROUP /end SUB_GROUP /begin FUNCTION_LIST /end FUNCTION_LIST /begin REF_CHARACTERISTIC /end REF_CHARACTERISTIC
 /begin REF_MEASUREMENT Rte_SrlComOutput_PimIsDynDaeMsg.AngleColonne Rte_SrlComOutput_PimIsDynDaeMsg.CauseDesactivCpk Rte_SrlComOutput_PimIsDynDaeMsg.ChksumTrmeDynDae Rte_SrlComOutput_PimIsDynDaeMsg.CpleVolantOptimse Rte_SrlComOutput_PimIsDynDaeMsg.CptProcess4bDae Rte_SrlComOutput_PimIsDynDaeMsg.EtatDaeCav3Virtuel Rte_SrlComOutput_PimIsDynDaeMsg.EtatDaeCpk Rte_SrlComOutput_PimIsDynDaeMsg.EtatSecuAngleCol Rte_SrlComOutput_PimIsDynDaeMsg.VitesseColonne /end REF_MEASUREMENT
/end GROUP
/begin GROUP SrlComOutput.PimIsDynVolAddMsg "MICROSAR RTE" /begin SUB_GROUP /end SUB_GROUP /begin FUNCTION_LIST /end FUNCTION_LIST /begin REF_CHARACTERISTIC /end REF_CHARACTERISTIC
 /begin REF_MEASUREMENT Rte_SrlComOutput_PimIsDynVolAddMsg.AngleVolantOrigine Rte_SrlComOutput_PimIsDynVolAddMsg.CalibrationVol Rte_SrlComOutput_PimIsDynVolAddMsg.CodeDefaultVol Rte_SrlComOutput_PimIsDynVolAddMsg.EtatCaptVol Rte_SrlComOutput_PimIsDynVolAddMsg.FlgAvolIcn Rte_SrlComOutput_PimIsDynVolAddMsg.FlgInitAvol Rte_SrlComOutput_PimIsDynVolAddMsg.TrimVol Rte_SrlComOutput_PimIsDynVolAddMsg.VitesseRotVolOptimise /end REF_MEASUREMENT
/end GROUP
/begin GROUP SrlComOutput.PimIsDynVolBaseMsg "MICROSAR RTE" /begin SUB_GROUP /end SUB_GROUP /begin FUNCTION_LIST /end FUNCTION_LIST /begin REF_CHARACTERISTIC /end REF_CHARACTERISTIC
 /begin REF_MEASUREMENT Rte_SrlComOutput_PimIsDynVolBaseMsg.AngleVolant Rte_SrlComOutput_PimIsDynVolBaseMsg.ChksumVol Rte_SrlComOutput_PimIsDynVolBaseMsg.CptProcess4bAVol Rte_SrlComOutput_PimIsDynVolBaseMsg.SensRotVol Rte_SrlComOutput_PimIsDynVolBaseMsg.VitesseRotVol /end REF_MEASUREMENT
/end GROUP
/begin GROUP SrlComOutput.PimIsSupvDiraMsg "MICROSAR RTE" /begin SUB_GROUP /end SUB_GROUP /begin FUNCTION_LIST /end FUNCTION_LIST /begin REF_CHARACTERISTIC /end REF_CHARACTERISTIC
 /begin REF_MEASUREMENT Rte_SrlComOutput_PimIsSupvDiraMsg.CodeDefaut Rte_SrlComOutput_PimIsSupvDiraMsg.EtatAssistDa Rte_SrlComOutput_PimIsSupvDiraMsg.EtatLigneApc Rte_SrlComOutput_PimIsSupvDiraMsg.StatusConfabsent /end REF_MEASUREMENT
/end GROUP
/begin GROUP SrlComOutput.RampDwnStatusComplete.Cnt_lgc "MICROSAR RTE" /begin SUB_GROUP /end SUB_GROUP /begin FUNCTION_LIST /end FUNCTION_LIST /begin REF_CHARACTERISTIC /end REF_CHARACTERISTIC /begin REF_MEASUREMENT Rte_StOpCtrl_SysStReqDi_Cnt_lgc /end REF_MEASUREMENT /end GROUP
/begin GROUP SrlComOutput.ReceiverPorts "MICROSAR RTE"
 /begin SUB_GROUP SrlComOutput.APAState.Cnt_enum SrlComOutput.APAStateTransitionCause.Cnt_enum SrlComOutput.AVASelected.Cnt_lgc SrlComOutput.AbsltHwPosn.HwDeg_f32 SrlComOutput.AbsltHwPosnLvl1.Cnt_lgc SrlComOutput.AbsltHwPosnLvl2.Cnt_lgc SrlComOutput.AbsltHwPosnVld.Cnt_lgc SrlComOutput.AgArbnStToSerlCom.Cnt_enum SrlComOutput.CAVHCSelected.Cnt_lgc SrlComOutput.CTCFailed.Cnt_lgc SrlComOutput.CityParkSelected.Cnt_lgc SrlComOutput.DefaultHwaSCommExportValue.Cnt_lgc SrlComOutput.DmdDelestDaVld.Cnt_lgc SrlComOutput.DrvrIntvDetd.Cnt_lgc SrlComOutput.EPSStateForLxa.Cnt_enum SrlComOutput.ESCOffsCfgSeld.Cnt_lgc SrlComOutput.ETATDADYN.Cnt_enum SrlComOutput.EtatMT.Cnt_u08 SrlComOutput.HandwheelAuthority.Uls_f32 SrlComOutput.HandwheelPosition.HwDeg_f32 SrlComOutput.HandwheelTorque.HwNm_f32 SrlComOutput.HandwheelVelocity.HwRadpS_f32 SrlComOutput.LXASelected.Cnt_lgc SrlComOutput.LxaTqLimnActv.Cnt_lgc SrlComOutput.OutputRampMult.Uls_f32 SrlComOutput.RampDwnStatusComplete.Cnt_lgc SrlComOutput.RelHwPosnToSerlCom.HwDeg_f32 SrlComOutput.RelHwPosnVldToSerlCom.Cnt_lgc SrlComOutput.STTdSelected.Cnt_lgc SrlComOutput.SrlComHwTrq.HwNm_f32 SrlComOutput.TxEnabled.Cnt_lgc SrlComOutput.ValidEngineStatus.Cnt_lgc SrlComOutput.VehicleSpeed.Kph_f32 SrlComOutput.VehicleSpeedValid.Cnt_lgc /end SUB_GROUP
 /begin FUNCTION_LIST /end FUNCTION_LIST
 /begin REF_CHARACTERISTIC /end REF_CHARACTERISTIC
 /begin REF_MEASUREMENT /end REF_MEASUREMENT
/end GROUP
/begin GROUP SrlComOutput.RelHwPosnToSerlCom.HwDeg_f32 "MICROSAR RTE" /begin SUB_GROUP /end SUB_GROUP /begin FUNCTION_LIST /end FUNCTION_LIST /begin REF_CHARACTERISTIC /end REF_CHARACTERISTIC /end GROUP
/begin GROUP SrlComOutput.RelHwPosnVldToSerlCom.Cnt_lgc "MICROSAR RTE" /begin SUB_GROUP /end SUB_GROUP /begin FUNCTION_LIST /end FUNCTION_LIST /begin REF_CHARACTERISTIC /end REF_CHARACTERISTIC /end GROUP
/begin GROUP SrlComOutput.STTdSelected.Cnt_lgc "MICROSAR RTE" /begin SUB_GROUP /end SUB_GROUP /begin FUNCTION_LIST /end FUNCTION_LIST /begin REF_CHARACTERISTIC /end REF_CHARACTERISTIC /end GROUP
/begin GROUP SrlComOutput.SrlComHwTrq.HwNm_f32 "MICROSAR RTE" /begin SUB_GROUP /end SUB_GROUP /begin FUNCTION_LIST /end FUNCTION_LIST /begin REF_CHARACTERISTIC /end REF_CHARACTERISTIC /end GROUP
/begin GROUP SrlComOutput.SystemState.Mode "MICROSAR RTE" /begin SUB_GROUP /end SUB_GROUP /begin FUNCTION_LIST /end FUNCTION_LIST /begin REF_CHARACTERISTIC /end REF_CHARACTERISTIC /end GROUP
/begin GROUP SrlComOutput.TxEnabled.Cnt_lgc "MICROSAR RTE" /begin SUB_GROUP /end SUB_GROUP /begin FUNCTION_LIST /end FUNCTION_LIST /begin REF_CHARACTERISTIC /end REF_CHARACTERISTIC /end GROUP
/begin GROUP SrlComOutput.ValidEngineStatus.Cnt_lgc "MICROSAR RTE" /begin SUB_GROUP /end SUB_GROUP /begin FUNCTION_LIST /end FUNCTION_LIST /begin REF_CHARACTERISTIC /end REF_CHARACTERISTIC /end GROUP
/begin GROUP SrlComOutput.VehicleSpeed.Kph_f32 "MICROSAR RTE" /begin SUB_GROUP /end SUB_GROUP /begin FUNCTION_LIST /end FUNCTION_LIST /begin REF_CHARACTERISTIC /end REF_CHARACTERISTIC /end GROUP
/begin GROUP SrlComOutput.VehicleSpeedValid.Cnt_lgc "MICROSAR RTE" /begin SUB_GROUP /end SUB_GROUP /begin FUNCTION_LIST /end FUNCTION_LIST /begin REF_CHARACTERISTIC /end REF_CHARACTERISTIC /end GROUP
/begin GROUP StOpCtrl "MICROSAR RTE" /begin SUB_GROUP StOpCtrl.ReceiverPorts StOpCtrl.SenderPorts /end SUB_GROUP /begin FUNCTION_LIST /end FUNCTION_LIST /begin REF_CHARACTERISTIC /end REF_CHARACTERISTIC /begin REF_MEASUREMENT /end REF_MEASUREMENT /end GROUP
/begin GROUP StOpCtrl.DiagRampRate.XpmS_f32 "MICROSAR RTE" /begin SUB_GROUP /end SUB_GROUP /begin FUNCTION_LIST /end FUNCTION_LIST /begin REF_CHARACTERISTIC /end REF_CHARACTERISTIC /end GROUP
/begin GROUP StOpCtrl.DiagRampValue.Uls_f32 "MICROSAR RTE" /begin SUB_GROUP /end SUB_GROUP /begin FUNCTION_LIST /end FUNCTION_LIST /begin REF_CHARACTERISTIC /end REF_CHARACTERISTIC /end GROUP
/begin GROUP StOpCtrl.DiagStsDiagRmpActive.Cnt_lgc "MICROSAR RTE" /begin SUB_GROUP /end SUB_GROUP /begin FUNCTION_LIST /end FUNCTION_LIST /begin REF_CHARACTERISTIC /end REF_CHARACTERISTIC /end GROUP
/begin GROUP StOpCtrl.LoaRateLimit.UlspS_f32 "MICROSAR RTE" /begin SUB_GROUP /end SUB_GROUP /begin FUNCTION_LIST /end FUNCTION_LIST /begin REF_CHARACTERISTIC /end REF_CHARACTERISTIC /end GROUP
/begin GROUP StOpCtrl.LoaScaleFctr.Uls_f32 "MICROSAR RTE" /begin SUB_GROUP /end SUB_GROUP /begin FUNCTION_LIST /end FUNCTION_LIST /begin REF_CHARACTERISTIC /end REF_CHARACTERISTIC /end GROUP
/begin GROUP StOpCtrl.OperRampRate.XpmS_f32 "MICROSAR RTE" /begin SUB_GROUP /end SUB_GROUP /begin FUNCTION_LIST /end FUNCTION_LIST /begin REF_CHARACTERISTIC /end REF_CHARACTERISTIC /begin REF_MEASUREMENT Rte_VehPwrMd_OperRampRate_XpmS_f32 /end REF_MEASUREMENT /end GROUP
/begin GROUP StOpCtrl.OperRampValue.Uls_f32 "MICROSAR RTE" /begin SUB_GROUP /end SUB_GROUP /begin FUNCTION_LIST /end FUNCTION_LIST /begin REF_CHARACTERISTIC /end REF_CHARACTERISTIC /begin REF_MEASUREMENT Rte_VehPwrMd_OperRampValue_Uls_f32 /end REF_MEASUREMENT /end GROUP
/begin GROUP StOpCtrl.OutputRampMult.Uls_f32 "MICROSAR RTE" /begin SUB_GROUP /end SUB_GROUP /begin FUNCTION_LIST /end FUNCTION_LIST /begin REF_CHARACTERISTIC /end REF_CHARACTERISTIC /end GROUP
/begin GROUP StOpCtrl.RampSrlComSvcDft.Cnt_lgc "MICROSAR RTE" /begin SUB_GROUP /end SUB_GROUP /begin FUNCTION_LIST /end FUNCTION_LIST /begin REF_CHARACTERISTIC /end REF_CHARACTERISTIC /end GROUP
/begin GROUP StOpCtrl.ReceiverPorts "MICROSAR RTE"
 /begin SUB_GROUP StOpCtrl.DiagRampRate.XpmS_f32 StOpCtrl.DiagRampValue.Uls_f32 StOpCtrl.DiagStsDiagRmpActive.Cnt_lgc StOpCtrl.LoaRateLimit.UlspS_f32 StOpCtrl.LoaScaleFctr.Uls_f32 StOpCtrl.OperRampRate.XpmS_f32 StOpCtrl.OperRampValue.Uls_f32 StOpCtrl.RampSrlComSvcDft.Cnt_lgc StOpCtrl.StrtStopRateLimit.UlspS_f32 StOpCtrl.StrtStopScaleFctr.Uls_f32 /end SUB_GROUP
 /begin FUNCTION_LIST /end FUNCTION_LIST
 /begin REF_CHARACTERISTIC /end REF_CHARACTERISTIC
 /begin REF_MEASUREMENT /end REF_MEASUREMENT
/end GROUP
/begin GROUP StOpCtrl.SenderPorts "MICROSAR RTE"
 /begin SUB_GROUP StOpCtrl.OutputRampMult.Uls_f32 StOpCtrl.SysStReqDi.Cnt_lgc /end SUB_GROUP
 /begin FUNCTION_LIST /end FUNCTION_LIST
 /begin REF_CHARACTERISTIC /end REF_CHARACTERISTIC
 /begin REF_MEASUREMENT /end REF_MEASUREMENT
/end GROUP
/begin GROUP StOpCtrl.StrtStopRateLimit.UlspS_f32 "MICROSAR RTE" /begin SUB_GROUP /end SUB_GROUP /begin FUNCTION_LIST /end FUNCTION_LIST /begin REF_CHARACTERISTIC /end REF_CHARACTERISTIC /begin REF_MEASUREMENT Rte_StOpCtrl_StrtStopRateLimit_UlspS_f32 /end REF_MEASUREMENT /end GROUP
/begin GROUP StOpCtrl.StrtStopScaleFctr.Uls_f32 "MICROSAR RTE" /begin SUB_GROUP /end SUB_GROUP /begin FUNCTION_LIST /end FUNCTION_LIST /begin REF_CHARACTERISTIC /end REF_CHARACTERISTIC /begin REF_MEASUREMENT Rte_StOpCtrl_StrtStopScaleFctr_Uls_f32 /end REF_MEASUREMENT /end GROUP
/begin GROUP StOpCtrl.SysStReqDi.Cnt_lgc "MICROSAR RTE" /begin SUB_GROUP /end SUB_GROUP /begin FUNCTION_LIST /end FUNCTION_LIST /begin REF_CHARACTERISTIC /end REF_CHARACTERISTIC /begin REF_MEASUREMENT Rte_StOpCtrl_SysStReqDi_Cnt_lgc /end REF_MEASUREMENT /end GROUP
/begin GROUP StaMd "MICROSAR RTE"
 /begin SUB_GROUP StaMd.ModeProvidePorts StaMd.ModeRequirePorts StaMd.ReceiverPorts StaMd.SenderPorts /end SUB_GROUP
 /begin FUNCTION_LIST /end FUNCTION_LIST
 /begin REF_CHARACTERISTIC /end REF_CHARACTERISTIC
 /begin REF_MEASUREMENT /end REF_MEASUREMENT
/end GROUP
/begin GROUP StaMd.ATerm.Cnt_lgc "MICROSAR RTE" /begin SUB_GROUP /end SUB_GROUP /begin FUNCTION_LIST /end FUNCTION_LIST /begin REF_CHARACTERISTIC /end REF_CHARACTERISTIC /begin REF_MEASUREMENT Rte_VehPwrMd_ATermActive_Cnt_lgc /end REF_MEASUREMENT /end GROUP
/begin GROUP StaMd.CTerm.Cnt_lgc "MICROSAR RTE" /begin SUB_GROUP /end SUB_GROUP /begin FUNCTION_LIST /end FUNCTION_LIST /begin REF_CHARACTERISTIC /end REF_CHARACTERISTIC /end GROUP
/begin GROUP StaMd.ControlledDampStatusComplete.Cnt_lgc "MICROSAR RTE" /begin SUB_GROUP /end SUB_GROUP /begin FUNCTION_LIST /end FUNCTION_LIST /begin REF_CHARACTERISTIC /end REF_CHARACTERISTIC /begin REF_MEASUREMENT Rte_TranlDampg_CntrlDampComp_Cnt_lgc /end REF_MEASUREMENT /end GROUP
/begin GROUP StaMd.CurrentSystemState.Mode "MICROSAR RTE" /begin SUB_GROUP /end SUB_GROUP /begin FUNCTION_LIST /end FUNCTION_LIST /begin REF_CHARACTERISTIC /end REF_CHARACTERISTIC /end GROUP
/begin GROUP StaMd.FTerm.Cnt_lgc "MICROSAR RTE" /begin SUB_GROUP /end SUB_GROUP /begin FUNCTION_LIST /end FUNCTION_LIST /begin REF_CHARACTERISTIC /end REF_CHARACTERISTIC /end GROUP
/begin GROUP StaMd.ModeProvidePorts "MICROSAR RTE" /begin SUB_GROUP StaMd.SystemState.Mode /end SUB_GROUP /begin FUNCTION_LIST /end FUNCTION_LIST /begin REF_CHARACTERISTIC /end REF_CHARACTERISTIC /begin REF_MEASUREMENT /end REF_MEASUREMENT /end GROUP
/begin GROUP StaMd.ModeRequirePorts "MICROSAR RTE" /begin SUB_GROUP StaMd.CurrentSystemState.Mode /end SUB_GROUP /begin FUNCTION_LIST /end FUNCTION_LIST /begin REF_CHARACTERISTIC /end REF_CHARACTERISTIC /begin REF_MEASUREMENT /end REF_MEASUREMENT /end GROUP
/begin GROUP StaMd.PwrDnFastWriteComplete.Cnt_lgc "MICROSAR RTE" /begin SUB_GROUP /end SUB_GROUP /begin FUNCTION_LIST /end FUNCTION_LIST /begin REF_CHARACTERISTIC /end REF_CHARACTERISTIC /begin REF_MEASUREMENT Rte_StaMd_PwrDnFastWriteComplete_Cnt_lgc /end REF_MEASUREMENT /end GROUP
/begin GROUP StaMd.RampStatusComplete.Cnt_lgc "MICROSAR RTE" /begin SUB_GROUP /end SUB_GROUP /begin FUNCTION_LIST /end FUNCTION_LIST /begin REF_CHARACTERISTIC /end REF_CHARACTERISTIC /begin REF_MEASUREMENT Rte_StOpCtrl_SysStReqDi_Cnt_lgc /end REF_MEASUREMENT /end GROUP
/begin GROUP StaMd.ReceiverPorts "MICROSAR RTE"
 /begin SUB_GROUP StaMd.ATerm.Cnt_lgc StaMd.CTerm.Cnt_lgc StaMd.ControlledDampStatusComplete.Cnt_lgc StaMd.FTerm.Cnt_lgc StaMd.RampStatusComplete.Cnt_lgc StaMd.TMFTestComplete.Cnt_lgc /end SUB_GROUP
 /begin FUNCTION_LIST /end FUNCTION_LIST
 /begin REF_CHARACTERISTIC /end REF_CHARACTERISTIC
 /begin REF_MEASUREMENT /end REF_MEASUREMENT
/end GROUP
/begin GROUP StaMd.SenderPorts "MICROSAR RTE" /begin SUB_GROUP StaMd.PwrDnFastWriteComplete.Cnt_lgc /end SUB_GROUP /begin FUNCTION_LIST /end FUNCTION_LIST /begin REF_CHARACTERISTIC /end REF_CHARACTERISTIC /begin REF_MEASUREMENT /end REF_MEASUREMENT /end GROUP
/begin GROUP StaMd.SystemState.Mode "MICROSAR RTE" /begin SUB_GROUP /end SUB_GROUP /begin FUNCTION_LIST /end FUNCTION_LIST /begin REF_CHARACTERISTIC /end REF_CHARACTERISTIC /end GROUP
/begin GROUP StaMd.TMFTestComplete.Cnt_lgc "MICROSAR RTE" /begin SUB_GROUP /end SUB_GROUP /begin FUNCTION_LIST /end FUNCTION_LIST /begin REF_CHARACTERISTIC /end REF_CHARACTERISTIC /end GROUP
/begin GROUP StaMd11 "MICROSAR RTE" /begin SUB_GROUP StaMd11.ModeProvidePorts StaMd11.ReceiverPorts /end SUB_GROUP /begin FUNCTION_LIST /end FUNCTION_LIST /begin REF_CHARACTERISTIC /end REF_CHARACTERISTIC /begin REF_MEASUREMENT /end REF_MEASUREMENT /end GROUP
/begin GROUP StaMd11.ATerm.Cnt_lgc "MICROSAR RTE" /begin SUB_GROUP /end SUB_GROUP /begin FUNCTION_LIST /end FUNCTION_LIST /begin REF_CHARACTERISTIC /end REF_CHARACTERISTIC /begin REF_MEASUREMENT Rte_VehPwrMd_ATermActive_Cnt_lgc /end REF_MEASUREMENT /end GROUP
/begin GROUP StaMd11.CTerm.Cnt_lgc "MICROSAR RTE" /begin SUB_GROUP /end SUB_GROUP /begin FUNCTION_LIST /end FUNCTION_LIST /begin REF_CHARACTERISTIC /end REF_CHARACTERISTIC /end GROUP
/begin GROUP StaMd11.ControlledDampStatusComplete.Cnt_lgc "MICROSAR RTE" /begin SUB_GROUP /end SUB_GROUP /begin FUNCTION_LIST /end FUNCTION_LIST /begin REF_CHARACTERISTIC /end REF_CHARACTERISTIC /begin REF_MEASUREMENT Rte_TranlDampg_CntrlDampComp_Cnt_lgc /end REF_MEASUREMENT /end GROUP
/begin GROUP StaMd11.FTerm.Cnt_lgc "MICROSAR RTE" /begin SUB_GROUP /end SUB_GROUP /begin FUNCTION_LIST /end FUNCTION_LIST /begin REF_CHARACTERISTIC /end REF_CHARACTERISTIC /end GROUP
/begin GROUP StaMd11.ModeProvidePorts "MICROSAR RTE" /begin SUB_GROUP StaMd11.SystemState11.Mode /end SUB_GROUP /begin FUNCTION_LIST /end FUNCTION_LIST /begin REF_CHARACTERISTIC /end REF_CHARACTERISTIC /begin REF_MEASUREMENT /end REF_MEASUREMENT /end GROUP
/begin GROUP StaMd11.RampStatusComplete.Cnt_lgc "MICROSAR RTE" /begin SUB_GROUP /end SUB_GROUP /begin FUNCTION_LIST /end FUNCTION_LIST /begin REF_CHARACTERISTIC /end REF_CHARACTERISTIC /begin REF_MEASUREMENT Rte_StOpCtrl_SysStReqDi_Cnt_lgc /end REF_MEASUREMENT /end GROUP
/begin GROUP StaMd11.ReceiverPorts "MICROSAR RTE"
 /begin SUB_GROUP StaMd11.ATerm.Cnt_lgc StaMd11.CTerm.Cnt_lgc StaMd11.ControlledDampStatusComplete.Cnt_lgc StaMd11.FTerm.Cnt_lgc StaMd11.RampStatusComplete.Cnt_lgc StaMd11.TMFTestComplete.Cnt_lgc /end SUB_GROUP
 /begin FUNCTION_LIST /end FUNCTION_LIST
 /begin REF_CHARACTERISTIC /end REF_CHARACTERISTIC
 /begin REF_MEASUREMENT /end REF_MEASUREMENT
/end GROUP
/begin GROUP StaMd11.SystemState11.Mode "MICROSAR RTE" /begin SUB_GROUP /end SUB_GROUP /begin FUNCTION_LIST /end FUNCTION_LIST /begin REF_CHARACTERISTIC /end REF_CHARACTERISTIC /end GROUP
/begin GROUP StaMd11.TMFTestComplete.Cnt_lgc "MICROSAR RTE" /begin SUB_GROUP /end SUB_GROUP /begin FUNCTION_LIST /end FUNCTION_LIST /begin REF_CHARACTERISTIC /end REF_CHARACTERISTIC /end GROUP
/begin GROUP StaMd6 "MICROSAR RTE" /begin SUB_GROUP StaMd6.ModeProvidePorts /end SUB_GROUP /begin FUNCTION_LIST /end FUNCTION_LIST /begin REF_CHARACTERISTIC /end REF_CHARACTERISTIC /begin REF_MEASUREMENT /end REF_MEASUREMENT /end GROUP
/begin GROUP StaMd6.ModeProvidePorts "MICROSAR RTE" /begin SUB_GROUP StaMd6.SystemState6.Mode /end SUB_GROUP /begin FUNCTION_LIST /end FUNCTION_LIST /begin REF_CHARACTERISTIC /end REF_CHARACTERISTIC /begin REF_MEASUREMENT /end REF_MEASUREMENT /end GROUP
/begin GROUP StaMd6.SystemState6.Mode "MICROSAR RTE" /begin SUB_GROUP /end SUB_GROUP /begin FUNCTION_LIST /end FUNCTION_LIST /begin REF_CHARACTERISTIC /end REF_CHARACTERISTIC /end GROUP
/begin GROUP StaMd9 "MICROSAR RTE" /begin SUB_GROUP StaMd9.ModeProvidePorts /end SUB_GROUP /begin FUNCTION_LIST /end FUNCTION_LIST /begin REF_CHARACTERISTIC /end REF_CHARACTERISTIC /begin REF_MEASUREMENT /end REF_MEASUREMENT /end GROUP
/begin GROUP StaMd9.ModeProvidePorts "MICROSAR RTE" /begin SUB_GROUP StaMd9.SystemState9.Mode /end SUB_GROUP /begin FUNCTION_LIST /end FUNCTION_LIST /begin REF_CHARACTERISTIC /end REF_CHARACTERISTIC /begin REF_MEASUREMENT /end REF_MEASUREMENT /end GROUP
/begin GROUP StaMd9.SystemState9.Mode "MICROSAR RTE" /begin SUB_GROUP /end SUB_GROUP /begin FUNCTION_LIST /end FUNCTION_LIST /begin REF_CHARACTERISTIC /end REF_CHARACTERISTIC /end GROUP
/begin GROUP StabilityComp "MICROSAR RTE" /begin SUB_GROUP StabilityComp.ReceiverPorts StabilityComp.SenderPorts /end SUB_GROUP /begin FUNCTION_LIST /end FUNCTION_LIST /begin REF_CHARACTERISTIC /end REF_CHARACTERISTIC /begin REF_MEASUREMENT /end REF_MEASUREMENT /end GROUP
/begin GROUP StabilityComp.AssistCmd.MtrNm_f32 "MICROSAR RTE" /begin SUB_GROUP /end SUB_GROUP /begin FUNCTION_LIST /end FUNCTION_LIST /begin REF_CHARACTERISTIC /end REF_CHARACTERISTIC /end GROUP
/begin GROUP StabilityComp.AssistDDFactor.Uls_f32 "MICROSAR RTE" /begin SUB_GROUP /end SUB_GROUP /begin FUNCTION_LIST /end FUNCTION_LIST /begin REF_CHARACTERISTIC /end REF_CHARACTERISTIC /begin REF_MEASUREMENT Rte_StabilityComp_AssistDDFactor_Uls_f32 /end REF_MEASUREMENT /end GROUP
/begin GROUP StabilityComp.AsstFWActive.Uls_f32 "MICROSAR RTE" /begin SUB_GROUP /end SUB_GROUP /begin FUNCTION_LIST /end FUNCTION_LIST /begin REF_CHARACTERISTIC /end REF_CHARACTERISTIC /end GROUP
/begin GROUP StabilityComp.CombinedAssist.MtrNm_f32 "MICROSAR RTE" /begin SUB_GROUP /end SUB_GROUP /begin FUNCTION_LIST /end FUNCTION_LIST /begin REF_CHARACTERISTIC /end REF_CHARACTERISTIC /end GROUP
/begin GROUP StabilityComp.HwTorque.HwNm_f32 "MICROSAR RTE" /begin SUB_GROUP /end SUB_GROUP /begin FUNCTION_LIST /end FUNCTION_LIST /begin REF_CHARACTERISTIC /end REF_CHARACTERISTIC /end GROUP
/begin GROUP StabilityComp.ReceiverPorts "MICROSAR RTE"
 /begin SUB_GROUP StabilityComp.AssistDDFactor.Uls_f32 StabilityComp.AsstFWActive.Uls_f32 StabilityComp.CombinedAssist.MtrNm_f32 StabilityComp.HwTorque.HwNm_f32 StabilityComp.SysAssistCmd_MtrNm.MtrNm_f32 StabilityComp.VehicleSpeed.Kph_f32 /end SUB_GROUP
 /begin FUNCTION_LIST /end FUNCTION_LIST
 /begin REF_CHARACTERISTIC /end REF_CHARACTERISTIC
 /begin REF_MEASUREMENT /end REF_MEASUREMENT
/end GROUP
/begin GROUP StabilityComp.SenderPorts "MICROSAR RTE" /begin SUB_GROUP StabilityComp.AssistCmd.MtrNm_f32 /end SUB_GROUP /begin FUNCTION_LIST /end FUNCTION_LIST /begin REF_CHARACTERISTIC /end REF_CHARACTERISTIC /begin REF_MEASUREMENT /end REF_MEASUREMENT /end GROUP
/begin GROUP StabilityComp.SysAssistCmd_MtrNm.MtrNm_f32 "MICROSAR RTE" /begin SUB_GROUP /end SUB_GROUP /begin FUNCTION_LIST /end FUNCTION_LIST /begin REF_CHARACTERISTIC /end REF_CHARACTERISTIC /begin REF_MEASUREMENT Rte_StabilityComp2_SysAssistCmd_MtrNm_f32 /end REF_MEASUREMENT /end GROUP
/begin GROUP StabilityComp.VehicleSpeed.Kph_f32 "MICROSAR RTE" /begin SUB_GROUP /end SUB_GROUP /begin FUNCTION_LIST /end FUNCTION_LIST /begin REF_CHARACTERISTIC /end REF_CHARACTERISTIC /end GROUP
/begin GROUP StabilityComp2 "MICROSAR RTE" /begin SUB_GROUP StabilityComp2.ReceiverPorts StabilityComp2.SenderPorts /end SUB_GROUP /begin FUNCTION_LIST /end FUNCTION_LIST /begin REF_CHARACTERISTIC /end REF_CHARACTERISTIC /begin REF_MEASUREMENT /end REF_MEASUREMENT /end GROUP
/begin GROUP StabilityComp2.AssistDDFactor.Uls_f32 "MICROSAR RTE" /begin SUB_GROUP /end SUB_GROUP /begin FUNCTION_LIST /end FUNCTION_LIST /begin REF_CHARACTERISTIC /end REF_CHARACTERISTIC /begin REF_MEASUREMENT Rte_StabilityComp2_AssistDDFactor_Uls_f32 /end REF_MEASUREMENT /end GROUP
/begin GROUP StabilityComp2.AsstFWActive.Uls_f32 "MICROSAR RTE" /begin SUB_GROUP /end SUB_GROUP /begin FUNCTION_LIST /end FUNCTION_LIST /begin REF_CHARACTERISTIC /end REF_CHARACTERISTIC /end GROUP
/begin GROUP StabilityComp2.CombinedAssist.MtrNm_f32 "MICROSAR RTE" /begin SUB_GROUP /end SUB_GROUP /begin FUNCTION_LIST /end FUNCTION_LIST /begin REF_CHARACTERISTIC /end REF_CHARACTERISTIC /end GROUP
/begin GROUP StabilityComp2.HwTorque.HwNm_f32 "MICROSAR RTE" /begin SUB_GROUP /end SUB_GROUP /begin FUNCTION_LIST /end FUNCTION_LIST /begin REF_CHARACTERISTIC /end REF_CHARACTERISTIC /end GROUP
/begin GROUP StabilityComp2.ReceiverPorts "MICROSAR RTE"
 /begin SUB_GROUP StabilityComp2.AssistDDFactor.Uls_f32 StabilityComp2.AsstFWActive.Uls_f32 StabilityComp2.CombinedAssist.MtrNm_f32 StabilityComp2.HwTorque.HwNm_f32 StabilityComp2.VehicleSpeed.Kph_f32 /end SUB_GROUP
 /begin FUNCTION_LIST /end FUNCTION_LIST
 /begin REF_CHARACTERISTIC /end REF_CHARACTERISTIC
 /begin REF_MEASUREMENT /end REF_MEASUREMENT
/end GROUP
/begin GROUP StabilityComp2.SenderPorts "MICROSAR RTE" /begin SUB_GROUP StabilityComp2.SysAssistCmd.MtrNm_f32 /end SUB_GROUP /begin FUNCTION_LIST /end FUNCTION_LIST /begin REF_CHARACTERISTIC /end REF_CHARACTERISTIC /begin REF_MEASUREMENT /end REF_MEASUREMENT /end GROUP
/begin GROUP StabilityComp2.SysAssistCmd.MtrNm_f32 "MICROSAR RTE" /begin SUB_GROUP /end SUB_GROUP /begin FUNCTION_LIST /end FUNCTION_LIST /begin REF_CHARACTERISTIC /end REF_CHARACTERISTIC /begin REF_MEASUREMENT Rte_StabilityComp2_SysAssistCmd_MtrNm_f32 /end REF_MEASUREMENT /end GROUP
/begin GROUP StabilityComp2.VehicleSpeed.Kph_f32 "MICROSAR RTE" /begin SUB_GROUP /end SUB_GROUP /begin FUNCTION_LIST /end FUNCTION_LIST /begin REF_CHARACTERISTIC /end REF_CHARACTERISTIC /end GROUP
/begin GROUP Sweep "MICROSAR RTE" /begin SUB_GROUP Sweep.ReceiverPorts Sweep.SenderPorts /end SUB_GROUP /begin FUNCTION_LIST /end FUNCTION_LIST /begin REF_CHARACTERISTIC /end REF_CHARACTERISTIC /begin REF_MEASUREMENT /end REF_MEASUREMENT /end GROUP
/begin GROUP Sweep.InputHwTrq.HwNm_f32 "MICROSAR RTE" /begin SUB_GROUP /end SUB_GROUP /begin FUNCTION_LIST /end FUNCTION_LIST /begin REF_CHARACTERISTIC /end REF_CHARACTERISTIC /end GROUP
/begin GROUP Sweep.OutputHwTrq.HwNm_f32 "MICROSAR RTE" /begin SUB_GROUP /end SUB_GROUP /begin FUNCTION_LIST /end FUNCTION_LIST /begin REF_CHARACTERISTIC /end REF_CHARACTERISTIC /end GROUP
/begin GROUP Sweep.ReceiverPorts "MICROSAR RTE"
 /begin SUB_GROUP Sweep.InputHwTrq.HwNm_f32 Sweep.VehSpd.Kph_f32 Sweep.VehSpdValid.Cnt_lgc /end SUB_GROUP
 /begin FUNCTION_LIST /end FUNCTION_LIST
 /begin REF_CHARACTERISTIC /end REF_CHARACTERISTIC
 /begin REF_MEASUREMENT /end REF_MEASUREMENT
/end GROUP
/begin GROUP Sweep.SenderPorts "MICROSAR RTE" /begin SUB_GROUP Sweep.OutputHwTrq.HwNm_f32 /end SUB_GROUP /begin FUNCTION_LIST /end FUNCTION_LIST /begin REF_CHARACTERISTIC /end REF_CHARACTERISTIC /begin REF_MEASUREMENT /end REF_MEASUREMENT /end GROUP
/begin GROUP Sweep.VehSpd.Kph_f32 "MICROSAR RTE" /begin SUB_GROUP /end SUB_GROUP /begin FUNCTION_LIST /end FUNCTION_LIST /begin REF_CHARACTERISTIC /end REF_CHARACTERISTIC /end GROUP
/begin GROUP Sweep.VehSpdValid.Cnt_lgc "MICROSAR RTE" /begin SUB_GROUP /end SUB_GROUP /begin FUNCTION_LIST /end FUNCTION_LIST /begin REF_CHARACTERISTIC /end REF_CHARACTERISTIC /end GROUP
/begin GROUP Sweep2 "MICROSAR RTE" /begin SUB_GROUP Sweep2.ReceiverPorts Sweep2.SenderPorts /end SUB_GROUP /begin FUNCTION_LIST /end FUNCTION_LIST /begin REF_CHARACTERISTIC /end REF_CHARACTERISTIC /begin REF_MEASUREMENT /end REF_MEASUREMENT /end GROUP
/begin GROUP Sweep2.InputMtrTrq.MtrNm_f32 "MICROSAR RTE" /begin SUB_GROUP /end SUB_GROUP /begin FUNCTION_LIST /end FUNCTION_LIST /begin REF_CHARACTERISTIC /end REF_CHARACTERISTIC /end GROUP
/begin GROUP Sweep2.OutputMtrTrq.MtrNm_f32 "MICROSAR RTE" /begin SUB_GROUP /end SUB_GROUP /begin FUNCTION_LIST /end FUNCTION_LIST /begin REF_CHARACTERISTIC /end REF_CHARACTERISTIC /begin REF_MEASUREMENT Rte_Sweep2_OutputMtrTrq_MtrNm_f32 /end REF_MEASUREMENT /end GROUP
/begin GROUP Sweep2.ReceiverPorts "MICROSAR RTE" /begin SUB_GROUP Sweep2.InputMtrTrq.MtrNm_f32 /end SUB_GROUP /begin FUNCTION_LIST /end FUNCTION_LIST /begin REF_CHARACTERISTIC /end REF_CHARACTERISTIC /begin REF_MEASUREMENT /end REF_MEASUREMENT /end GROUP
/begin GROUP Sweep2.SenderPorts "MICROSAR RTE" /begin SUB_GROUP Sweep2.OutputMtrTrq.MtrNm_f32 /end SUB_GROUP /begin FUNCTION_LIST /end FUNCTION_LIST /begin REF_CHARACTERISTIC /end REF_CHARACTERISTIC /begin REF_MEASUREMENT /end REF_MEASUREMENT /end GROUP
/begin GROUP ThrmlDutyCycle "MICROSAR RTE"
 /begin SUB_GROUP ThrmlDutyCycle.ModeRequirePorts ThrmlDutyCycle.PerInstanceMemories ThrmlDutyCycle.ReceiverPorts ThrmlDutyCycle.SenderPorts /end SUB_GROUP
 /begin FUNCTION_LIST /end FUNCTION_LIST
 /begin REF_CHARACTERISTIC /end REF_CHARACTERISTIC
 /begin REF_MEASUREMENT /end REF_MEASUREMENT
/end GROUP
/begin GROUP ThrmlDutyCycle.CuTempEst.DegC_f32 "MICROSAR RTE" /begin SUB_GROUP /end SUB_GROUP /begin FUNCTION_LIST /end FUNCTION_LIST /begin REF_CHARACTERISTIC /end REF_CHARACTERISTIC /end GROUP
/begin GROUP ThrmlDutyCycle.DefeatDutySvc.Cnt_lgc "MICROSAR RTE" /begin SUB_GROUP /end SUB_GROUP /begin FUNCTION_LIST /end FUNCTION_LIST /begin REF_CHARACTERISTIC /end REF_CHARACTERISTIC /end GROUP
/begin GROUP ThrmlDutyCycle.DutyCycleLevel.Uls_f32 "MICROSAR RTE" /begin SUB_GROUP /end SUB_GROUP /begin FUNCTION_LIST /end FUNCTION_LIST /begin REF_CHARACTERISTIC /end REF_CHARACTERISTIC /end GROUP
/begin GROUP ThrmlDutyCycle.FiltMeasTemp.DegC_f32 "MICROSAR RTE" /begin SUB_GROUP /end SUB_GROUP /begin FUNCTION_LIST /end FUNCTION_LIST /begin REF_CHARACTERISTIC /end REF_CHARACTERISTIC /end GROUP
/begin GROUP ThrmlDutyCycle.FilteredPkCurr.AmpSq_f32 "MICROSAR RTE" /begin SUB_GROUP /end SUB_GROUP /begin FUNCTION_LIST /end FUNCTION_LIST /begin REF_CHARACTERISTIC /end REF_CHARACTERISTIC /end GROUP
/begin GROUP ThrmlDutyCycle.IgnTimeOff.Cnt_u32 "MICROSAR RTE" /begin SUB_GROUP /end SUB_GROUP /begin FUNCTION_LIST /end FUNCTION_LIST /begin REF_CHARACTERISTIC /end REF_CHARACTERISTIC /begin REF_MEASUREMENT Rte_SrlComInput_IgnTimeOff_Cnt_u32 /end REF_MEASUREMENT /end GROUP
/begin GROUP ThrmlDutyCycle.MagTempEst.DegC_f32 "MICROSAR RTE" /begin SUB_GROUP /end SUB_GROUP /begin FUNCTION_LIST /end FUNCTION_LIST /begin REF_CHARACTERISTIC /end REF_CHARACTERISTIC /end GROUP
/begin GROUP ThrmlDutyCycle.ModeRequirePorts "MICROSAR RTE" /begin SUB_GROUP ThrmlDutyCycle.SystemState.Mode /end SUB_GROUP /begin FUNCTION_LIST /end FUNCTION_LIST /begin REF_CHARACTERISTIC /end REF_CHARACTERISTIC /begin REF_MEASUREMENT /end REF_MEASUREMENT /end GROUP
/begin GROUP ThrmlDutyCycle.MotorVelCRF.MtrRadpS_f32 "MICROSAR RTE" /begin SUB_GROUP /end SUB_GROUP /begin FUNCTION_LIST /end FUNCTION_LIST /begin REF_CHARACTERISTIC /end REF_CHARACTERISTIC /end GROUP
/begin GROUP ThrmlDutyCycle.MtrPkCurr.AmpSq_f32 "MICROSAR RTE" /begin SUB_GROUP /end SUB_GROUP /begin FUNCTION_LIST /end FUNCTION_LIST /begin REF_CHARACTERISTIC /end REF_CHARACTERISTIC /end GROUP
/begin GROUP ThrmlDutyCycle.PerInstanceMemories "MICROSAR RTE" /begin SUB_GROUP ThrmlDutyCycle.ThrmlDutyCycle_FltStVal /end SUB_GROUP /begin FUNCTION_LIST /end FUNCTION_LIST /begin REF_CHARACTERISTIC /end REF_CHARACTERISTIC /begin REF_MEASUREMENT /end REF_MEASUREMENT /end GROUP
/begin GROUP ThrmlDutyCycle.ReceiverPorts "MICROSAR RTE"
 /begin SUB_GROUP ThrmlDutyCycle.CuTempEst.DegC_f32 ThrmlDutyCycle.DefeatDutySvc.Cnt_lgc ThrmlDutyCycle.FiltMeasTemp.DegC_f32 ThrmlDutyCycle.FilteredPkCurr.AmpSq_f32 ThrmlDutyCycle.IgnTimeOff.Cnt_u32 ThrmlDutyCycle.MagTempEst.DegC_f32 ThrmlDutyCycle.MotorVelCRF.MtrRadpS_f32 ThrmlDutyCycle.MtrPkCurr.AmpSq_f32 ThrmlDutyCycle.SiTempEst.DegC_f32 ThrmlDutyCycle.VehTimeValid.Cnt_lgc /end SUB_GROUP
 /begin FUNCTION_LIST /end FUNCTION_LIST
 /begin REF_CHARACTERISTIC /end REF_CHARACTERISTIC
 /begin REF_MEASUREMENT /end REF_MEASUREMENT
/end GROUP
/begin GROUP ThrmlDutyCycle.SenderPorts "MICROSAR RTE"
 /begin SUB_GROUP ThrmlDutyCycle.DutyCycleLevel.Uls_f32 ThrmlDutyCycle.ThermLimitPerc.Uls_f32 ThrmlDutyCycle.ThermalLimit.MtrNm_f32 /end SUB_GROUP
 /begin FUNCTION_LIST /end FUNCTION_LIST
 /begin REF_CHARACTERISTIC /end REF_CHARACTERISTIC
 /begin REF_MEASUREMENT /end REF_MEASUREMENT
/end GROUP
/begin GROUP ThrmlDutyCycle.SiTempEst.DegC_f32 "MICROSAR RTE" /begin SUB_GROUP /end SUB_GROUP /begin FUNCTION_LIST /end FUNCTION_LIST /begin REF_CHARACTERISTIC /end REF_CHARACTERISTIC /end GROUP
/begin GROUP ThrmlDutyCycle.SystemState.Mode "MICROSAR RTE" /begin SUB_GROUP /end SUB_GROUP /begin FUNCTION_LIST /end FUNCTION_LIST /begin REF_CHARACTERISTIC /end REF_CHARACTERISTIC /end GROUP
/begin GROUP ThrmlDutyCycle.ThermLimitPerc.Uls_f32 "MICROSAR RTE" /begin SUB_GROUP /end SUB_GROUP /begin FUNCTION_LIST /end FUNCTION_LIST /begin REF_CHARACTERISTIC /end REF_CHARACTERISTIC /end GROUP
/begin GROUP ThrmlDutyCycle.ThermalLimit.MtrNm_f32 "MICROSAR RTE" /begin SUB_GROUP /end SUB_GROUP /begin FUNCTION_LIST /end FUNCTION_LIST /begin REF_CHARACTERISTIC /end REF_CHARACTERISTIC /end GROUP
/begin GROUP ThrmlDutyCycle.ThrmlDutyCycle_FltStVal "MICROSAR RTE" /begin SUB_GROUP /end SUB_GROUP /begin FUNCTION_LIST /end FUNCTION_LIST /begin REF_CHARACTERISTIC /end REF_CHARACTERISTIC
 /begin REF_MEASUREMENT Rte_ThrmlDutyCycle_ThrmlDutyCycle_FltStVal.Filt3Val_Cnt_u8 Rte_ThrmlDutyCycle_ThrmlDutyCycle_FltStVal.Filt4Val_Cnt_u8 Rte_ThrmlDutyCycle_ThrmlDutyCycle_FltStVal.Filt5Val_Cnt_u8 Rte_ThrmlDutyCycle_ThrmlDutyCycle_FltStVal.Filt6Val_Cnt_u8 /end REF_MEASUREMENT
/end GROUP
/begin GROUP ThrmlDutyCycle.VehTimeValid.Cnt_lgc "MICROSAR RTE" /begin SUB_GROUP /end SUB_GROUP /begin FUNCTION_LIST /end FUNCTION_LIST /begin REF_CHARACTERISTIC /end REF_CHARACTERISTIC /begin REF_MEASUREMENT Rte_SrlComInput_VehTimeValid_Cnt_lgc /end REF_MEASUREMENT /end GROUP
/begin GROUP TmprlMon "MICROSAR RTE"
 /begin SUB_GROUP TmprlMon.ModeRequirePorts TmprlMon.ReceiverPorts TmprlMon.SenderPorts /end SUB_GROUP
 /begin FUNCTION_LIST /end FUNCTION_LIST
 /begin REF_CHARACTERISTIC /end REF_CHARACTERISTIC
 /begin REF_MEASUREMENT /end REF_MEASUREMENT
/end GROUP
/begin GROUP TmprlMon.ModeRequirePorts "MICROSAR RTE" /begin SUB_GROUP TmprlMon.SystemState.Mode /end SUB_GROUP /begin FUNCTION_LIST /end FUNCTION_LIST /begin REF_CHARACTERISTIC /end REF_CHARACTERISTIC /begin REF_MEASUREMENT /end REF_MEASUREMENT /end GROUP
/begin GROUP TmprlMon.ReceiverPorts "MICROSAR RTE" /begin SUB_GROUP TmprlMon.TMFTestStart.Cnt_lgc /end SUB_GROUP /begin FUNCTION_LIST /end FUNCTION_LIST /begin REF_CHARACTERISTIC /end REF_CHARACTERISTIC /begin REF_MEASUREMENT /end REF_MEASUREMENT /end GROUP
/begin GROUP TmprlMon.SenderPorts "MICROSAR RTE" /begin SUB_GROUP TmprlMon.TMFTestComplete.Cnt_lgc /end SUB_GROUP /begin FUNCTION_LIST /end FUNCTION_LIST /begin REF_CHARACTERISTIC /end REF_CHARACTERISTIC /begin REF_MEASUREMENT /end REF_MEASUREMENT /end GROUP
/begin GROUP TmprlMon.SystemState.Mode "MICROSAR RTE" /begin SUB_GROUP /end SUB_GROUP /begin FUNCTION_LIST /end FUNCTION_LIST /begin REF_CHARACTERISTIC /end REF_CHARACTERISTIC /end GROUP
/begin GROUP TmprlMon.TMFTestComplete.Cnt_lgc "MICROSAR RTE" /begin SUB_GROUP /end SUB_GROUP /begin FUNCTION_LIST /end FUNCTION_LIST /begin REF_CHARACTERISTIC /end REF_CHARACTERISTIC /end GROUP
/begin GROUP TmprlMon.TMFTestStart.Cnt_lgc "MICROSAR RTE" /begin SUB_GROUP /end SUB_GROUP /begin FUNCTION_LIST /end FUNCTION_LIST /begin REF_CHARACTERISTIC /end REF_CHARACTERISTIC /end GROUP
/begin GROUP TqRsDg "MICROSAR RTE"
 /begin SUB_GROUP TqRsDg.ModeRequirePorts TqRsDg.ReceiverPorts TqRsDg.SenderPorts /end SUB_GROUP
 /begin FUNCTION_LIST /end FUNCTION_LIST
 /begin REF_CHARACTERISTIC /end REF_CHARACTERISTIC
 /begin REF_MEASUREMENT /end REF_MEASUREMENT
/end GROUP
/begin GROUP TqRsDg.CorrMtrPosElec.Rev_f32 "MICROSAR RTE" /begin SUB_GROUP /end SUB_GROUP /begin FUNCTION_LIST /end FUNCTION_LIST /begin REF_CHARACTERISTIC /end REF_CHARACTERISTIC /end GROUP
/begin GROUP TqRsDg.EstKe.VpRadpS_f32 "MICROSAR RTE" /begin SUB_GROUP /end SUB_GROUP /begin FUNCTION_LIST /end FUNCTION_LIST /begin REF_CHARACTERISTIC /end REF_CHARACTERISTIC /end GROUP
/begin GROUP TqRsDg.EstR.Ohm_f32 "MICROSAR RTE" /begin SUB_GROUP /end SUB_GROUP /begin FUNCTION_LIST /end FUNCTION_LIST /begin REF_CHARACTERISTIC /end REF_CHARACTERISTIC /end GROUP
/begin GROUP TqRsDg.MRFMtrVel.MtrRadpS_f32 "MICROSAR RTE" /begin SUB_GROUP /end SUB_GROUP /begin FUNCTION_LIST /end FUNCTION_LIST /begin REF_CHARACTERISTIC /end REF_CHARACTERISTIC /end GROUP
/begin GROUP TqRsDg.ModeRequirePorts "MICROSAR RTE" /begin SUB_GROUP TqRsDg.SystemState.Mode /end SUB_GROUP /begin FUNCTION_LIST /end FUNCTION_LIST /begin REF_CHARACTERISTIC /end REF_CHARACTERISTIC /begin REF_MEASUREMENT /end REF_MEASUREMENT /end GROUP
/begin GROUP TqRsDg.MtrCurrDaxRef.Amp_f32 "MICROSAR RTE" /begin SUB_GROUP /end SUB_GROUP /begin FUNCTION_LIST /end FUNCTION_LIST /begin REF_CHARACTERISTIC /end REF_CHARACTERISTIC /end GROUP
/begin GROUP TqRsDg.MtrCurrIdptSig.Cnt_u08 "MICROSAR RTE" /begin SUB_GROUP /end SUB_GROUP /begin FUNCTION_LIST /end FUNCTION_LIST /begin REF_CHARACTERISTIC /end REF_CHARACTERISTIC /end GROUP
/begin GROUP TqRsDg.MtrCurrQaxFinalRef.Amp_f32 "MICROSAR RTE" /begin SUB_GROUP /end SUB_GROUP /begin FUNCTION_LIST /end FUNCTION_LIST /begin REF_CHARACTERISTIC /end REF_CHARACTERISTIC /end GROUP
/begin GROUP TqRsDg.MtrVoltDax.Volt_f32 "MICROSAR RTE" /begin SUB_GROUP /end SUB_GROUP /begin FUNCTION_LIST /end FUNCTION_LIST /begin REF_CHARACTERISTIC /end REF_CHARACTERISTIC /end GROUP
/begin GROUP TqRsDg.MtrVoltQax.Volt_f32 "MICROSAR RTE" /begin SUB_GROUP /end SUB_GROUP /begin FUNCTION_LIST /end FUNCTION_LIST /begin REF_CHARACTERISTIC /end REF_CHARACTERISTIC /end GROUP
/begin GROUP TqRsDg.OutputRampMult.Uls_f32 "MICROSAR RTE" /begin SUB_GROUP /end SUB_GROUP /begin FUNCTION_LIST /end FUNCTION_LIST /begin REF_CHARACTERISTIC /end REF_CHARACTERISTIC /end GROUP
/begin GROUP TqRsDg.ReceiverPorts "MICROSAR RTE"
 /begin SUB_GROUP TqRsDg.CorrMtrPosElec.Rev_f32 TqRsDg.EstKe.VpRadpS_f32 TqRsDg.EstR.Ohm_f32 TqRsDg.MRFMtrVel.MtrRadpS_f32 TqRsDg.MtrCurrDaxRef.Amp_f32 TqRsDg.MtrCurrQaxFinalRef.Amp_f32 TqRsDg.MtrVoltDax.Volt_f32 TqRsDg.MtrVoltQax.Volt_f32 TqRsDg.OutputRampMult.Uls_f32 TqRsDg.TrqLimitMin.MtrNm_f32 /end SUB_GROUP
 /begin FUNCTION_LIST /end FUNCTION_LIST
 /begin REF_CHARACTERISTIC /end REF_CHARACTERISTIC
 /begin REF_MEASUREMENT /end REF_MEASUREMENT
/end GROUP
/begin GROUP TqRsDg.SenderPorts "MICROSAR RTE" /begin SUB_GROUP TqRsDg.MtrCurrIdptSig.Cnt_u08 /end SUB_GROUP /begin FUNCTION_LIST /end FUNCTION_LIST /begin REF_CHARACTERISTIC /end REF_CHARACTERISTIC /begin REF_MEASUREMENT /end REF_MEASUREMENT /end GROUP
/begin GROUP TqRsDg.SystemState.Mode "MICROSAR RTE" /begin SUB_GROUP /end SUB_GROUP /begin FUNCTION_LIST /end FUNCTION_LIST /begin REF_CHARACTERISTIC /end REF_CHARACTERISTIC /end GROUP
/begin GROUP TqRsDg.TrqLimitMin.MtrNm_f32 "MICROSAR RTE" /begin SUB_GROUP /end SUB_GROUP /begin FUNCTION_LIST /end FUNCTION_LIST /begin REF_CHARACTERISTIC /end REF_CHARACTERISTIC /end GROUP
/begin GROUP TranlDampg "MICROSAR RTE"
 /begin SUB_GROUP TranlDampg.ModeRequirePorts TranlDampg.ReceiverPorts TranlDampg.SenderPorts /end SUB_GROUP
 /begin FUNCTION_LIST /end FUNCTION_LIST
 /begin REF_CHARACTERISTIC /end REF_CHARACTERISTIC
 /begin REF_MEASUREMENT /end REF_MEASUREMENT
/end GROUP
/begin GROUP TranlDampg.AssistAssyPolarity.Cnt_s08 "MICROSAR RTE" /begin SUB_GROUP /end SUB_GROUP /begin FUNCTION_LIST /end FUNCTION_LIST /begin REF_CHARACTERISTIC /end REF_CHARACTERISTIC /end GROUP
/begin GROUP TranlDampg.CRFMtrTrqCmd.MtrNm_f32 "MICROSAR RTE" /begin SUB_GROUP /end SUB_GROUP /begin FUNCTION_LIST /end FUNCTION_LIST /begin REF_CHARACTERISTIC /end REF_CHARACTERISTIC /end GROUP
/begin GROUP TranlDampg.CRFMtrVel.MtrRadpS_f32 "MICROSAR RTE" /begin SUB_GROUP /end SUB_GROUP /begin FUNCTION_LIST /end FUNCTION_LIST /begin REF_CHARACTERISTIC /end REF_CHARACTERISTIC /end GROUP
/begin GROUP TranlDampg.CntrlDampComp.Cnt_lgc "MICROSAR RTE" /begin SUB_GROUP /end SUB_GROUP /begin FUNCTION_LIST /end FUNCTION_LIST /begin REF_CHARACTERISTIC /end REF_CHARACTERISTIC /begin REF_MEASUREMENT Rte_TranlDampg_CntrlDampComp_Cnt_lgc /end REF_MEASUREMENT /end GROUP
/begin GROUP TranlDampg.DiagStsF2Active.Cnt_lgc "MICROSAR RTE" /begin SUB_GROUP /end SUB_GROUP /begin FUNCTION_LIST /end FUNCTION_LIST /begin REF_CHARACTERISTIC /end REF_CHARACTERISTIC /end GROUP
/begin GROUP TranlDampg.HandwheelPosition.HwDeg_f32 "MICROSAR RTE" /begin SUB_GROUP /end SUB_GROUP /begin FUNCTION_LIST /end FUNCTION_LIST /begin REF_CHARACTERISTIC /end REF_CHARACTERISTIC /end GROUP
/begin GROUP TranlDampg.LoaSt.State_enum "MICROSAR RTE" /begin SUB_GROUP /end SUB_GROUP /begin FUNCTION_LIST /end FUNCTION_LIST /begin REF_CHARACTERISTIC /end REF_CHARACTERISTIC /end GROUP
/begin GROUP TranlDampg.MRFMtrTrqCmd.MtrNm_f32 "MICROSAR RTE" /begin SUB_GROUP /end SUB_GROUP /begin FUNCTION_LIST /end FUNCTION_LIST /begin REF_CHARACTERISTIC /end REF_CHARACTERISTIC /end GROUP
/begin GROUP TranlDampg.ModeRequirePorts "MICROSAR RTE" /begin SUB_GROUP TranlDampg.SystemState.Mode /end SUB_GROUP /begin FUNCTION_LIST /end FUNCTION_LIST /begin REF_CHARACTERISTIC /end REF_CHARACTERISTIC /begin REF_MEASUREMENT /end REF_MEASUREMENT /end GROUP
/begin GROUP TranlDampg.ReceiverPorts "MICROSAR RTE"
 /begin SUB_GROUP TranlDampg.AssistAssyPolarity.Cnt_s08 TranlDampg.CRFMtrVel.MtrRadpS_f32 TranlDampg.DiagStsF2Active.Cnt_lgc TranlDampg.HandwheelPosition.HwDeg_f32 TranlDampg.LoaSt.State_enum TranlDampg.SumLimTrqCmd.MtrNm_f32 TranlDampg.VehSpd.Kph_f32 /end SUB_GROUP
 /begin FUNCTION_LIST /end FUNCTION_LIST
 /begin REF_CHARACTERISTIC /end REF_CHARACTERISTIC
 /begin REF_MEASUREMENT /end REF_MEASUREMENT
/end GROUP
/begin GROUP TranlDampg.SenderPorts "MICROSAR RTE"
 /begin SUB_GROUP TranlDampg.CRFMtrTrqCmd.MtrNm_f32 TranlDampg.CntrlDampComp.Cnt_lgc TranlDampg.MRFMtrTrqCmd.MtrNm_f32 TranlDampg.SysC_CRFMtrTrqCmd.MtrNm_f32 TranlDampg.SysC_MRFMtrTrqCmd.MtrNm_f32 /end SUB_GROUP
 /begin FUNCTION_LIST /end FUNCTION_LIST
 /begin REF_CHARACTERISTIC /end REF_CHARACTERISTIC
 /begin REF_MEASUREMENT /end REF_MEASUREMENT
/end GROUP
/begin GROUP TranlDampg.SumLimTrqCmd.MtrNm_f32 "MICROSAR RTE" /begin SUB_GROUP /end SUB_GROUP /begin FUNCTION_LIST /end FUNCTION_LIST /begin REF_CHARACTERISTIC /end REF_CHARACTERISTIC /begin REF_MEASUREMENT Rte_Sweep2_OutputMtrTrq_MtrNm_f32 /end REF_MEASUREMENT /end GROUP
/begin GROUP TranlDampg.SysC_CRFMtrTrqCmd.MtrNm_f32 "MICROSAR RTE" /begin SUB_GROUP /end SUB_GROUP /begin FUNCTION_LIST /end FUNCTION_LIST /begin REF_CHARACTERISTIC /end REF_CHARACTERISTIC /begin REF_MEASUREMENT Rte_TranlDampg_SysC_CRFMtrTrqCmd_MtrNm_f32 /end REF_MEASUREMENT /end GROUP
/begin GROUP TranlDampg.SysC_MRFMtrTrqCmd.MtrNm_f32 "MICROSAR RTE" /begin SUB_GROUP /end SUB_GROUP /begin FUNCTION_LIST /end FUNCTION_LIST /begin REF_CHARACTERISTIC /end REF_CHARACTERISTIC /begin REF_MEASUREMENT Rte_TranlDampg_SysC_MRFMtrTrqCmd_MtrNm_f32 /end REF_MEASUREMENT /end GROUP
/begin GROUP TranlDampg.SystemState.Mode "MICROSAR RTE" /begin SUB_GROUP /end SUB_GROUP /begin FUNCTION_LIST /end FUNCTION_LIST /begin REF_CHARACTERISTIC /end REF_CHARACTERISTIC /end GROUP
/begin GROUP TranlDampg.VehSpd.Kph_f32 "MICROSAR RTE" /begin SUB_GROUP /end SUB_GROUP /begin FUNCTION_LIST /end FUNCTION_LIST /begin REF_CHARACTERISTIC /end REF_CHARACTERISTIC /end GROUP
/begin GROUP TrqCanc "MICROSAR RTE" /begin SUB_GROUP TrqCanc.PerInstanceMemories TrqCanc.ReceiverPorts /end SUB_GROUP /begin FUNCTION_LIST /end FUNCTION_LIST /begin REF_CHARACTERISTIC /end REF_CHARACTERISTIC /begin REF_MEASUREMENT /end REF_MEASUREMENT /end GROUP
/begin GROUP TrqCanc.CogTrqCal "MICROSAR RTE" /begin SUB_GROUP /end SUB_GROUP /begin FUNCTION_LIST /end FUNCTION_LIST /begin REF_CHARACTERISTIC /end REF_CHARACTERISTIC /begin REF_MEASUREMENT Rte_TrqCanc_CogTrqCal /end REF_MEASUREMENT /end GROUP
/begin GROUP TrqCanc.CogTrqRplComp "MICROSAR RTE" /begin SUB_GROUP /end SUB_GROUP /begin FUNCTION_LIST /end FUNCTION_LIST /begin REF_CHARACTERISTIC /end REF_CHARACTERISTIC /begin REF_MEASUREMENT Rte_TrqCanc_CogTrqRplComp /end REF_MEASUREMENT /end GROUP
/begin GROUP TrqCanc.EstKe.VpRadpS_f32 "MICROSAR RTE" /begin SUB_GROUP /end SUB_GROUP /begin FUNCTION_LIST /end FUNCTION_LIST /begin REF_CHARACTERISTIC /end REF_CHARACTERISTIC /end GROUP
/begin GROUP TrqCanc.EstLd.Henry_f32 "MICROSAR RTE" /begin SUB_GROUP /end SUB_GROUP /begin FUNCTION_LIST /end FUNCTION_LIST /begin REF_CHARACTERISTIC /end REF_CHARACTERISTIC /end GROUP
/begin GROUP TrqCanc.EstLq.Henry_f32 "MICROSAR RTE" /begin SUB_GROUP /end SUB_GROUP /begin FUNCTION_LIST /end FUNCTION_LIST /begin REF_CHARACTERISTIC /end REF_CHARACTERISTIC /end GROUP
/begin GROUP TrqCanc.MRFMtrVel.MtrRadpS_f32 "MICROSAR RTE" /begin SUB_GROUP /end SUB_GROUP /begin FUNCTION_LIST /end FUNCTION_LIST /begin REF_CHARACTERISTIC /end REF_CHARACTERISTIC /end GROUP
/begin GROUP TrqCanc.MtrCurrDaxRef.Amp_f32 "MICROSAR RTE" /begin SUB_GROUP /end SUB_GROUP /begin FUNCTION_LIST /end FUNCTION_LIST /begin REF_CHARACTERISTIC /end REF_CHARACTERISTIC /end GROUP
/begin GROUP TrqCanc.MtrCurrQaxRef.Amp_f32 "MICROSAR RTE" /begin SUB_GROUP /end SUB_GROUP /begin FUNCTION_LIST /end FUNCTION_LIST /begin REF_CHARACTERISTIC /end REF_CHARACTERISTIC /end GROUP
/begin GROUP TrqCanc.MtrTrqCmdMRFScl.MtrNm_f32 "MICROSAR RTE" /begin SUB_GROUP /end SUB_GROUP /begin FUNCTION_LIST /end FUNCTION_LIST /begin REF_CHARACTERISTIC /end REF_CHARACTERISTIC /end GROUP
/begin GROUP TrqCanc.PerInstanceMemories "MICROSAR RTE" /begin SUB_GROUP TrqCanc.CogTrqCal TrqCanc.CogTrqRplComp /end SUB_GROUP /begin FUNCTION_LIST /end FUNCTION_LIST /begin REF_CHARACTERISTIC /end REF_CHARACTERISTIC /begin REF_MEASUREMENT /end REF_MEASUREMENT /end GROUP
/begin GROUP TrqCanc.ReceiverPorts "MICROSAR RTE"
 /begin SUB_GROUP TrqCanc.EstKe.VpRadpS_f32 TrqCanc.EstLd.Henry_f32 TrqCanc.EstLq.Henry_f32 TrqCanc.MRFMtrVel.MtrRadpS_f32 TrqCanc.MtrCurrDaxRef.Amp_f32 TrqCanc.MtrCurrQaxRef.Amp_f32 TrqCanc.MtrTrqCmdMRFScl.MtrNm_f32 /end SUB_GROUP
 /begin FUNCTION_LIST /end FUNCTION_LIST
 /begin REF_CHARACTERISTIC /end REF_CHARACTERISTIC
 /begin REF_MEASUREMENT /end REF_MEASUREMENT
/end GROUP
/begin GROUP TrqCmdScl "MICROSAR RTE"
 /begin SUB_GROUP TrqCmdScl.PerInstanceMemories TrqCmdScl.ReceiverPorts TrqCmdScl.SenderPorts /end SUB_GROUP
 /begin FUNCTION_LIST /end FUNCTION_LIST
 /begin REF_CHARACTERISTIC /end REF_CHARACTERISTIC
 /begin REF_MEASUREMENT /end REF_MEASUREMENT
/end GROUP
/begin GROUP TrqCmdScl.MRFMtrTrqCmd.MtrNm_f32 "MICROSAR RTE" /begin SUB_GROUP /end SUB_GROUP /begin FUNCTION_LIST /end FUNCTION_LIST /begin REF_CHARACTERISTIC /end REF_CHARACTERISTIC /end GROUP
/begin GROUP TrqCmdScl.MRFMtrTrqCmdScl.MtrNm_f32 "MICROSAR RTE" /begin SUB_GROUP /end SUB_GROUP /begin FUNCTION_LIST /end FUNCTION_LIST /begin REF_CHARACTERISTIC /end REF_CHARACTERISTIC /end GROUP
/begin GROUP TrqCmdScl.PerInstanceMemories "MICROSAR RTE" /begin SUB_GROUP TrqCmdScl.TorqueCmdSF_Uls_f32 /end SUB_GROUP /begin FUNCTION_LIST /end FUNCTION_LIST /begin REF_CHARACTERISTIC /end REF_CHARACTERISTIC /begin REF_MEASUREMENT /end REF_MEASUREMENT /end GROUP
/begin GROUP TrqCmdScl.ReceiverPorts "MICROSAR RTE" /begin SUB_GROUP TrqCmdScl.MRFMtrTrqCmd.MtrNm_f32 /end SUB_GROUP /begin FUNCTION_LIST /end FUNCTION_LIST /begin REF_CHARACTERISTIC /end REF_CHARACTERISTIC /begin REF_MEASUREMENT /end REF_MEASUREMENT /end GROUP
/begin GROUP TrqCmdScl.SenderPorts "MICROSAR RTE" /begin SUB_GROUP TrqCmdScl.MRFMtrTrqCmdScl.MtrNm_f32 /end SUB_GROUP /begin FUNCTION_LIST /end FUNCTION_LIST /begin REF_CHARACTERISTIC /end REF_CHARACTERISTIC /begin REF_MEASUREMENT /end REF_MEASUREMENT /end GROUP
/begin GROUP TrqCmdScl.TorqueCmdSF_Uls_f32 "MICROSAR RTE" /begin SUB_GROUP /end SUB_GROUP /begin FUNCTION_LIST /end FUNCTION_LIST /begin REF_CHARACTERISTIC /end REF_CHARACTERISTIC /begin REF_MEASUREMENT Rte_TrqCmdScl_TorqueCmdSF_Uls_f32 /end REF_MEASUREMENT /end GROUP
/begin GROUP TrqLOA "MICROSAR RTE" /begin SUB_GROUP TrqLOA.ReceiverPorts TrqLOA.SenderPorts /end SUB_GROUP /begin FUNCTION_LIST /end FUNCTION_LIST /begin REF_CHARACTERISTIC /end REF_CHARACTERISTIC /begin REF_MEASUREMENT /end REF_MEASUREMENT /end GROUP
/begin GROUP TrqLOA.HandwheelAuthority.Uls_f32 "MICROSAR RTE" /begin SUB_GROUP /end SUB_GROUP /begin FUNCTION_LIST /end FUNCTION_LIST /begin REF_CHARACTERISTIC /end REF_CHARACTERISTIC /end GROUP
/begin GROUP TrqLOA.HandwheelPosition.HwDeg_f32 "MICROSAR RTE" /begin SUB_GROUP /end SUB_GROUP /begin FUNCTION_LIST /end FUNCTION_LIST /begin REF_CHARACTERISTIC /end REF_CHARACTERISTIC /end GROUP
/begin GROUP TrqLOA.MotAgLoaMtgtnEn.Cnt_lgc "MICROSAR RTE" /begin SUB_GROUP /end SUB_GROUP /begin FUNCTION_LIST /end FUNCTION_LIST /begin REF_CHARACTERISTIC /end REF_CHARACTERISTIC /end GROUP
/begin GROUP TrqLOA.MtrVelCRF.MtrRadpS_f32 "MICROSAR RTE" /begin SUB_GROUP /end SUB_GROUP /begin FUNCTION_LIST /end FUNCTION_LIST /begin REF_CHARACTERISTIC /end REF_CHARACTERISTIC /end GROUP
/begin GROUP TrqLOA.ReceiverPorts "MICROSAR RTE"
 /begin SUB_GROUP TrqLOA.HandwheelAuthority.Uls_f32 TrqLOA.HandwheelPosition.HwDeg_f32 TrqLOA.MotAgLoaMtgtnEn.Cnt_lgc TrqLOA.MtrVelCRF.MtrRadpS_f32 TrqLOA.TrqLoaDi.Cnt_lgc TrqLOA.VehWhlBas.mm_f32 TrqLOA.VehWhlBasVld.Cnt_lgc TrqLOA.VehicleLatAccel.MpSecSq_f32 TrqLOA.VehicleLatAccelValid.Cnt_lgc TrqLOA.VehicleSpeed.Kph_f32 TrqLOA.VehicleSpeedValid.Cnt_lgc /end SUB_GROUP
 /begin FUNCTION_LIST /end FUNCTION_LIST
 /begin REF_CHARACTERISTIC /end REF_CHARACTERISTIC
 /begin REF_MEASUREMENT /end REF_MEASUREMENT
/end GROUP
/begin GROUP TrqLOA.SenderPorts "MICROSAR RTE" /begin SUB_GROUP TrqLOA.TrqLOAAvail.Cnt_lgc TrqLOA.TrqLOACmd.MtrNm_f32 /end SUB_GROUP /begin FUNCTION_LIST /end FUNCTION_LIST /begin REF_CHARACTERISTIC /end REF_CHARACTERISTIC /begin REF_MEASUREMENT /end REF_MEASUREMENT /end GROUP
/begin GROUP TrqLOA.TrqLOAAvail.Cnt_lgc "MICROSAR RTE" /begin SUB_GROUP /end SUB_GROUP /begin FUNCTION_LIST /end FUNCTION_LIST /begin REF_CHARACTERISTIC /end REF_CHARACTERISTIC /end GROUP
/begin GROUP TrqLOA.TrqLOACmd.MtrNm_f32 "MICROSAR RTE" /begin SUB_GROUP /end SUB_GROUP /begin FUNCTION_LIST /end FUNCTION_LIST /begin REF_CHARACTERISTIC /end REF_CHARACTERISTIC /end GROUP
/begin GROUP TrqLOA.TrqLoaDi.Cnt_lgc "MICROSAR RTE" /begin SUB_GROUP /end SUB_GROUP /begin FUNCTION_LIST /end FUNCTION_LIST /begin REF_CHARACTERISTIC /end REF_CHARACTERISTIC /begin REF_MEASUREMENT Rte_TrqLOA_TrqLoaDi_Cnt_lgc /end REF_MEASUREMENT /end GROUP
/begin GROUP TrqLOA.VehWhlBas.mm_f32 "MICROSAR RTE" /begin SUB_GROUP /end SUB_GROUP /begin FUNCTION_LIST /end FUNCTION_LIST /begin REF_CHARACTERISTIC /end REF_CHARACTERISTIC /begin REF_MEASUREMENT Rte_TrqLOA_VehWhlBas_mm_f32 /end REF_MEASUREMENT /end GROUP
/begin GROUP TrqLOA.VehWhlBasVld.Cnt_lgc "MICROSAR RTE" /begin SUB_GROUP /end SUB_GROUP /begin FUNCTION_LIST /end FUNCTION_LIST /begin REF_CHARACTERISTIC /end REF_CHARACTERISTIC /begin REF_MEASUREMENT Rte_TrqLOA_VehWhlBasVld_Cnt_lgc /end REF_MEASUREMENT /end GROUP
/begin GROUP TrqLOA.VehicleLatAccel.MpSecSq_f32 "MICROSAR RTE" /begin SUB_GROUP /end SUB_GROUP /begin FUNCTION_LIST /end FUNCTION_LIST /begin REF_CHARACTERISTIC /end REF_CHARACTERISTIC /end GROUP
/begin GROUP TrqLOA.VehicleLatAccelValid.Cnt_lgc "MICROSAR RTE" /begin SUB_GROUP /end SUB_GROUP /begin FUNCTION_LIST /end FUNCTION_LIST /begin REF_CHARACTERISTIC /end REF_CHARACTERISTIC /begin REF_MEASUREMENT Rte_SrlComInput_VehicleLatAccelValid_Cnt_lgc /end REF_MEASUREMENT /end GROUP
/begin GROUP TrqLOA.VehicleSpeed.Kph_f32 "MICROSAR RTE" /begin SUB_GROUP /end SUB_GROUP /begin FUNCTION_LIST /end FUNCTION_LIST /begin REF_CHARACTERISTIC /end REF_CHARACTERISTIC /end GROUP
/begin GROUP TrqLOA.VehicleSpeedValid.Cnt_lgc "MICROSAR RTE" /begin SUB_GROUP /end SUB_GROUP /begin FUNCTION_LIST /end FUNCTION_LIST /begin REF_CHARACTERISTIC /end REF_CHARACTERISTIC /end GROUP
/begin GROUP TuningSelAuth "MICROSAR RTE" /begin SUB_GROUP TuningSelAuth.ReceiverPorts TuningSelAuth.SenderPorts /end SUB_GROUP /begin FUNCTION_LIST /end FUNCTION_LIST /begin REF_CHARACTERISTIC /end REF_CHARACTERISTIC /begin REF_MEASUREMENT /end REF_MEASUREMENT /end GROUP
/begin GROUP TuningSelAuth.ActiveTunOvrPtrAddr.Cnt_u32 "MICROSAR RTE" /begin SUB_GROUP /end SUB_GROUP /begin FUNCTION_LIST /end FUNCTION_LIST /begin REF_CHARACTERISTIC /end REF_CHARACTERISTIC /end GROUP
/begin GROUP TuningSelAuth.ActiveTunPers.Cnt_u16 "MICROSAR RTE" /begin SUB_GROUP /end SUB_GROUP /begin FUNCTION_LIST /end FUNCTION_LIST /begin REF_CHARACTERISTIC /end REF_CHARACTERISTIC /end GROUP
/begin GROUP TuningSelAuth.ActiveTunSet.Cnt_u16 "MICROSAR RTE" /begin SUB_GROUP /end SUB_GROUP /begin FUNCTION_LIST /end FUNCTION_LIST /begin REF_CHARACTERISTIC /end REF_CHARACTERISTIC /end GROUP
/begin GROUP TuningSelAuth.DesiredTunPers.Cnt_u16 "MICROSAR RTE" /begin SUB_GROUP /end SUB_GROUP /begin FUNCTION_LIST /end FUNCTION_LIST /begin REF_CHARACTERISTIC /end REF_CHARACTERISTIC /end GROUP
/begin GROUP TuningSelAuth.DesiredTunSet.Cnt_u16 "MICROSAR RTE" /begin SUB_GROUP /end SUB_GROUP /begin FUNCTION_LIST /end FUNCTION_LIST /begin REF_CHARACTERISTIC /end REF_CHARACTERISTIC /end GROUP
/begin GROUP TuningSelAuth.HandwheelVelocity.HwRadpS_f32 "MICROSAR RTE" /begin SUB_GROUP /end SUB_GROUP /begin FUNCTION_LIST /end FUNCTION_LIST /begin REF_CHARACTERISTIC /end REF_CHARACTERISTIC /end GROUP
/begin GROUP TuningSelAuth.HwTorque.HwNm_f32 "MICROSAR RTE" /begin SUB_GROUP /end SUB_GROUP /begin FUNCTION_LIST /end FUNCTION_LIST /begin REF_CHARACTERISTIC /end REF_CHARACTERISTIC /end GROUP
/begin GROUP TuningSelAuth.ReceiverPorts "MICROSAR RTE"
 /begin SUB_GROUP TuningSelAuth.ActiveTunOvrPtrAddr.Cnt_u32 TuningSelAuth.DesiredTunPers.Cnt_u16 TuningSelAuth.DesiredTunSet.Cnt_u16 TuningSelAuth.HandwheelVelocity.HwRadpS_f32 TuningSelAuth.HwTorque.HwNm_f32 TuningSelAuth.TuningSessionActPtr.Cnt_u8 TuningSelAuth.VehicleSpeed.Kph_f32 /end SUB_GROUP
 /begin FUNCTION_LIST /end FUNCTION_LIST
 /begin REF_CHARACTERISTIC /end REF_CHARACTERISTIC
 /begin REF_MEASUREMENT /end REF_MEASUREMENT
/end GROUP
/begin GROUP TuningSelAuth.SenderPorts "MICROSAR RTE"
 /begin SUB_GROUP TuningSelAuth.ActiveTunPers.Cnt_u16 TuningSelAuth.ActiveTunSet.Cnt_u16 TuningSelAuth.TunReqGranted.Cnt_lgc /end SUB_GROUP
 /begin FUNCTION_LIST /end FUNCTION_LIST
 /begin REF_CHARACTERISTIC /end REF_CHARACTERISTIC
 /begin REF_MEASUREMENT /end REF_MEASUREMENT
/end GROUP
/begin GROUP TuningSelAuth.TunReqGranted.Cnt_lgc "MICROSAR RTE" /begin SUB_GROUP /end SUB_GROUP /begin FUNCTION_LIST /end FUNCTION_LIST /begin REF_CHARACTERISTIC /end REF_CHARACTERISTIC /end GROUP
/begin GROUP TuningSelAuth.TuningSessionActPtr.Cnt_u8 "MICROSAR RTE" /begin SUB_GROUP /end SUB_GROUP /begin FUNCTION_LIST /end FUNCTION_LIST /begin REF_CHARACTERISTIC /end REF_CHARACTERISTIC /end GROUP
/begin GROUP TuningSelAuth.VehicleSpeed.Kph_f32 "MICROSAR RTE" /begin SUB_GROUP /end SUB_GROUP /begin FUNCTION_LIST /end FUNCTION_LIST /begin REF_CHARACTERISTIC /end REF_CHARACTERISTIC /end GROUP
/begin GROUP VehDyn "MICROSAR RTE"
 /begin SUB_GROUP VehDyn.ModeRequirePorts VehDyn.PerInstanceMemories VehDyn.ReceiverPorts VehDyn.SenderPorts /end SUB_GROUP
 /begin FUNCTION_LIST /end FUNCTION_LIST
 /begin REF_CHARACTERISTIC /end REF_CHARACTERISTIC
 /begin REF_MEASUREMENT /end REF_MEASUREMENT
/end GROUP
/begin GROUP VehDyn.CCWPosition.HwDeg_f32 "MICROSAR RTE" /begin SUB_GROUP /end SUB_GROUP /begin FUNCTION_LIST /end FUNCTION_LIST /begin REF_CHARACTERISTIC /end REF_CHARACTERISTIC /end GROUP
/begin GROUP VehDyn.CWPosition.HwDeg_f32 "MICROSAR RTE" /begin SUB_GROUP /end SUB_GROUP /begin FUNCTION_LIST /end FUNCTION_LIST /begin REF_CHARACTERISTIC /end REF_CHARACTERISTIC /end GROUP
/begin GROUP VehDyn.HandwheelPosition.HwDeg_f32 "MICROSAR RTE" /begin SUB_GROUP /end SUB_GROUP /begin FUNCTION_LIST /end FUNCTION_LIST /begin REF_CHARACTERISTIC /end REF_CHARACTERISTIC /end GROUP
/begin GROUP VehDyn.HwAuth.Uls_f32 "MICROSAR RTE" /begin SUB_GROUP /end SUB_GROUP /begin FUNCTION_LIST /end FUNCTION_LIST /begin REF_CHARACTERISTIC /end REF_CHARACTERISTIC /end GROUP
/begin GROUP VehDyn.HwTorque.HwNm_f32 "MICROSAR RTE" /begin SUB_GROUP /end SUB_GROUP /begin FUNCTION_LIST /end FUNCTION_LIST /begin REF_CHARACTERISTIC /end REF_CHARACTERISTIC /end GROUP
/begin GROUP VehDyn.ModeRequirePorts "MICROSAR RTE" /begin SUB_GROUP VehDyn.SystemState.Mode /end SUB_GROUP /begin FUNCTION_LIST /end FUNCTION_LIST /begin REF_CHARACTERISTIC /end REF_CHARACTERISTIC /begin REF_MEASUREMENT /end REF_MEASUREMENT /end GROUP
/begin GROUP VehDyn.MotPosReset "MICROSAR RTE" /begin SUB_GROUP /end SUB_GROUP /begin FUNCTION_LIST /end FUNCTION_LIST /begin REF_CHARACTERISTIC /end REF_CHARACTERISTIC
 /begin REF_MEASUREMENT Rte_VehDyn_MotPosReset.NVMStoredLastPosValid_Cnt_lgc Rte_VehDyn_MotPosReset.NVMStoredLastPos_HwDeg_f32 /end REF_MEASUREMENT
/end GROUP
/begin GROUP VehDyn.MtrVelCRF.MtrRadpS_f32 "MICROSAR RTE" /begin SUB_GROUP /end SUB_GROUP /begin FUNCTION_LIST /end FUNCTION_LIST /begin REF_CHARACTERISTIC /end REF_CHARACTERISTIC /end GROUP
/begin GROUP VehDyn.PerInstanceMemories "MICROSAR RTE" /begin SUB_GROUP VehDyn.MotPosReset /end SUB_GROUP /begin FUNCTION_LIST /end FUNCTION_LIST /begin REF_CHARACTERISTIC /end REF_CHARACTERISTIC /begin REF_MEASUREMENT /end REF_MEASUREMENT /end GROUP
/begin GROUP VehDyn.ReceiverPorts "MICROSAR RTE"
 /begin SUB_GROUP VehDyn.CCWPosition.HwDeg_f32 VehDyn.CWPosition.HwDeg_f32 VehDyn.HandwheelPosition.HwDeg_f32 VehDyn.HwAuth.Uls_f32 VehDyn.HwTorque.HwNm_f32 VehDyn.MtrVelCRF.MtrRadpS_f32 VehDyn.RelHwPos.HwDeg_f32 VehDyn.SrlHwAg.HwDeg_f32 VehDyn.SrlHwAgVld.Cnt_lgc VehDyn.TorqueCmdCRF.MtrNm_f32 VehDyn.VehicleSpeed.Kph_f32 VehDyn.VehicleSpeedValid.Cnt_lgc /end SUB_GROUP
 /begin FUNCTION_LIST /end FUNCTION_LIST
 /begin REF_CHARACTERISTIC /end REF_CHARACTERISTIC
 /begin REF_MEASUREMENT /end REF_MEASUREMENT
/end GROUP
/begin GROUP VehDyn.RelHwPos.HwDeg_f32 "MICROSAR RTE" /begin SUB_GROUP /end SUB_GROUP /begin FUNCTION_LIST /end FUNCTION_LIST /begin REF_CHARACTERISTIC /end REF_CHARACTERISTIC /end GROUP
/begin GROUP VehDyn.SenderPorts "MICROSAR RTE"
 /begin SUB_GROUP VehDyn.SensorlessAuthority.Uls_f32 VehDyn.SensorlessHwPos.HwDeg_f32 /end SUB_GROUP
 /begin FUNCTION_LIST /end FUNCTION_LIST
 /begin REF_CHARACTERISTIC /end REF_CHARACTERISTIC
 /begin REF_MEASUREMENT /end REF_MEASUREMENT
/end GROUP
/begin GROUP VehDyn.SensorlessAuthority.Uls_f32 "MICROSAR RTE" /begin SUB_GROUP /end SUB_GROUP /begin FUNCTION_LIST /end FUNCTION_LIST /begin REF_CHARACTERISTIC /end REF_CHARACTERISTIC /end GROUP
/begin GROUP VehDyn.SensorlessHwPos.HwDeg_f32 "MICROSAR RTE" /begin SUB_GROUP /end SUB_GROUP /begin FUNCTION_LIST /end FUNCTION_LIST /begin REF_CHARACTERISTIC /end REF_CHARACTERISTIC /end GROUP
/begin GROUP VehDyn.SrlHwAg.HwDeg_f32 "MICROSAR RTE" /begin SUB_GROUP /end SUB_GROUP /begin FUNCTION_LIST /end FUNCTION_LIST /begin REF_CHARACTERISTIC /end REF_CHARACTERISTIC /begin REF_MEASUREMENT Rte_SrlComInput_AngleVolant_HwDeg_f32 /end REF_MEASUREMENT /end GROUP
/begin GROUP VehDyn.SrlHwAgVld.Cnt_lgc "MICROSAR RTE" /begin SUB_GROUP /end SUB_GROUP /begin FUNCTION_LIST /end FUNCTION_LIST /begin REF_CHARACTERISTIC /end REF_CHARACTERISTIC /begin REF_MEASUREMENT Rte_SrlComInput_SerialComAngleValid_Cnt_lgc /end REF_MEASUREMENT /end GROUP
/begin GROUP VehDyn.SystemState.Mode "MICROSAR RTE" /begin SUB_GROUP /end SUB_GROUP /begin FUNCTION_LIST /end FUNCTION_LIST /begin REF_CHARACTERISTIC /end REF_CHARACTERISTIC /end GROUP
/begin GROUP VehDyn.TorqueCmdCRF.MtrNm_f32 "MICROSAR RTE" /begin SUB_GROUP /end SUB_GROUP /begin FUNCTION_LIST /end FUNCTION_LIST /begin REF_CHARACTERISTIC /end REF_CHARACTERISTIC /end GROUP
/begin GROUP VehDyn.VehicleSpeed.Kph_f32 "MICROSAR RTE" /begin SUB_GROUP /end SUB_GROUP /begin FUNCTION_LIST /end FUNCTION_LIST /begin REF_CHARACTERISTIC /end REF_CHARACTERISTIC /end GROUP
/begin GROUP VehDyn.VehicleSpeedValid.Cnt_lgc "MICROSAR RTE" /begin SUB_GROUP /end SUB_GROUP /begin FUNCTION_LIST /end FUNCTION_LIST /begin REF_CHARACTERISTIC /end REF_CHARACTERISTIC /end GROUP
/begin GROUP VehPwrMd "MICROSAR RTE"
 /begin SUB_GROUP VehPwrMd.ModeRequirePorts VehPwrMd.ReceiverPorts VehPwrMd.SenderPorts /end SUB_GROUP
 /begin FUNCTION_LIST /end FUNCTION_LIST
 /begin REF_CHARACTERISTIC /end REF_CHARACTERISTIC
 /begin REF_MEASUREMENT /end REF_MEASUREMENT
/end GROUP
/begin GROUP VehPwrMd.ATermActive.Cnt_lgc "MICROSAR RTE" /begin SUB_GROUP /end SUB_GROUP /begin FUNCTION_LIST /end FUNCTION_LIST /begin REF_CHARACTERISTIC /end REF_CHARACTERISTIC /begin REF_MEASUREMENT Rte_VehPwrMd_ATermActive_Cnt_lgc /end REF_MEASUREMENT /end GROUP
/begin GROUP VehPwrMd.CTermActive.Cnt_lgc "MICROSAR RTE" /begin SUB_GROUP /end SUB_GROUP /begin FUNCTION_LIST /end FUNCTION_LIST /begin REF_CHARACTERISTIC /end REF_CHARACTERISTIC /end GROUP
/begin GROUP VehPwrMd.DmdDelestDASts.Cnt_u08 "MICROSAR RTE" /begin SUB_GROUP /end SUB_GROUP /begin FUNCTION_LIST /end FUNCTION_LIST /begin REF_CHARACTERISTIC /end REF_CHARACTERISTIC /end GROUP
/begin GROUP VehPwrMd.DmdDelestDaVld.Cnt_lgc "MICROSAR RTE" /begin SUB_GROUP /end SUB_GROUP /begin FUNCTION_LIST /end FUNCTION_LIST /begin REF_CHARACTERISTIC /end REF_CHARACTERISTIC /begin REF_MEASUREMENT Rte_SrlComInput_DmdDelestDaVld_Cnt_lgc /end REF_MEASUREMENT /end GROUP
/begin GROUP VehPwrMd.EngONSrlComSvcDft.Cnt_lgc "MICROSAR RTE" /begin SUB_GROUP /end SUB_GROUP /begin FUNCTION_LIST /end FUNCTION_LIST /begin REF_CHARACTERISTIC /end REF_CHARACTERISTIC /end GROUP
/begin GROUP VehPwrMd.EngOn.Cnt_lgc "MICROSAR RTE" /begin SUB_GROUP /end SUB_GROUP /begin FUNCTION_LIST /end FUNCTION_LIST /begin REF_CHARACTERISTIC /end REF_CHARACTERISTIC /end GROUP
/begin GROUP VehPwrMd.EtatMT.Cnt_u08 "MICROSAR RTE" /begin SUB_GROUP /end SUB_GROUP /begin FUNCTION_LIST /end FUNCTION_LIST /begin REF_CHARACTERISTIC /end REF_CHARACTERISTIC /end GROUP
/begin GROUP VehPwrMd.MEC.Cnt_enum "MICROSAR RTE" /begin SUB_GROUP /end SUB_GROUP /begin FUNCTION_LIST /end FUNCTION_LIST /begin REF_CHARACTERISTIC /end REF_CHARACTERISTIC /end GROUP
/begin GROUP VehPwrMd.ModeRequirePorts "MICROSAR RTE" /begin SUB_GROUP VehPwrMd.SystemState.Mode /end SUB_GROUP /begin FUNCTION_LIST /end FUNCTION_LIST /begin REF_CHARACTERISTIC /end REF_CHARACTERISTIC /begin REF_MEASUREMENT /end REF_MEASUREMENT /end GROUP
/begin GROUP VehPwrMd.OperRampRate.XpmS_f32 "MICROSAR RTE" /begin SUB_GROUP /end SUB_GROUP /begin FUNCTION_LIST /end FUNCTION_LIST /begin REF_CHARACTERISTIC /end REF_CHARACTERISTIC /begin REF_MEASUREMENT Rte_VehPwrMd_OperRampRate_XpmS_f32 /end REF_MEASUREMENT /end GROUP
/begin GROUP VehPwrMd.OperRampValue.Uls_f32 "MICROSAR RTE" /begin SUB_GROUP /end SUB_GROUP /begin FUNCTION_LIST /end FUNCTION_LIST /begin REF_CHARACTERISTIC /end REF_CHARACTERISTIC /begin REF_MEASUREMENT Rte_VehPwrMd_OperRampValue_Uls_f32 /end REF_MEASUREMENT /end GROUP
/begin GROUP VehPwrMd.OutputRampMult.Uls_f32 "MICROSAR RTE" /begin SUB_GROUP /end SUB_GROUP /begin FUNCTION_LIST /end FUNCTION_LIST /begin REF_CHARACTERISTIC /end REF_CHARACTERISTIC /end GROUP
/begin GROUP VehPwrMd.RampDwnStatusComplete.Cnt_lgc "MICROSAR RTE" /begin SUB_GROUP /end SUB_GROUP /begin FUNCTION_LIST /end FUNCTION_LIST /begin REF_CHARACTERISTIC /end REF_CHARACTERISTIC /begin REF_MEASUREMENT Rte_StOpCtrl_SysStReqDi_Cnt_lgc /end REF_MEASUREMENT /end GROUP
/begin GROUP VehPwrMd.ReceiverPorts "MICROSAR RTE"
 /begin SUB_GROUP VehPwrMd.DmdDelestDASts.Cnt_u08 VehPwrMd.DmdDelestDaVld.Cnt_lgc VehPwrMd.EngONSrlComSvcDft.Cnt_lgc VehPwrMd.EngOn.Cnt_lgc VehPwrMd.EtatMT.Cnt_u08 VehPwrMd.MEC.Cnt_enum VehPwrMd.OutputRampMult.Uls_f32 VehPwrMd.RampDwnStatusComplete.Cnt_lgc VehPwrMd.STTdSelected.Cnt_lgc VehPwrMd.SrlComVehSpd.Kph_f32 VehPwrMd.VehSpdValid.Cnt_lgc /end SUB_GROUP
 /begin FUNCTION_LIST /end FUNCTION_LIST
 /begin REF_CHARACTERISTIC /end REF_CHARACTERISTIC
 /begin REF_MEASUREMENT /end REF_MEASUREMENT
/end GROUP
/begin GROUP VehPwrMd.STTdSelected.Cnt_lgc "MICROSAR RTE" /begin SUB_GROUP /end SUB_GROUP /begin FUNCTION_LIST /end FUNCTION_LIST /begin REF_CHARACTERISTIC /end REF_CHARACTERISTIC /end GROUP
/begin GROUP VehPwrMd.SenderPorts "MICROSAR RTE"
 /begin SUB_GROUP VehPwrMd.ATermActive.Cnt_lgc VehPwrMd.CTermActive.Cnt_lgc VehPwrMd.OperRampRate.XpmS_f32 VehPwrMd.OperRampValue.Uls_f32 /end SUB_GROUP
 /begin FUNCTION_LIST /end FUNCTION_LIST
 /begin REF_CHARACTERISTIC /end REF_CHARACTERISTIC
 /begin REF_MEASUREMENT /end REF_MEASUREMENT
/end GROUP
/begin GROUP VehPwrMd.SrlComVehSpd.Kph_f32 "MICROSAR RTE" /begin SUB_GROUP /end SUB_GROUP /begin FUNCTION_LIST /end FUNCTION_LIST /begin REF_CHARACTERISTIC /end REF_CHARACTERISTIC /end GROUP
/begin GROUP VehPwrMd.SystemState.Mode "MICROSAR RTE" /begin SUB_GROUP /end SUB_GROUP /begin FUNCTION_LIST /end FUNCTION_LIST /begin REF_CHARACTERISTIC /end REF_CHARACTERISTIC /end GROUP
/begin GROUP VehPwrMd.VehSpdValid.Cnt_lgc "MICROSAR RTE" /begin SUB_GROUP /end SUB_GROUP /begin FUNCTION_LIST /end FUNCTION_LIST /begin REF_CHARACTERISTIC /end REF_CHARACTERISTIC /end GROUP
/begin GROUP VehSpdLmt "MICROSAR RTE" /begin SUB_GROUP VehSpdLmt.ReceiverPorts VehSpdLmt.SenderPorts /end SUB_GROUP /begin FUNCTION_LIST /end FUNCTION_LIST /begin REF_CHARACTERISTIC /end REF_CHARACTERISTIC /begin REF_MEASUREMENT /end REF_MEASUREMENT /end GROUP
/begin GROUP VehSpdLmt.AstVehSpdLimit.MtrNm_f32 "MICROSAR RTE" /begin SUB_GROUP /end SUB_GROUP /begin FUNCTION_LIST /end FUNCTION_LIST /begin REF_CHARACTERISTIC /end REF_CHARACTERISTIC /end GROUP
/begin GROUP VehSpdLmt.CCWPosition.HwDeg_f32 "MICROSAR RTE" /begin SUB_GROUP /end SUB_GROUP /begin FUNCTION_LIST /end FUNCTION_LIST /begin REF_CHARACTERISTIC /end REF_CHARACTERISTIC /end GROUP
/begin GROUP VehSpdLmt.CWPosition.HwDeg_f32 "MICROSAR RTE" /begin SUB_GROUP /end SUB_GROUP /begin FUNCTION_LIST /end FUNCTION_LIST /begin REF_CHARACTERISTIC /end REF_CHARACTERISTIC /end GROUP
/begin GROUP VehSpdLmt.HwPos.HwDeg_f32 "MICROSAR RTE" /begin SUB_GROUP /end SUB_GROUP /begin FUNCTION_LIST /end FUNCTION_LIST /begin REF_CHARACTERISTIC /end REF_CHARACTERISTIC /end GROUP
/begin GROUP VehSpdLmt.HwPosAuth.Uls_f32 "MICROSAR RTE" /begin SUB_GROUP /end SUB_GROUP /begin FUNCTION_LIST /end FUNCTION_LIST /begin REF_CHARACTERISTIC /end REF_CHARACTERISTIC /end GROUP
/begin GROUP VehSpdLmt.ReceiverPorts "MICROSAR RTE"
 /begin SUB_GROUP VehSpdLmt.CCWPosition.HwDeg_f32 VehSpdLmt.CWPosition.HwDeg_f32 VehSpdLmt.HwPos.HwDeg_f32 VehSpdLmt.HwPosAuth.Uls_f32 VehSpdLmt.VehSpd.Kph_f32 /end SUB_GROUP
 /begin FUNCTION_LIST /end FUNCTION_LIST
 /begin REF_CHARACTERISTIC /end REF_CHARACTERISTIC
 /begin REF_MEASUREMENT /end REF_MEASUREMENT
/end GROUP
/begin GROUP VehSpdLmt.SenderPorts "MICROSAR RTE" /begin SUB_GROUP VehSpdLmt.AstVehSpdLimit.MtrNm_f32 /end SUB_GROUP /begin FUNCTION_LIST /end FUNCTION_LIST /begin REF_CHARACTERISTIC /end REF_CHARACTERISTIC /begin REF_MEASUREMENT /end REF_MEASUREMENT /end GROUP
/begin GROUP VehSpdLmt.VehSpd.Kph_f32 "MICROSAR RTE" /begin SUB_GROUP /end SUB_GROUP /begin FUNCTION_LIST /end FUNCTION_LIST /begin REF_CHARACTERISTIC /end REF_CHARACTERISTIC /end GROUP
/begin GROUP ePWM2 "MICROSAR RTE" /begin SUB_GROUP ePWM2.ModeRequirePorts ePWM2.ReceiverPorts /end SUB_GROUP /begin FUNCTION_LIST /end FUNCTION_LIST /begin REF_CHARACTERISTIC /end REF_CHARACTERISTIC /begin REF_MEASUREMENT /end REF_MEASUREMENT /end GROUP
/begin GROUP ePWM2.CtrldDmpStsCmp.Cnt_lgc "MICROSAR RTE" /begin SUB_GROUP /end SUB_GROUP /begin FUNCTION_LIST /end FUNCTION_LIST /begin REF_CHARACTERISTIC /end REF_CHARACTERISTIC /begin REF_MEASUREMENT Rte_TranlDampg_CntrlDampComp_Cnt_lgc /end REF_MEASUREMENT /end GROUP
/begin GROUP ePWM2.DiagStsCtrldDisRmpPres.Cnt_lgc "MICROSAR RTE" /begin SUB_GROUP /end SUB_GROUP /begin FUNCTION_LIST /end FUNCTION_LIST /begin REF_CHARACTERISTIC /end REF_CHARACTERISTIC /end GROUP
/begin GROUP ePWM2.DiagStsNonRecRmpToZeroFltPres.Cnt_lgc "MICROSAR RTE" /begin SUB_GROUP /end SUB_GROUP /begin FUNCTION_LIST /end FUNCTION_LIST /begin REF_CHARACTERISTIC /end REF_CHARACTERISTIC /end GROUP
/begin GROUP ePWM2.ModeRequirePorts "MICROSAR RTE" /begin SUB_GROUP ePWM2.SystemState.Mode /end SUB_GROUP /begin FUNCTION_LIST /end FUNCTION_LIST /begin REF_CHARACTERISTIC /end REF_CHARACTERISTIC /begin REF_MEASUREMENT /end REF_MEASUREMENT /end GROUP
/begin GROUP ePWM2.RampDwnStatusComplete.Cnt_lgc "MICROSAR RTE" /begin SUB_GROUP /end SUB_GROUP /begin FUNCTION_LIST /end FUNCTION_LIST /begin REF_CHARACTERISTIC /end REF_CHARACTERISTIC /begin REF_MEASUREMENT Rte_StOpCtrl_SysStReqDi_Cnt_lgc /end REF_MEASUREMENT /end GROUP
/begin GROUP ePWM2.ReceiverPorts "MICROSAR RTE"
 /begin SUB_GROUP ePWM2.CtrldDmpStsCmp.Cnt_lgc ePWM2.DiagStsCtrldDisRmpPres.Cnt_lgc ePWM2.DiagStsNonRecRmpToZeroFltPres.Cnt_lgc ePWM2.RampDwnStatusComplete.Cnt_lgc /end SUB_GROUP
 /begin FUNCTION_LIST /end FUNCTION_LIST
 /begin REF_CHARACTERISTIC /end REF_CHARACTERISTIC
 /begin REF_MEASUREMENT /end REF_MEASUREMENT
/end GROUP
/begin GROUP ePWM2.SystemState.Mode "MICROSAR RTE" /begin SUB_GROUP /end SUB_GROUP /begin FUNCTION_LIST /end FUNCTION_LIST /begin REF_CHARACTERISTIC /end REF_CHARACTERISTIC /end GROUP
/begin RECORD_LAYOUT RTE_RL_FLOAT32_IEEE FNC_VALUES 1 FLOAT32_IEEE ROW_DIR DIRECT /end RECORD_LAYOUT
/begin RECORD_LAYOUT RTE_RL_FLOAT64_IEEE FNC_VALUES 1 FLOAT64_IEEE ROW_DIR DIRECT /end RECORD_LAYOUT
/begin RECORD_LAYOUT RTE_RL_BOOLEAN FNC_VALUES 1 UBYTE ROW_DIR DIRECT /end RECORD_LAYOUT
/**********************************************************************************************************************
* COMPU_METHOD / COMPU_VTAB_RANGE
*********************************************************************************************************************/
/begin COMPU_METHOD RTE_CM_BOOLEAN "" TAB_VERB "%3.1" "" COMPU_TAB_REF RTE_CM_BOOLEAN /end COMPU_METHOD
/begin COMPU_VTAB_RANGE RTE_CM_BOOLEAN "" 2 0 0 "false" 1 255 "true" /end COMPU_VTAB_RANGE
/begin COMPU_METHOD RTE_CM_STRING "" TAB_VERB "%.1" "" COMPU_TAB_REF RTE_CM_STRING /end COMPU_METHOD
/begin COMPU_VTAB_RANGE RTE_CM_STRING "" 256 0 31 "UNDEFINED" 32 32 " " 33 33 "!" 34 34 "\"" 35 35 "#" 36 36 "$" 37 37 "%" 38 38 "&" 39 39 "'" 40 40 "(" 41 41 ")" 42 42 "*" 43 43 "+" 44 44 "," 45 45 "-" 46 46 "." 47 47 "/" 48 48 "0" 49 49 "1" 50 50 "2" 51 51 "3" 52 52 "4" 53 53 "5" 54 54 "6" 55 55 "7" 56 56 "8" 57 57 "9" 58 58 ":" 59 59 ";" 60 60 "<" 61 61 "=" 62 62 ">" 63 63 "?" 64 64 "@" 65 65 "A" 66 66 "B" 67 67 "C" 68 68 "D" 69 69 "E" 70 70 "F" 71 71 "G" 72 72 "H" 73 73 "I" 74 74 "J" 75 75 "K" 76 76 "L" 77 77 "M" 78 78 "N" 79 79 "O" 80 80 "P" 81 81 "Q" 82 82 "R" 83 83 "S" 84 84 "T" 85 85 "U" 86 86 "V" 87 87 "W" 88 88 "X" 89 89 "Y" 90 90 "Z" 91 91 "[" 92 92 "\\" 93 93 "]" 94 94 "^" 95 95 "_" 96 96 "`" 97 97 "a" 98 98 "b" 99 99 "c" 100 100 "d" 101 101 "e" 102 102 "f" 103 103 "g" 104 104 "h" 105 105 "i" 106 106 "j" 107 107 "k" 108 108 "l" 109 109 "m" 110 110 "n" 111 111 "o" 112 112 "p" 113 113 "q" 114 114 "r" 115 115 "s" 116 116 "t" 117 117 "u" 118 118 "v" 119 119 "w" 120 120 "x" 121 121 "y" 122 122 "z" 123 123 "{" 124 124 "|" 125 125 "}" 126 126 "~" 127 255 "UNDEFINED" /end COMPU_VTAB_RANGE
/begin COMPU_METHOD RTE_CM_CPLE_VOLANT "" RAT_FUNC "%." "Nm" COEFFS 0 4 0 0 0 1 /end COMPU_METHOD
/begin COMPU_METHOD RTE_CM_EPS_STATE_LKA "" RAT_FUNC "%." "" COEFFS 0 1 0 0 0 1 /end COMPU_METHOD
/begin COMPU_METHOD RTE_CM_ETAT_DA_2004 "" RAT_FUNC "%." "" COEFFS 0 1 0 0 0 1 /end COMPU_METHOD
/begin COMPU_METHOD RTE_CM_ETAT_DA_2010 "" RAT_FUNC "%." "" COEFFS 0 1 0 0 0 1 /end COMPU_METHOD
/begin COMPU_METHOD RTE_CM_ETAT_DA_DYN "" RAT_FUNC "%." "" COEFFS 0 1 0 0 0 1 /end COMPU_METHOD
/begin COMPU_METHOD RTE_CM_ANGLE_COLONNE "" RAT_FUNC "%." "Deg" COEFFS 0 10 0 0 0 1 /end COMPU_METHOD
/begin COMPU_METHOD RTE_CM_CAUSE_DESACTIV_CPK "" RAT_FUNC "%." "" COEFFS 0 1 0 0 0 1 /end COMPU_METHOD
/begin COMPU_METHOD RTE_CM_CPLE_VOLANT_OPTMSE "" RAT_FUNC "%." "Nm" COEFFS 0 10 0 0 0 1 /end COMPU_METHOD
/begin COMPU_METHOD RTE_CM_ETAT_DAE_CAV3_VIRTUEL "" RAT_FUNC "%." "" COEFFS 0 1 0 0 0 1 /end COMPU_METHOD
/begin COMPU_METHOD RTE_CM_ETAT_DAE_CPK "" RAT_FUNC "%." "" COEFFS 0 1 0 0 0 1 /end COMPU_METHOD
/begin COMPU_METHOD RTE_CM_VITESSE_COLONNE "" RAT_FUNC "%." "Deg/s" COEFFS 0 1 0 0 0 1 /end COMPU_METHOD
/begin COMPU_METHOD RTE_CM_ANGLE_VOLANT_ORIGINE "" RAT_FUNC "%." "" COEFFS 0 1 0 0 0 1 /end COMPU_METHOD
/begin COMPU_METHOD RTE_CM_CODE_DEFAUT_VOL "" RAT_FUNC "%." "" COEFFS 0 1 0 0 0 1 /end COMPU_METHOD
/begin COMPU_METHOD RTE_CM_VITESSE_ROT_VOL_OPTIMISE "" RAT_FUNC "%." "" COEFFS 0 0.25 0 0 0 1 /end COMPU_METHOD
/begin COMPU_METHOD RTE_CM_ANGLE_VOLANT "" RAT_FUNC "%." "Deg" COEFFS 0 10 0 0 0 1 /end COMPU_METHOD
/begin COMPU_METHOD RTE_CM_VITESSE_ROT_VOL "" RAT_FUNC "%." "Deg/s" COEFFS 0 0.25 0 0 0 1 /end COMPU_METHOD
/begin COMPU_METHOD RTE_CM_CODE_DEFAUT "" RAT_FUNC "%." "" COEFFS 0 1 0 0 0 1 /end COMPU_METHOD
/begin COMPU_METHOD RTE_CM_ETAT_ASSIST_DA "" RAT_FUNC "%." "" COEFFS 0 1 0 0 0 1 /end COMPU_METHOD
