/begin MEASUREMENT Rte_FaultLog_FaultLog.QueueData[42].Status_Cnt_u08 "MICROSAR RTE" UBYTE NO_COMPU_METHOD 0 0 0 255 ECU_ADDRESS 0 READ_WRITE /end MEASUREMENT
/begin MEASUREMENT Rte_FaultLog_FaultLog.QueueData[43].QueueEventIdx_Cnt_u08 "MICROSAR RTE" UBYTE NO_COMPU_METHOD 0 0 0 255 ECU_ADDRESS 0 READ_WRITE /end MEASUREMENT
/begin MEASUREMENT Rte_FaultLog_FaultLog.QueueData[43].Status_Cnt_u08 "MICROSAR RTE" UBYTE NO_COMPU_METHOD 0 0 0 255 ECU_ADDRESS 0 READ_WRITE /end MEASUREMENT
/begin MEASUREMENT Rte_FaultLog_FaultLog.QueueData[44].QueueEventIdx_Cnt_u08 "MICROSAR RTE" UBYTE NO_COMPU_METHOD 0 0 0 255 ECU_ADDRESS 0 READ_WRITE /end MEASUREMENT
/begin MEASUREMENT Rte_FaultLog_FaultLog.QueueData[44].Status_Cnt_u08 "MICROSAR RTE" UBYTE NO_COMPU_METHOD 0 0 0 255 ECU_ADDRESS 0 READ_WRITE /end MEASUREMENT
/begin MEASUREMENT Rte_FaultLog_FaultLog.QueueData[45].QueueEventIdx_Cnt_u08 "MICROSAR RTE" UBYTE NO_COMPU_METHOD 0 0 0 255 ECU_ADDRESS 0 READ_WRITE /end MEASUREMENT
/begin MEASUREMENT Rte_FaultLog_FaultLog.QueueData[45].Status_Cnt_u08 "MICROSAR RTE" UBYTE NO_COMPU_METHOD 0 0 0 255 ECU_ADDRESS 0 READ_WRITE /end MEASUREMENT
/begin MEASUREMENT Rte_FaultLog_FaultLog.QueueData[46].QueueEventIdx_Cnt_u08 "MICROSAR RTE" UBYTE NO_COMPU_METHOD 0 0 0 255 ECU_ADDRESS 0 READ_WRITE /end MEASUREMENT
/begin MEASUREMENT Rte_FaultLog_FaultLog.QueueData[46].Status_Cnt_u08 "MICROSAR RTE" UBYTE NO_COMPU_METHOD 0 0 0 255 ECU_ADDRESS 0 READ_WRITE /end MEASUREMENT
/begin MEASUREMENT Rte_FaultLog_FaultLog.QueueData[47].QueueEventIdx_Cnt_u08 "MICROSAR RTE" UBYTE NO_COMPU_METHOD 0 0 0 255 ECU_ADDRESS 0 READ_WRITE /end MEASUREMENT
/begin MEASUREMENT Rte_FaultLog_FaultLog.QueueData[47].Status_Cnt_u08 "MICROSAR RTE" UBYTE NO_COMPU_METHOD 0 0 0 255 ECU_ADDRESS 0 READ_WRITE /end MEASUREMENT
/begin MEASUREMENT Rte_FaultLog_FaultLog.QueueData[48].QueueEventIdx_Cnt_u08 "MICROSAR RTE" UBYTE NO_COMPU_METHOD 0 0 0 255 ECU_ADDRESS 0 READ_WRITE /end MEASUREMENT
/begin MEASUREMENT Rte_FaultLog_FaultLog.QueueData[48].Status_Cnt_u08 "MICROSAR RTE" UBYTE NO_COMPU_METHOD 0 0 0 255 ECU_ADDRESS 0 READ_WRITE /end MEASUREMENT
/begin MEASUREMENT Rte_FaultLog_FaultLog.QueueData[49].QueueEventIdx_Cnt_u08 "MICROSAR RTE" UBYTE NO_COMPU_METHOD 0 0 0 255 ECU_ADDRESS 0 READ_WRITE /end MEASUREMENT
/begin MEASUREMENT Rte_FaultLog_FaultLog.QueueData[49].Status_Cnt_u08 "MICROSAR RTE" UBYTE NO_COMPU_METHOD 0 0 0 255 ECU_ADDRESS 0 READ_WRITE /end MEASUREMENT
/begin MEASUREMENT Rte_FaultLog_FaultLog.QueueData[4].QueueEventIdx_Cnt_u08 "MICROSAR RTE" UBYTE NO_COMPU_METHOD 0 0 0 255 ECU_ADDRESS 0 READ_WRITE /end MEASUREMENT
/begin MEASUREMENT Rte_FaultLog_FaultLog.QueueData[4].Status_Cnt_u08 "MICROSAR RTE" UBYTE NO_COMPU_METHOD 0 0 0 255 ECU_ADDRESS 0 READ_WRITE /end MEASUREMENT
/begin MEASUREMENT Rte_FaultLog_FaultLog.QueueData[50].QueueEventIdx_Cnt_u08 "MICROSAR RTE" UBYTE NO_COMPU_METHOD 0 0 0 255 ECU_ADDRESS 0 READ_WRITE /end MEASUREMENT
/begin MEASUREMENT Rte_FaultLog_FaultLog.QueueData[50].Status_Cnt_u08 "MICROSAR RTE" UBYTE NO_COMPU_METHOD 0 0 0 255 ECU_ADDRESS 0 READ_WRITE /end MEASUREMENT
/begin MEASUREMENT Rte_FaultLog_FaultLog.QueueData[51].QueueEventIdx_Cnt_u08 "MICROSAR RTE" UBYTE NO_COMPU_METHOD 0 0 0 255 ECU_ADDRESS 0 READ_WRITE /end MEASUREMENT
/begin MEASUREMENT Rte_FaultLog_FaultLog.QueueData[51].Status_Cnt_u08 "MICROSAR RTE" UBYTE NO_COMPU_METHOD 0 0 0 255 ECU_ADDRESS 0 READ_WRITE /end MEASUREMENT
/begin MEASUREMENT Rte_FaultLog_FaultLog.QueueData[52].QueueEventIdx_Cnt_u08 "MICROSAR RTE" UBYTE NO_COMPU_METHOD 0 0 0 255 ECU_ADDRESS 0 READ_WRITE /end MEASUREMENT
/begin MEASUREMENT Rte_FaultLog_FaultLog.QueueData[52].Status_Cnt_u08 "MICROSAR RTE" UBYTE NO_COMPU_METHOD 0 0 0 255 ECU_ADDRESS 0 READ_WRITE /end MEASUREMENT
/begin MEASUREMENT Rte_FaultLog_FaultLog.QueueData[53].QueueEventIdx_Cnt_u08 "MICROSAR RTE" UBYTE NO_COMPU_METHOD 0 0 0 255 ECU_ADDRESS 0 READ_WRITE /end MEASUREMENT
/begin MEASUREMENT Rte_FaultLog_FaultLog.QueueData[53].Status_Cnt_u08 "MICROSAR RTE" UBYTE NO_COMPU_METHOD 0 0 0 255 ECU_ADDRESS 0 READ_WRITE /end MEASUREMENT
/begin MEASUREMENT Rte_FaultLog_FaultLog.QueueData[54].QueueEventIdx_Cnt_u08 "MICROSAR RTE" UBYTE NO_COMPU_METHOD 0 0 0 255 ECU_ADDRESS 0 READ_WRITE /end MEASUREMENT
/begin MEASUREMENT Rte_FaultLog_FaultLog.QueueData[54].Status_Cnt_u08 "MICROSAR RTE" UBYTE NO_COMPU_METHOD 0 0 0 255 ECU_ADDRESS 0 READ_WRITE /end MEASUREMENT
/begin MEASUREMENT Rte_FaultLog_FaultLog.QueueData[55].QueueEventIdx_Cnt_u08 "MICROSAR RTE" UBYTE NO_COMPU_METHOD 0 0 0 255 ECU_ADDRESS 0 READ_WRITE /end MEASUREMENT
/begin MEASUREMENT Rte_FaultLog_FaultLog.QueueData[55].Status_Cnt_u08 "MICROSAR RTE" UBYTE NO_COMPU_METHOD 0 0 0 255 ECU_ADDRESS 0 READ_WRITE /end MEASUREMENT
/begin MEASUREMENT Rte_FaultLog_FaultLog.QueueData[56].QueueEventIdx_Cnt_u08 "MICROSAR RTE" UBYTE NO_COMPU_METHOD 0 0 0 255 ECU_ADDRESS 0 READ_WRITE /end MEASUREMENT
/begin MEASUREMENT Rte_FaultLog_FaultLog.QueueData[56].Status_Cnt_u08 "MICROSAR RTE" UBYTE NO_COMPU_METHOD 0 0 0 255 ECU_ADDRESS 0 READ_WRITE /end MEASUREMENT
/begin MEASUREMENT Rte_FaultLog_FaultLog.QueueData[57].QueueEventIdx_Cnt_u08 "MICROSAR RTE" UBYTE NO_COMPU_METHOD 0 0 0 255 ECU_ADDRESS 0 READ_WRITE /end MEASUREMENT
/begin MEASUREMENT Rte_FaultLog_FaultLog.QueueData[57].Status_Cnt_u08 "MICROSAR RTE" UBYTE NO_COMPU_METHOD 0 0 0 255 ECU_ADDRESS 0 READ_WRITE /end MEASUREMENT
/begin MEASUREMENT Rte_FaultLog_FaultLog.QueueData[58].QueueEventIdx_Cnt_u08 "MICROSAR RTE" UBYTE NO_COMPU_METHOD 0 0 0 255 ECU_ADDRESS 0 READ_WRITE /end MEASUREMENT
/begin MEASUREMENT Rte_FaultLog_FaultLog.QueueData[58].Status_Cnt_u08 "MICROSAR RTE" UBYTE NO_COMPU_METHOD 0 0 0 255 ECU_ADDRESS 0 READ_WRITE /end MEASUREMENT
/begin MEASUREMENT Rte_FaultLog_FaultLog.QueueData[59].QueueEventIdx_Cnt_u08 "MICROSAR RTE" UBYTE NO_COMPU_METHOD 0 0 0 255 ECU_ADDRESS 0 READ_WRITE /end MEASUREMENT
/begin MEASUREMENT Rte_FaultLog_FaultLog.QueueData[59].Status_Cnt_u08 "MICROSAR RTE" UBYTE NO_COMPU_METHOD 0 0 0 255 ECU_ADDRESS 0 READ_WRITE /end MEASUREMENT
/begin MEASUREMENT Rte_FaultLog_FaultLog.QueueData[5].QueueEventIdx_Cnt_u08 "MICROSAR RTE" UBYTE NO_COMPU_METHOD 0 0 0 255 ECU_ADDRESS 0 READ_WRITE /end MEASUREMENT
/begin MEASUREMENT Rte_FaultLog_FaultLog.QueueData[5].Status_Cnt_u08 "MICROSAR RTE" UBYTE NO_COMPU_METHOD 0 0 0 255 ECU_ADDRESS 0 READ_WRITE /end MEASUREMENT
/begin MEASUREMENT Rte_FaultLog_FaultLog.QueueData[60].QueueEventIdx_Cnt_u08 "MICROSAR RTE" UBYTE NO_COMPU_METHOD 0 0 0 255 ECU_ADDRESS 0 READ_WRITE /end MEASUREMENT
/begin MEASUREMENT Rte_FaultLog_FaultLog.QueueData[60].Status_Cnt_u08 "MICROSAR RTE" UBYTE NO_COMPU_METHOD 0 0 0 255 ECU_ADDRESS 0 READ_WRITE /end MEASUREMENT
/begin MEASUREMENT Rte_FaultLog_FaultLog.QueueData[61].QueueEventIdx_Cnt_u08 "MICROSAR RTE" UBYTE NO_COMPU_METHOD 0 0 0 255 ECU_ADDRESS 0 READ_WRITE /end MEASUREMENT
/begin MEASUREMENT Rte_FaultLog_FaultLog.QueueData[61].Status_Cnt_u08 "MICROSAR RTE" UBYTE NO_COMPU_METHOD 0 0 0 255 ECU_ADDRESS 0 READ_WRITE /end MEASUREMENT
/begin MEASUREMENT Rte_FaultLog_FaultLog.QueueData[62].QueueEventIdx_Cnt_u08 "MICROSAR RTE" UBYTE NO_COMPU_METHOD 0 0 0 255 ECU_ADDRESS 0 READ_WRITE /end MEASUREMENT
/begin MEASUREMENT Rte_FaultLog_FaultLog.QueueData[62].Status_Cnt_u08 "MICROSAR RTE" UBYTE NO_COMPU_METHOD 0 0 0 255 ECU_ADDRESS 0 READ_WRITE /end MEASUREMENT
/begin MEASUREMENT Rte_FaultLog_FaultLog.QueueData[63].QueueEventIdx_Cnt_u08 "MICROSAR RTE" UBYTE NO_COMPU_METHOD 0 0 0 255 ECU_ADDRESS 0 READ_WRITE /end MEASUREMENT
/begin MEASUREMENT Rte_FaultLog_FaultLog.QueueData[63].Status_Cnt_u08 "MICROSAR RTE" UBYTE NO_COMPU_METHOD 0 0 0 255 ECU_ADDRESS 0 READ_WRITE /end MEASUREMENT
/begin MEASUREMENT Rte_FaultLog_FaultLog.QueueData[64].QueueEventIdx_Cnt_u08 "MICROSAR RTE" UBYTE NO_COMPU_METHOD 0 0 0 255 ECU_ADDRESS 0 READ_WRITE /end MEASUREMENT
/begin MEASUREMENT Rte_FaultLog_FaultLog.QueueData[64].Status_Cnt_u08 "MICROSAR RTE" UBYTE NO_COMPU_METHOD 0 0 0 255 ECU_ADDRESS 0 READ_WRITE /end MEASUREMENT
/begin MEASUREMENT Rte_FaultLog_FaultLog.QueueData[65].QueueEventIdx_Cnt_u08 "MICROSAR RTE" UBYTE NO_COMPU_METHOD 0 0 0 255 ECU_ADDRESS 0 READ_WRITE /end MEASUREMENT
/begin MEASUREMENT Rte_FaultLog_FaultLog.QueueData[65].Status_Cnt_u08 "MICROSAR RTE" UBYTE NO_COMPU_METHOD 0 0 0 255 ECU_ADDRESS 0 READ_WRITE /end MEASUREMENT
/begin MEASUREMENT Rte_FaultLog_FaultLog.QueueData[66].QueueEventIdx_Cnt_u08 "MICROSAR RTE" UBYTE NO_COMPU_METHOD 0 0 0 255 ECU_ADDRESS 0 READ_WRITE /end MEASUREMENT
/begin MEASUREMENT Rte_FaultLog_FaultLog.QueueData[66].Status_Cnt_u08 "MICROSAR RTE" UBYTE NO_COMPU_METHOD 0 0 0 255 ECU_ADDRESS 0 READ_WRITE /end MEASUREMENT
/begin MEASUREMENT Rte_FaultLog_FaultLog.QueueData[67].QueueEventIdx_Cnt_u08 "MICROSAR RTE" UBYTE NO_COMPU_METHOD 0 0 0 255 ECU_ADDRESS 0 READ_WRITE /end MEASUREMENT
/begin MEASUREMENT Rte_FaultLog_FaultLog.QueueData[67].Status_Cnt_u08 "MICROSAR RTE" UBYTE NO_COMPU_METHOD 0 0 0 255 ECU_ADDRESS 0 READ_WRITE /end MEASUREMENT
/begin MEASUREMENT Rte_FaultLog_FaultLog.QueueData[68].QueueEventIdx_Cnt_u08 "MICROSAR RTE" UBYTE NO_COMPU_METHOD 0 0 0 255 ECU_ADDRESS 0 READ_WRITE /end MEASUREMENT
/begin MEASUREMENT Rte_FaultLog_FaultLog.QueueData[68].Status_Cnt_u08 "MICROSAR RTE" UBYTE NO_COMPU_METHOD 0 0 0 255 ECU_ADDRESS 0 READ_WRITE /end MEASUREMENT
/begin MEASUREMENT Rte_FaultLog_FaultLog.QueueData[69].QueueEventIdx_Cnt_u08 "MICROSAR RTE" UBYTE NO_COMPU_METHOD 0 0 0 255 ECU_ADDRESS 0 READ_WRITE /end MEASUREMENT
/begin MEASUREMENT Rte_FaultLog_FaultLog.QueueData[69].Status_Cnt_u08 "MICROSAR RTE" UBYTE NO_COMPU_METHOD 0 0 0 255 ECU_ADDRESS 0 READ_WRITE /end MEASUREMENT
/begin MEASUREMENT Rte_FaultLog_FaultLog.QueueData[6].QueueEventIdx_Cnt_u08 "MICROSAR RTE" UBYTE NO_COMPU_METHOD 0 0 0 255 ECU_ADDRESS 0 READ_WRITE /end MEASUREMENT
/begin MEASUREMENT Rte_FaultLog_FaultLog.QueueData[6].Status_Cnt_u08 "MICROSAR RTE" UBYTE NO_COMPU_METHOD 0 0 0 255 ECU_ADDRESS 0 READ_WRITE /end MEASUREMENT
/begin MEASUREMENT Rte_FaultLog_FaultLog.QueueData[70].QueueEventIdx_Cnt_u08 "MICROSAR RTE" UBYTE NO_COMPU_METHOD 0 0 0 255 ECU_ADDRESS 0 READ_WRITE /end MEASUREMENT
/begin MEASUREMENT Rte_FaultLog_FaultLog.QueueData[70].Status_Cnt_u08 "MICROSAR RTE" UBYTE NO_COMPU_METHOD 0 0 0 255 ECU_ADDRESS 0 READ_WRITE /end MEASUREMENT
/begin MEASUREMENT Rte_FaultLog_FaultLog.QueueData[71].QueueEventIdx_Cnt_u08 "MICROSAR RTE" UBYTE NO_COMPU_METHOD 0 0 0 255 ECU_ADDRESS 0 READ_WRITE /end MEASUREMENT
/begin MEASUREMENT Rte_FaultLog_FaultLog.QueueData[71].Status_Cnt_u08 "MICROSAR RTE" UBYTE NO_COMPU_METHOD 0 0 0 255 ECU_ADDRESS 0 READ_WRITE /end MEASUREMENT
/begin MEASUREMENT Rte_FaultLog_FaultLog.QueueData[72].QueueEventIdx_Cnt_u08 "MICROSAR RTE" UBYTE NO_COMPU_METHOD 0 0 0 255 ECU_ADDRESS 0 READ_WRITE /end MEASUREMENT
/begin MEASUREMENT Rte_FaultLog_FaultLog.QueueData[72].Status_Cnt_u08 "MICROSAR RTE" UBYTE NO_COMPU_METHOD 0 0 0 255 ECU_ADDRESS 0 READ_WRITE /end MEASUREMENT
/begin MEASUREMENT Rte_FaultLog_FaultLog.QueueData[73].QueueEventIdx_Cnt_u08 "MICROSAR RTE" UBYTE NO_COMPU_METHOD 0 0 0 255 ECU_ADDRESS 0 READ_WRITE /end MEASUREMENT
/begin MEASUREMENT Rte_FaultLog_FaultLog.QueueData[73].Status_Cnt_u08 "MICROSAR RTE" UBYTE NO_COMPU_METHOD 0 0 0 255 ECU_ADDRESS 0 READ_WRITE /end MEASUREMENT
/begin MEASUREMENT Rte_FaultLog_FaultLog.QueueData[74].QueueEventIdx_Cnt_u08 "MICROSAR RTE" UBYTE NO_COMPU_METHOD 0 0 0 255 ECU_ADDRESS 0 READ_WRITE /end MEASUREMENT
/begin MEASUREMENT Rte_FaultLog_FaultLog.QueueData[74].Status_Cnt_u08 "MICROSAR RTE" UBYTE NO_COMPU_METHOD 0 0 0 255 ECU_ADDRESS 0 READ_WRITE /end MEASUREMENT
/begin MEASUREMENT Rte_FaultLog_FaultLog.QueueData[75].QueueEventIdx_Cnt_u08 "MICROSAR RTE" UBYTE NO_COMPU_METHOD 0 0 0 255 ECU_ADDRESS 0 READ_WRITE /end MEASUREMENT
/begin MEASUREMENT Rte_FaultLog_FaultLog.QueueData[75].Status_Cnt_u08 "MICROSAR RTE" UBYTE NO_COMPU_METHOD 0 0 0 255 ECU_ADDRESS 0 READ_WRITE /end MEASUREMENT
/begin MEASUREMENT Rte_FaultLog_FaultLog.QueueData[76].QueueEventIdx_Cnt_u08 "MICROSAR RTE" UBYTE NO_COMPU_METHOD 0 0 0 255 ECU_ADDRESS 0 READ_WRITE /end MEASUREMENT
/begin MEASUREMENT Rte_FaultLog_FaultLog.QueueData[76].Status_Cnt_u08 "MICROSAR RTE" UBYTE NO_COMPU_METHOD 0 0 0 255 ECU_ADDRESS 0 READ_WRITE /end MEASUREMENT
/begin MEASUREMENT Rte_FaultLog_FaultLog.QueueData[77].QueueEventIdx_Cnt_u08 "MICROSAR RTE" UBYTE NO_COMPU_METHOD 0 0 0 255 ECU_ADDRESS 0 READ_WRITE /end MEASUREMENT
/begin MEASUREMENT Rte_FaultLog_FaultLog.QueueData[77].Status_Cnt_u08 "MICROSAR RTE" UBYTE NO_COMPU_METHOD 0 0 0 255 ECU_ADDRESS 0 READ_WRITE /end MEASUREMENT
/begin MEASUREMENT Rte_FaultLog_FaultLog.QueueData[78].QueueEventIdx_Cnt_u08 "MICROSAR RTE" UBYTE NO_COMPU_METHOD 0 0 0 255 ECU_ADDRESS 0 READ_WRITE /end MEASUREMENT
/begin MEASUREMENT Rte_FaultLog_FaultLog.QueueData[78].Status_Cnt_u08 "MICROSAR RTE" UBYTE NO_COMPU_METHOD 0 0 0 255 ECU_ADDRESS 0 READ_WRITE /end MEASUREMENT
/begin MEASUREMENT Rte_FaultLog_FaultLog.QueueData[79].QueueEventIdx_Cnt_u08 "MICROSAR RTE" UBYTE NO_COMPU_METHOD 0 0 0 255 ECU_ADDRESS 0 READ_WRITE /end MEASUREMENT
/begin MEASUREMENT Rte_FaultLog_FaultLog.QueueData[79].Status_Cnt_u08 "MICROSAR RTE" UBYTE NO_COMPU_METHOD 0 0 0 255 ECU_ADDRESS 0 READ_WRITE /end MEASUREMENT
/begin MEASUREMENT Rte_FaultLog_FaultLog.QueueData[7].QueueEventIdx_Cnt_u08 "MICROSAR RTE" UBYTE NO_COMPU_METHOD 0 0 0 255 ECU_ADDRESS 0 READ_WRITE /end MEASUREMENT
/begin MEASUREMENT Rte_FaultLog_FaultLog.QueueData[7].Status_Cnt_u08 "MICROSAR RTE" UBYTE NO_COMPU_METHOD 0 0 0 255 ECU_ADDRESS 0 READ_WRITE /end MEASUREMENT
/begin MEASUREMENT Rte_FaultLog_FaultLog.QueueData[80].QueueEventIdx_Cnt_u08 "MICROSAR RTE" UBYTE NO_COMPU_METHOD 0 0 0 255 ECU_ADDRESS 0 READ_WRITE /end MEASUREMENT
/begin MEASUREMENT Rte_FaultLog_FaultLog.QueueData[80].Status_Cnt_u08 "MICROSAR RTE" UBYTE NO_COMPU_METHOD 0 0 0 255 ECU_ADDRESS 0 READ_WRITE /end MEASUREMENT
/begin MEASUREMENT Rte_FaultLog_FaultLog.QueueData[81].QueueEventIdx_Cnt_u08 "MICROSAR RTE" UBYTE NO_COMPU_METHOD 0 0 0 255 ECU_ADDRESS 0 READ_WRITE /end MEASUREMENT
/begin MEASUREMENT Rte_FaultLog_FaultLog.QueueData[81].Status_Cnt_u08 "MICROSAR RTE" UBYTE NO_COMPU_METHOD 0 0 0 255 ECU_ADDRESS 0 READ_WRITE /end MEASUREMENT
/begin MEASUREMENT Rte_FaultLog_FaultLog.QueueData[82].QueueEventIdx_Cnt_u08 "MICROSAR RTE" UBYTE NO_COMPU_METHOD 0 0 0 255 ECU_ADDRESS 0 READ_WRITE /end MEASUREMENT
/begin MEASUREMENT Rte_FaultLog_FaultLog.QueueData[82].Status_Cnt_u08 "MICROSAR RTE" UBYTE NO_COMPU_METHOD 0 0 0 255 ECU_ADDRESS 0 READ_WRITE /end MEASUREMENT
/begin MEASUREMENT Rte_FaultLog_FaultLog.QueueData[83].QueueEventIdx_Cnt_u08 "MICROSAR RTE" UBYTE NO_COMPU_METHOD 0 0 0 255 ECU_ADDRESS 0 READ_WRITE /end MEASUREMENT
/begin MEASUREMENT Rte_FaultLog_FaultLog.QueueData[83].Status_Cnt_u08 "MICROSAR RTE" UBYTE NO_COMPU_METHOD 0 0 0 255 ECU_ADDRESS 0 READ_WRITE /end MEASUREMENT
/begin MEASUREMENT Rte_FaultLog_FaultLog.QueueData[84].QueueEventIdx_Cnt_u08 "MICROSAR RTE" UBYTE NO_COMPU_METHOD 0 0 0 255 ECU_ADDRESS 0 READ_WRITE /end MEASUREMENT
/begin MEASUREMENT Rte_FaultLog_FaultLog.QueueData[84].Status_Cnt_u08 "MICROSAR RTE" UBYTE NO_COMPU_METHOD 0 0 0 255 ECU_ADDRESS 0 READ_WRITE /end MEASUREMENT
/begin MEASUREMENT Rte_FaultLog_FaultLog.QueueData[85].QueueEventIdx_Cnt_u08 "MICROSAR RTE" UBYTE NO_COMPU_METHOD 0 0 0 255 ECU_ADDRESS 0 READ_WRITE /end MEASUREMENT
/begin MEASUREMENT Rte_FaultLog_FaultLog.QueueData[85].Status_Cnt_u08 "MICROSAR RTE" UBYTE NO_COMPU_METHOD 0 0 0 255 ECU_ADDRESS 0 READ_WRITE /end MEASUREMENT
/begin MEASUREMENT Rte_FaultLog_FaultLog.QueueData[86].QueueEventIdx_Cnt_u08 "MICROSAR RTE" UBYTE NO_COMPU_METHOD 0 0 0 255 ECU_ADDRESS 0 READ_WRITE /end MEASUREMENT
/begin MEASUREMENT Rte_FaultLog_FaultLog.QueueData[86].Status_Cnt_u08 "MICROSAR RTE" UBYTE NO_COMPU_METHOD 0 0 0 255 ECU_ADDRESS 0 READ_WRITE /end MEASUREMENT
/begin MEASUREMENT Rte_FaultLog_FaultLog.QueueData[87].QueueEventIdx_Cnt_u08 "MICROSAR RTE" UBYTE NO_COMPU_METHOD 0 0 0 255 ECU_ADDRESS 0 READ_WRITE /end MEASUREMENT
/begin MEASUREMENT Rte_FaultLog_FaultLog.QueueData[87].Status_Cnt_u08 "MICROSAR RTE" UBYTE NO_COMPU_METHOD 0 0 0 255 ECU_ADDRESS 0 READ_WRITE /end MEASUREMENT
/begin MEASUREMENT Rte_FaultLog_FaultLog.QueueData[88].QueueEventIdx_Cnt_u08 "MICROSAR RTE" UBYTE NO_COMPU_METHOD 0 0 0 255 ECU_ADDRESS 0 READ_WRITE /end MEASUREMENT
/begin MEASUREMENT Rte_FaultLog_FaultLog.QueueData[88].Status_Cnt_u08 "MICROSAR RTE" UBYTE NO_COMPU_METHOD 0 0 0 255 ECU_ADDRESS 0 READ_WRITE /end MEASUREMENT
/begin MEASUREMENT Rte_FaultLog_FaultLog.QueueData[89].QueueEventIdx_Cnt_u08 "MICROSAR RTE" UBYTE NO_COMPU_METHOD 0 0 0 255 ECU_ADDRESS 0 READ_WRITE /end MEASUREMENT
/begin MEASUREMENT Rte_FaultLog_FaultLog.QueueData[89].Status_Cnt_u08 "MICROSAR RTE" UBYTE NO_COMPU_METHOD 0 0 0 255 ECU_ADDRESS 0 READ_WRITE /end MEASUREMENT
/begin MEASUREMENT Rte_FaultLog_FaultLog.QueueData[8].QueueEventIdx_Cnt_u08 "MICROSAR RTE" UBYTE NO_COMPU_METHOD 0 0 0 255 ECU_ADDRESS 0 READ_WRITE /end MEASUREMENT
/begin MEASUREMENT Rte_FaultLog_FaultLog.QueueData[8].Status_Cnt_u08 "MICROSAR RTE" UBYTE NO_COMPU_METHOD 0 0 0 255 ECU_ADDRESS 0 READ_WRITE /end MEASUREMENT
/begin MEASUREMENT Rte_FaultLog_FaultLog.QueueData[90].QueueEventIdx_Cnt_u08 "MICROSAR RTE" UBYTE NO_COMPU_METHOD 0 0 0 255 ECU_ADDRESS 0 READ_WRITE /end MEASUREMENT
/begin MEASUREMENT Rte_FaultLog_FaultLog.QueueData[90].Status_Cnt_u08 "MICROSAR RTE" UBYTE NO_COMPU_METHOD 0 0 0 255 ECU_ADDRESS 0 READ_WRITE /end MEASUREMENT
/begin MEASUREMENT Rte_FaultLog_FaultLog.QueueData[91].QueueEventIdx_Cnt_u08 "MICROSAR RTE" UBYTE NO_COMPU_METHOD 0 0 0 255 ECU_ADDRESS 0 READ_WRITE /end MEASUREMENT
/begin MEASUREMENT Rte_FaultLog_FaultLog.QueueData[91].Status_Cnt_u08 "MICROSAR RTE" UBYTE NO_COMPU_METHOD 0 0 0 255 ECU_ADDRESS 0 READ_WRITE /end MEASUREMENT
/begin MEASUREMENT Rte_FaultLog_FaultLog.QueueData[92].QueueEventIdx_Cnt_u08 "MICROSAR RTE" UBYTE NO_COMPU_METHOD 0 0 0 255 ECU_ADDRESS 0 READ_WRITE /end MEASUREMENT
/begin MEASUREMENT Rte_FaultLog_FaultLog.QueueData[92].Status_Cnt_u08 "MICROSAR RTE" UBYTE NO_COMPU_METHOD 0 0 0 255 ECU_ADDRESS 0 READ_WRITE /end MEASUREMENT
/begin MEASUREMENT Rte_FaultLog_FaultLog.QueueData[93].QueueEventIdx_Cnt_u08 "MICROSAR RTE" UBYTE NO_COMPU_METHOD 0 0 0 255 ECU_ADDRESS 0 READ_WRITE /end MEASUREMENT
/begin MEASUREMENT Rte_FaultLog_FaultLog.QueueData[93].Status_Cnt_u08 "MICROSAR RTE" UBYTE NO_COMPU_METHOD 0 0 0 255 ECU_ADDRESS 0 READ_WRITE /end MEASUREMENT
/begin MEASUREMENT Rte_FaultLog_FaultLog.QueueData[94].QueueEventIdx_Cnt_u08 "MICROSAR RTE" UBYTE NO_COMPU_METHOD 0 0 0 255 ECU_ADDRESS 0 READ_WRITE /end MEASUREMENT
/begin MEASUREMENT Rte_FaultLog_FaultLog.QueueData[94].Status_Cnt_u08 "MICROSAR RTE" UBYTE NO_COMPU_METHOD 0 0 0 255 ECU_ADDRESS 0 READ_WRITE /end MEASUREMENT
/begin MEASUREMENT Rte_FaultLog_FaultLog.QueueData[95].QueueEventIdx_Cnt_u08 "MICROSAR RTE" UBYTE NO_COMPU_METHOD 0 0 0 255 ECU_ADDRESS 0 READ_WRITE /end MEASUREMENT
/begin MEASUREMENT Rte_FaultLog_FaultLog.QueueData[95].Status_Cnt_u08 "MICROSAR RTE" UBYTE NO_COMPU_METHOD 0 0 0 255 ECU_ADDRESS 0 READ_WRITE /end MEASUREMENT
/begin MEASUREMENT Rte_FaultLog_FaultLog.QueueData[96].QueueEventIdx_Cnt_u08 "MICROSAR RTE" UBYTE NO_COMPU_METHOD 0 0 0 255 ECU_ADDRESS 0 READ_WRITE /end MEASUREMENT
/begin MEASUREMENT Rte_FaultLog_FaultLog.QueueData[96].Status_Cnt_u08 "MICROSAR RTE" UBYTE NO_COMPU_METHOD 0 0 0 255 ECU_ADDRESS 0 READ_WRITE /end MEASUREMENT
/begin MEASUREMENT Rte_FaultLog_FaultLog.QueueData[97].QueueEventIdx_Cnt_u08 "MICROSAR RTE" UBYTE NO_COMPU_METHOD 0 0 0 255 ECU_ADDRESS 0 READ_WRITE /end MEASUREMENT
/begin MEASUREMENT Rte_FaultLog_FaultLog.QueueData[97].Status_Cnt_u08 "MICROSAR RTE" UBYTE NO_COMPU_METHOD 0 0 0 255 ECU_ADDRESS 0 READ_WRITE /end MEASUREMENT
/begin MEASUREMENT Rte_FaultLog_FaultLog.QueueData[98].QueueEventIdx_Cnt_u08 "MICROSAR RTE" UBYTE NO_COMPU_METHOD 0 0 0 255 ECU_ADDRESS 0 READ_WRITE /end MEASUREMENT
/begin MEASUREMENT Rte_FaultLog_FaultLog.QueueData[98].Status_Cnt_u08 "MICROSAR RTE" UBYTE NO_COMPU_METHOD 0 0 0 255 ECU_ADDRESS 0 READ_WRITE /end MEASUREMENT
/begin MEASUREMENT Rte_FaultLog_FaultLog.QueueData[99].QueueEventIdx_Cnt_u08 "MICROSAR RTE" UBYTE NO_COMPU_METHOD 0 0 0 255 ECU_ADDRESS 0 READ_WRITE /end MEASUREMENT
/begin MEASUREMENT Rte_FaultLog_FaultLog.QueueData[99].Status_Cnt_u08 "MICROSAR RTE" UBYTE NO_COMPU_METHOD 0 0 0 255 ECU_ADDRESS 0 READ_WRITE /end MEASUREMENT
/begin MEASUREMENT Rte_FaultLog_FaultLog.QueueData[9].QueueEventIdx_Cnt_u08 "MICROSAR RTE" UBYTE NO_COMPU_METHOD 0 0 0 255 ECU_ADDRESS 0 READ_WRITE /end MEASUREMENT
/begin MEASUREMENT Rte_FaultLog_FaultLog.QueueData[9].Status_Cnt_u08 "MICROSAR RTE" UBYTE NO_COMPU_METHOD 0 0 0 255 ECU_ADDRESS 0 READ_WRITE /end MEASUREMENT
/begin MEASUREMENT Rte_SrlComInput_Kilometrage_Cnt_u32 "MICROSAR RTE" ULONG NO_COMPU_METHOD 0 0 0 4294967295 ECU_ADDRESS 0 /end MEASUREMENT
/begin MEASUREMENT Rte_SrlComInput_PowerSupplies_Cnt_u08 "MICROSAR RTE" UBYTE NO_COMPU_METHOD 0 0 0 255 ECU_ADDRESS 0 /end MEASUREMENT
/begin MEASUREMENT Rte_SrlComInput_ShuntPosition_Cnt_u08 "MICROSAR RTE" UBYTE NO_COMPU_METHOD 0 0 0 255 ECU_ADDRESS 0 /end MEASUREMENT
/begin MEASUREMENT Rte_SrlComDriver_TxEnabled_Cnt_lgc "MICROSAR RTE" UBYTE RTE_CM_BOOLEAN 0 0 0 255 ECU_ADDRESS 0 /end MEASUREMENT
/begin MEASUREMENT Rte_FrqDepDmpnInrtCmp_WIRCmdAmpBlnd_MtrNm_f32 "MICROSAR RTE" FLOAT32_IEEE NO_COMPU_METHOD 0 0 1.175494351e-38 3.402823466e+38 ECU_ADDRESS 0 /end MEASUREMENT
/begin MEASUREMENT Rte_HOWDetect_HOWEstimate_Uls_f32 "MICROSAR RTE" FLOAT32_IEEE NO_COMPU_METHOD 0 0 1.175494351e-38 3.402823466e+38 ECU_ADDRESS 0 /end MEASUREMENT
/begin MEASUREMENT Rte_HOWDetect_HOWState_Cnt_s08 "MICROSAR RTE" SBYTE NO_COMPU_METHOD 0 0 -128 127 ECU_ADDRESS 0 /end MEASUREMENT
/begin MEASUREMENT Rte_HiLoadStall_AssistStallLimit_MtrNm_f32 "MICROSAR RTE" FLOAT32_IEEE NO_COMPU_METHOD 0 0 1.175494351e-38 3.402823466e+38 ECU_ADDRESS 0 /end MEASUREMENT
/begin MEASUREMENT Rte_HighFreqAssist_WIRCmdAmpBlnd_MtrNm_f32 "MICROSAR RTE" FLOAT32_IEEE NO_COMPU_METHOD 0 0 1.175494351e-38 3.402823466e+38 ECU_ADDRESS 0 /end MEASUREMENT
/begin MEASUREMENT Rte_MtrDrvDiag_MtrDrvrInitComplete_Cnt_lgc "MICROSAR RTE" UBYTE RTE_CM_BOOLEAN 0 0 0 255 ECU_ADDRESS 0 /end MEASUREMENT
/begin MEASUREMENT Rte_HwPwUp_MtrDrvrInitStart_Cnt_lgc "MICROSAR RTE" UBYTE RTE_CM_BOOLEAN 0 0 0 255 ECU_ADDRESS 0 /end MEASUREMENT
/begin MEASUREMENT Rte_TmprlMon_TMFTestComplete_Cnt_lgc "MICROSAR RTE" UBYTE RTE_CM_BOOLEAN 0 0 0 255 ECU_ADDRESS 0 /end MEASUREMENT
/begin MEASUREMENT Rte_HwPwUp_TMFTestStart_Cnt_lgc "MICROSAR RTE" UBYTE RTE_CM_BOOLEAN 0 0 0 255 ECU_ADDRESS 0 /end MEASUREMENT
/begin MEASUREMENT Rte_Nhet1CfgAndUse_HwTq1Qlfr_State_enum "MICROSAR RTE" UBYTE RTE_CM_ENUM_SigQlfr_State_enum 0 0 0 2 ECU_ADDRESS 0 /end MEASUREMENT
/begin MEASUREMENT Rte_Nhet1CfgAndUse_HwTq1RollgCntr_Cnt_u08 "MICROSAR RTE" UBYTE NO_COMPU_METHOD 0 0 0 255 ECU_ADDRESS 0 /end MEASUREMENT
/begin MEASUREMENT Rte_Nhet1CfgAndUse_HwTq1Val_HwNm_f32 "MICROSAR RTE" FLOAT32_IEEE NO_COMPU_METHOD 0 0 1.175494351e-38 3.402823466e+38 ECU_ADDRESS 0 /end MEASUREMENT
/begin MEASUREMENT Rte_Nhet1CfgAndUse_HwTq2Qlfr_State_enum "MICROSAR RTE" UBYTE RTE_CM_ENUM_SigQlfr_State_enum 0 0 0 2 ECU_ADDRESS 0 /end MEASUREMENT
/begin MEASUREMENT Rte_Nhet1CfgAndUse_HwTq2RollgCntr_Cnt_u08 "MICROSAR RTE" UBYTE NO_COMPU_METHOD 0 0 0 255 ECU_ADDRESS 0 /end MEASUREMENT
/begin MEASUREMENT Rte_Nhet1CfgAndUse_HwTq2Val_HwNm_f32 "MICROSAR RTE" FLOAT32_IEEE NO_COMPU_METHOD 0 0 1.175494351e-38 3.402823466e+38 ECU_ADDRESS 0 /end MEASUREMENT
/begin MEASUREMENT Rte_HwTqArbn_HwTqArbnEOLCh1OffsetTrimData.HwTqArb_EOLChOffsetTrimPerf_Cnt_lgc "MICROSAR RTE" UBYTE RTE_CM_BOOLEAN 0 0 0 255 ECU_ADDRESS 0 READ_WRITE /end MEASUREMENT
/begin MEASUREMENT Rte_HwTqArbn_HwTqArbnEOLCh1OffsetTrimData.HwTqArb_EOLChOffsetTrim_HwNm_f32 "MICROSAR RTE" FLOAT32_IEEE NO_COMPU_METHOD 0 0 1.175494351e-38 3.402823466e+38 ECU_ADDRESS 0 READ_WRITE /end MEASUREMENT
/begin MEASUREMENT Rte_HwTqCorrln_HwTqCorrlnSts_Cnt_u16 "MICROSAR RTE" UWORD NO_COMPU_METHOD 0 0 0 65535 ECU_ADDRESS 0 /end MEASUREMENT
/begin MEASUREMENT Rte_HwTqArbn_HwTqVal_HwNm_f32 "MICROSAR RTE" FLOAT32_IEEE NO_COMPU_METHOD 0 0 1.175494351e-38 3.402823466e+38 ECU_ADDRESS 0 /end MEASUREMENT
/begin MEASUREMENT Rte_HwTqArbn_SVC_ClearCodes_Cnt_lgc "MICROSAR RTE" UBYTE RTE_CM_BOOLEAN 0 0 0 255 ECU_ADDRESS 0 /end MEASUREMENT
/begin MEASUREMENT Rte_HwTqCorrln_HwTqCorrlnCh1CMCLPFSvData "MICROSAR RTE" FLOAT32_IEEE NO_COMPU_METHOD 0 0 1.175494351e-38 3.402823466e+38 ECU_ADDRESS 0 READ_WRITE /end MEASUREMENT
/begin MEASUREMENT Rte_HwTqCorrln_HwTqIdptSig_Cnt_u08 "MICROSAR RTE" UBYTE NO_COMPU_METHOD 0 0 0 255 ECU_ADDRESS 0 /end MEASUREMENT
/begin MEASUREMENT Rte_HystComp_WIRCmdAmpBlnd_MtrNm_f32 "MICROSAR RTE" FLOAT32_IEEE NO_COMPU_METHOD 0 0 1.175494351e-38 3.402823466e+38 ECU_ADDRESS 0 /end MEASUREMENT
/begin MEASUREMENT Rte_VehSpdLmt_AstVehSpdLimit_MtrNm_f32 "MICROSAR RTE" FLOAT32_IEEE NO_COMPU_METHOD 0 0 1.175494351e-38 3.402823466e+38 ECU_ADDRESS 0 /end MEASUREMENT
/begin MEASUREMENT Rte_StOpCtrl_OutputRampMult_Uls_f32 "MICROSAR RTE" FLOAT32_IEEE NO_COMPU_METHOD 0 0 1.175494351e-38 3.402823466e+38 ECU_ADDRESS 0 /end MEASUREMENT
/begin MEASUREMENT Rte_ThrmlDutyCycle_ThermalLimit_MtrNm_f32 "MICROSAR RTE" FLOAT32_IEEE NO_COMPU_METHOD 0 0 1.175494351e-38 3.402823466e+38 ECU_ADDRESS 0 /end MEASUREMENT
/begin MEASUREMENT Rte_LoaMgr_LOASt_State_enum "MICROSAR RTE" UBYTE RTE_CM_ENUM_LOA_State_enum 0 0 0 5 ECU_ADDRESS 0 /end MEASUREMENT
/begin MEASUREMENT Rte_LoaMgr_LoaRateLimit_UlspS_f32 "MICROSAR RTE" FLOAT32_IEEE NO_COMPU_METHOD 0 0 1.175494351e-38 3.402823466e+38 ECU_ADDRESS 0 /end MEASUREMENT
/begin MEASUREMENT Rte_LoaMgr_LoaScaleFctr_Uls_f32 "MICROSAR RTE" FLOAT32_IEEE NO_COMPU_METHOD 0 0 1.175494351e-38 3.402823466e+38 ECU_ADDRESS 0 /end MEASUREMENT
/begin MEASUREMENT Rte_LoaMgr_MotAgLoaMtgtnEn_Cnt_lgc "MICROSAR RTE" UBYTE RTE_CM_BOOLEAN 0 0 0 255 ECU_ADDRESS 0 /end MEASUREMENT
/begin MEASUREMENT Rte_TqRsDg_MtrCurrIdptSig_Cnt_u08 "MICROSAR RTE" UBYTE NO_COMPU_METHOD 0 0 0 255 ECU_ADDRESS 0 /end MEASUREMENT
/begin MEASUREMENT Rte_LoaMgr_MtrPosIdptSig_Cnt_u08 "MICROSAR RTE" UBYTE NO_COMPU_METHOD 0 0 0 255 ECU_ADDRESS 0 /end MEASUREMENT
/begin MEASUREMENT Rte_LoaMgr_SteerMod_Cnt_enum "MICROSAR RTE" UBYTE RTE_CM_ENUM_SteerMod_enum 0 0 0 2 ECU_ADDRESS 0 /end MEASUREMENT
/begin MEASUREMENT Rte_TrqLOA_TrqLOAAvail_Cnt_lgc "MICROSAR RTE" UBYTE RTE_CM_BOOLEAN 0 0 0 255 ECU_ADDRESS 0 /end MEASUREMENT
/begin MEASUREMENT Rte_LoaMgr_TloaDi_Cnt_lgc "MICROSAR RTE" UBYTE RTE_CM_BOOLEAN 0 0 0 255 ECU_ADDRESS 0 /end MEASUREMENT
/begin MEASUREMENT Rte_LrnEOT_LearnedEOT.CCWEOTFound_Cnt_lgc "MICROSAR RTE" UBYTE RTE_CM_BOOLEAN 0 0 0 255 ECU_ADDRESS 0 READ_WRITE /end MEASUREMENT
/begin MEASUREMENT Rte_LrnEOT_LearnedEOT.CCWEOTPosition_HwDeg_f32 "MICROSAR RTE" FLOAT32_IEEE NO_COMPU_METHOD 0 0 1.175494351e-38 3.402823466e+38 ECU_ADDRESS 0 READ_WRITE /end MEASUREMENT
/begin MEASUREMENT Rte_LrnEOT_LearnedEOT.CWEOTFound_Cnt_lgc "MICROSAR RTE" UBYTE RTE_CM_BOOLEAN 0 0 0 255 ECU_ADDRESS 0 READ_WRITE /end MEASUREMENT
/begin MEASUREMENT Rte_LrnEOT_LearnedEOT.CWEOTPosition_HwDeg_f32 "MICROSAR RTE" FLOAT32_IEEE NO_COMPU_METHOD 0 0 1.175494351e-38 3.402823466e+38 ECU_ADDRESS 0 READ_WRITE /end MEASUREMENT
/begin MEASUREMENT Rte_MtrDrvDiag_FETFaultPhase_Cnt_enum "MICROSAR RTE" UBYTE RTE_CM_ENUM_FETPHASETYPE_ENUM 0 0 0 255 ECU_ADDRESS 0 /end MEASUREMENT
/begin MEASUREMENT Rte_MtrDrvDiag_FETFaultType_Cnt_enum "MICROSAR RTE" UBYTE RTE_CM_ENUM_FETFAULTTYPE_ENUM 0 0 0 255 ECU_ADDRESS 0 /end MEASUREMENT
/begin MEASUREMENT Rte_MtrTempEst_AmbTemp_DegC_f32 "MICROSAR RTE" FLOAT32_IEEE NO_COMPU_METHOD 0 0 1.175494351e-38 3.402823466e+38 ECU_ADDRESS 0 /end MEASUREMENT
/begin MEASUREMENT Rte_MtrTempEst_EngTemp_DegC_f32 "MICROSAR RTE" FLOAT32_IEEE NO_COMPU_METHOD 0 0 1.175494351e-38 3.402823466e+38 ECU_ADDRESS 0 /end MEASUREMENT
/begin MEASUREMENT Rte_PeakCurrEst_EstPkCurr_AmpSq_f32 "MICROSAR RTE" FLOAT32_IEEE NO_COMPU_METHOD 0 0 1.175494351e-38 3.402823466e+38 ECU_ADDRESS 0 /end MEASUREMENT
/begin MEASUREMENT Rte_MtrTempEst_ScomAMDefeat_Cnt_lgc "MICROSAR RTE" UBYTE RTE_CM_BOOLEAN 0 0 0 255 ECU_ADDRESS 0 /end MEASUREMENT
/begin MEASUREMENT Rte_MtrTempEst_ScomTempDataRcvd_Cnt_lgc "MICROSAR RTE" UBYTE RTE_CM_BOOLEAN 0 0 0 255 ECU_ADDRESS 0 /end MEASUREMENT
/begin MEASUREMENT Rte_MtrVel_HwVelValid_Cnt_lgc "MICROSAR RTE" UBYTE RTE_CM_BOOLEAN 0 0 0 255 ECU_ADDRESS 0 /end MEASUREMENT
/begin MEASUREMENT Rte_MtrVel2_SysCDiagHwVel_HwRadpS_f32 "MICROSAR RTE" FLOAT32_IEEE NO_COMPU_METHOD 0 0 1.175494351e-38 3.402823466e+38 ECU_ADDRESS 0 /end MEASUREMENT
/begin MEASUREMENT Rte_MtrVel2_SysCDiagMtrVelMRF_MtrRadpS_f32 "MICROSAR RTE" FLOAT32_IEEE NO_COMPU_METHOD 0 0 1.175494351e-38 3.402823466e+38 ECU_ADDRESS 0 /end MEASUREMENT
/begin MEASUREMENT Rte_MtrVel_SysCHandwheelVel_HwRadpS_f32 "MICROSAR RTE" FLOAT32_IEEE NO_COMPU_METHOD 0 0 1.175494351e-38 3.402823466e+38 ECU_ADDRESS 0 /end MEASUREMENT
/begin MEASUREMENT Rte_MtrVel_SysCMotorVelMRF_MtrRadpS_f32 "MICROSAR RTE" FLOAT32_IEEE NO_COMPU_METHOD 0 0 1.175494351e-38 3.402823466e+38 ECU_ADDRESS 0 /end MEASUREMENT
/begin MEASUREMENT Rte_SrlComInput_ReqModeDAFinal_Cnt_enum "MICROSAR RTE" UBYTE RTE_CM_ENUM_PsaTunModSt_Cnt_enum 0 0 0 3 ECU_ADDRESS 0 /end MEASUREMENT
/begin MEASUREMENT Rte_SrlComInput_MultiModeVld_Cnt_lgc "MICROSAR RTE" UBYTE RTE_CM_BOOLEAN 0 0 0 255 ECU_ADDRESS 0 /end MEASUREMENT
/begin MEASUREMENT Rte_PSADMQ_TunModSt_Cnt_enum "MICROSAR RTE" UBYTE RTE_CM_ENUM_PsaTunModSt_Cnt_enum 0 0 0 3 ECU_ADDRESS 0 /end MEASUREMENT
/begin MEASUREMENT Rte_TuningSelAuth_TunReqGranted_Cnt_lgc "MICROSAR RTE" UBYTE RTE_CM_BOOLEAN 0 0 0 255 ECU_ADDRESS 0 /end MEASUREMENT
/begin MEASUREMENT Rte_SrlComInput_AbsActv_Cnt_lgc "MICROSAR RTE" UBYTE RTE_CM_BOOLEAN 0 0 0 255 ECU_ADDRESS 0 /end MEASUREMENT
/begin MEASUREMENT Rte_SrlComInput_APAAuthn_Cnt_lgc "MICROSAR RTE" UBYTE RTE_CM_BOOLEAN 0 0 0 255 ECU_ADDRESS 0 /end MEASUREMENT
/begin MEASUREMENT Rte_SrlComInput_APARequest_Cnt_lgc "MICROSAR RTE" UBYTE RTE_CM_BOOLEAN 0 0 0 255 ECU_ADDRESS 0 /end MEASUREMENT
/begin MEASUREMENT Rte_SrlComInput_PosSrvoHwAngle_HwDeg_f32 "MICROSAR RTE" FLOAT32_IEEE NO_COMPU_METHOD 0 0 1.175494351e-38 3.402823466e+38 ECU_ADDRESS 0 /end MEASUREMENT
/begin MEASUREMENT Rte_PSATA_ApaPosSrvoFlt_Cnt_lgc "MICROSAR RTE" UBYTE RTE_CM_BOOLEAN 0 0 0 255 ECU_ADDRESS 0 /end MEASUREMENT
/begin MEASUREMENT Rte_SrlComInput_ApaRelaxReq_Cnt_lgc "MICROSAR RTE" UBYTE RTE_CM_BOOLEAN 0 0 0 255 ECU_ADDRESS 0 /end MEASUREMENT
/begin MEASUREMENT Rte_PSASH_ApaState_Cnt_enum "MICROSAR RTE" UBYTE RTE_CM_ENUM_PsaApaSt_Cnt_enum 0 0 0 3 ECU_ADDRESS 0 /end MEASUREMENT
/begin MEASUREMENT Rte_PSASH_ApaStateTransitionCause_Cnt_enum "MICROSAR RTE" UBYTE RTE_CM_ENUM_PsaApaTranCause_Cnt_enum 0 0 0 7 ECU_ADDRESS 0 /end MEASUREMENT
/begin MEASUREMENT Rte_SrlComInput_CPKOK_Cnt_lgc "MICROSAR RTE" UBYTE RTE_CM_BOOLEAN 0 0 0 255 ECU_ADDRESS 0 /end MEASUREMENT
/begin MEASUREMENT Rte_PSASH_DrvrIntvDetd_Cnt_lgc "MICROSAR RTE" UBYTE RTE_CM_BOOLEAN 0 0 0 255 ECU_ADDRESS 0 /end MEASUREMENT
/begin MEASUREMENT Rte_PSASH_EPSStateForLxa_Cnt_enum "MICROSAR RTE" UBYTE RTE_CM_ENUM_PsaEpsStLxa_Cnt_enum 0 0 0 4 ECU_ADDRESS 0 /end MEASUREMENT
/begin MEASUREMENT Rte_SrlComInput_EscActv_Cnt_lgc "MICROSAR RTE" UBYTE RTE_CM_BOOLEAN 0 0 0 255 ECU_ADDRESS 0 /end MEASUREMENT
/begin MEASUREMENT Rte_SrlComInput_EscEna_Cnt_lgc "MICROSAR RTE" UBYTE RTE_CM_BOOLEAN 0 0 0 255 ECU_ADDRESS 0 /end MEASUREMENT
/begin MEASUREMENT Rte_SrlComInput_EscFltPrsnt_Cnt_lgc "MICROSAR RTE" UBYTE RTE_CM_BOOLEAN 0 0 0 255 ECU_ADDRESS 0 /end MEASUREMENT
/begin MEASUREMENT Rte_PSASH_HwTrqRate_HwNmpS_f32 "MICROSAR RTE" FLOAT32_IEEE NO_COMPU_METHOD 0 0 1.175494351e-38 3.402823466e+38 ECU_ADDRESS 0 /end MEASUREMENT
/begin MEASUREMENT Rte_SrlComInput_LxaSeln_Cnt_lgc "MICROSAR RTE" UBYTE RTE_CM_BOOLEAN 0 0 0 255 ECU_ADDRESS 0 /end MEASUREMENT
/begin MEASUREMENT Rte_PSASH_LxaApaConflictReqNTC_Cnt_lgc "MICROSAR RTE" UBYTE RTE_CM_BOOLEAN 0 0 0 255 ECU_ADDRESS 0 /end MEASUREMENT
/begin MEASUREMENT Rte_PSASH_LxaCorrnFacReqLimd_Uls_f32 "MICROSAR RTE" FLOAT32_IEEE NO_COMPU_METHOD 0 0 1.175494351e-38 3.402823466e+38 ECU_ADDRESS 0 /end MEASUREMENT
/begin MEASUREMENT Rte_PSASH_LxaDrvrAbsntDetd_Cnt_lgc "MICROSAR RTE" UBYTE RTE_CM_BOOLEAN 0 0 0 255 ECU_ADDRESS 0 /end MEASUREMENT
/begin MEASUREMENT Rte_PSASH_LxaDrvrAbsntHwVelDetd_Cnt_lgc "MICROSAR RTE" UBYTE RTE_CM_BOOLEAN 0 0 0 255 ECU_ADDRESS 0 /end MEASUREMENT
/begin MEASUREMENT Rte_PSASH_LxaDrvrAbsntWarn_Cnt_lgc "MICROSAR RTE" UBYTE RTE_CM_BOOLEAN 0 0 0 255 ECU_ADDRESS 0 /end MEASUREMENT
/begin MEASUREMENT Rte_SrlComInput_ColAngleSetpoint_HwDeg_f32 "MICROSAR RTE" FLOAT32_IEEE NO_COMPU_METHOD 0 0 1.175494351e-38 3.402823466e+38 ECU_ADDRESS 0 /end MEASUREMENT
/begin MEASUREMENT Rte_PSASH_LxaHwAgDetd_Cnt_lgc "MICROSAR RTE" UBYTE RTE_CM_BOOLEAN 0 0 0 255 ECU_ADDRESS 0 /end MEASUREMENT
/begin MEASUREMENT Rte_PSASH_LxaInactivOnDrvrBhvr_Cnt_lgc "MICROSAR RTE" UBYTE RTE_CM_BOOLEAN 0 0 0 255 ECU_ADDRESS 0 /end MEASUREMENT
/begin MEASUREMENT Rte_SrlComInput_LxaInpVld_Cnt_lgc "MICROSAR RTE" UBYTE RTE_CM_BOOLEAN 0 0 0 255 ECU_ADDRESS 0 /end MEASUREMENT
/begin MEASUREMENT Rte_SrlComInput_LxaStateFilt_Cnt_enum "MICROSAR RTE" UBYTE RTE_CM_ENUM_PsaLxaSt_Cnt_enum 0 0 0 6 ECU_ADDRESS 0 /end MEASUREMENT
/begin MEASUREMENT Rte_SrlComInput_LxaTqFacReq_Uls_f32 "MICROSAR RTE" FLOAT32_IEEE NO_COMPU_METHOD 0 0 1.175494351e-38 3.402823466e+38 ECU_ADDRESS 0 /end MEASUREMENT
/begin MEASUREMENT Rte_PSASH_PosSrvoEnable_Cnt_lgc "MICROSAR RTE" UBYTE RTE_CM_BOOLEAN 0 0 0 255 ECU_ADDRESS 0 /end MEASUREMENT
/begin MEASUREMENT Rte_PSASH_PosSrvoHwAngle_HwDeg_f32 "MICROSAR RTE" FLOAT32_IEEE NO_COMPU_METHOD 0 0 1.175494351e-38 3.402823466e+38 ECU_ADDRESS 0 /end MEASUREMENT
/begin MEASUREMENT Rte_SrlComInput_ApaVehicleSpeedValid_Cnt_lgc "MICROSAR RTE" UBYTE RTE_CM_BOOLEAN 0 0 0 255 ECU_ADDRESS 0 /end MEASUREMENT
/begin MEASUREMENT Rte_PSATA_ApaOpTrqOv_MtrNm_f32 "MICROSAR RTE" FLOAT32_IEEE NO_COMPU_METHOD 0 0 1.175494351e-38 3.402823466e+38 ECU_ADDRESS 0 /end MEASUREMENT
/begin MEASUREMENT Rte_PSATA_LxaOpTrqOv_MtrNm_f32 "MICROSAR RTE" FLOAT32_IEEE NO_COMPU_METHOD 0 0 1.175494351e-38 3.402823466e+38 ECU_ADDRESS 0 /end MEASUREMENT
/begin MEASUREMENT Rte_PSATA_LxaTqLimnActv_Cnt_lgc "MICROSAR RTE" UBYTE RTE_CM_BOOLEAN 0 0 0 255 ECU_ADDRESS 0 /end MEASUREMENT
/begin MEASUREMENT Rte_PosServo_PosSrvoCmd_MtrNm_f32 "MICROSAR RTE" FLOAT32_IEEE NO_COMPU_METHOD 0 0 1.175494351e-38 3.402823466e+38 ECU_ADDRESS 0 /end MEASUREMENT
/begin MEASUREMENT Rte_PeakCurrEst_DualEcuMotCtrlMtgnEna_Cnt_lgc "MICROSAR RTE" UBYTE RTE_CM_BOOLEAN 0 0 0 255 ECU_ADDRESS 0 /end MEASUREMENT
/begin MEASUREMENT Rte_PeakCurrEst_FiltEstPkCurr_AmpSq_f32 "MICROSAR RTE" FLOAT32_IEEE NO_COMPU_METHOD 0 0 1.175494351e-38 3.402823466e+38 ECU_ADDRESS 0 /end MEASUREMENT
/begin MEASUREMENT Rte_PosServo_PosSrvoReturnSclFct_Uls_f32 "MICROSAR RTE" FLOAT32_IEEE NO_COMPU_METHOD 0 0 1.175494351e-38 3.402823466e+38 ECU_ADDRESS 0 /end MEASUREMENT
/begin MEASUREMENT Rte_PosServo_PosSrvoSmoothEnable_Uls_f32 "MICROSAR RTE" FLOAT32_IEEE NO_COMPU_METHOD 0 0 1.175494351e-38 3.402823466e+38 ECU_ADDRESS 0 /end MEASUREMENT
/begin MEASUREMENT Rte_PsaAgArbn_AbsltHwPosn_HwDeg_f32 "MICROSAR RTE" FLOAT32_IEEE NO_COMPU_METHOD 0 0 1.175494351e-38 3.402823466e+38 ECU_ADDRESS 0 /end MEASUREMENT
/begin MEASUREMENT Rte_PsaAgArbn_AbsltHwPosnLvl1_Cnt_lgc "MICROSAR RTE" UBYTE RTE_CM_BOOLEAN 0 0 0 255 ECU_ADDRESS 0 /end MEASUREMENT
/begin MEASUREMENT Rte_PsaAgArbn_AbsltHwPosnLvl2_Cnt_lgc "MICROSAR RTE" UBYTE RTE_CM_BOOLEAN 0 0 0 255 ECU_ADDRESS 0 /end MEASUREMENT
/begin MEASUREMENT Rte_PsaAgArbn_AbsltHwPosnPrecision_HwDeg_f32 "MICROSAR RTE" FLOAT32_IEEE NO_COMPU_METHOD 0 0 1.175494351e-38 3.402823466e+38 ECU_ADDRESS 0 /end MEASUREMENT
/begin MEASUREMENT Rte_PsaAgArbn_AbsltHwPosnVld_Cnt_lgc "MICROSAR RTE" UBYTE RTE_CM_BOOLEAN 0 0 0 255 ECU_ADDRESS 0 /end MEASUREMENT
/begin MEASUREMENT Rte_PsaAgArbn_AgArbnStToSerlCom_Cnt_enum "MICROSAR RTE" UBYTE RTE_CM_ENUM_PsaAgArbnSt_Enum 0 0 0 7 ECU_ADDRESS 0 /end MEASUREMENT
/begin MEASUREMENT Rte_SrlComInput_EscAckFromSerlCom_Cnt_lgc "MICROSAR RTE" UBYTE RTE_CM_BOOLEAN 0 0 0 255 ECU_ADDRESS 0 /end MEASUREMENT
/begin MEASUREMENT Rte_SrlComInput_EscDataVldFromSerlCom_Cnt_lgc "MICROSAR RTE" UBYTE RTE_CM_BOOLEAN 0 0 0 255 ECU_ADDRESS 0 /end MEASUREMENT
/begin MEASUREMENT Rte_SrlComInput_EscOffsFromSerlCom_HwDeg_f32 "MICROSAR RTE" FLOAT32_IEEE NO_COMPU_METHOD 0 0 1.175494351e-38 3.402823466e+38 ECU_ADDRESS 0 /end MEASUREMENT
/begin MEASUREMENT Rte_SrlComInput_EscPrecisionFromSerlCom_HwDeg_f32 "MICROSAR RTE" FLOAT32_IEEE NO_COMPU_METHOD 0 0 1.175494351e-38 3.402823466e+38 ECU_ADDRESS 0 /end MEASUREMENT
/begin MEASUREMENT Rte_PsaAgArbn_PsaAgArbnLrndOffsData.MaxOffset "MICROSAR RTE" FLOAT32_IEEE NO_COMPU_METHOD 0 0 1.175494351e-38 3.402823466e+38 ECU_ADDRESS 0 READ_WRITE /end MEASUREMENT
/begin MEASUREMENT Rte_PsaAgArbn_PsaAgArbnLrndOffsData.MaxSrc "MICROSAR RTE" UBYTE NO_COMPU_METHOD 0 0 0 255 ECU_ADDRESS 0 READ_WRITE /end MEASUREMENT
/begin MEASUREMENT Rte_PsaAgArbn_PsaAgArbnLrndOffsData.MinOffset "MICROSAR RTE" FLOAT32_IEEE NO_COMPU_METHOD 0 0 1.175494351e-38 3.402823466e+38 ECU_ADDRESS 0 READ_WRITE /end MEASUREMENT
/begin MEASUREMENT Rte_PsaAgArbn_PsaAgArbnLrndOffsData.MinSrc "MICROSAR RTE" UBYTE NO_COMPU_METHOD 0 0 0 255 ECU_ADDRESS 0 READ_WRITE /end MEASUREMENT
/begin MEASUREMENT Rte_PsaAgArbn_RelHwPosnToSerlCom_HwDeg_f32 "MICROSAR RTE" FLOAT32_IEEE NO_COMPU_METHOD 0 0 1.175494351e-38 3.402823466e+38 ECU_ADDRESS 0 /end MEASUREMENT
/begin MEASUREMENT Rte_PsaAgArbn_RelHwPosnVldToSerlCom_Cnt_lgc "MICROSAR RTE" UBYTE RTE_CM_BOOLEAN 0 0 0 255 ECU_ADDRESS 0 /end MEASUREMENT
/begin MEASUREMENT Rte_PwrLmtFuncCr_PosServEnable_Cnt_lgc "MICROSAR RTE" UBYTE RTE_CM_BOOLEAN 0 0 0 255 ECU_ADDRESS 0 /end MEASUREMENT
/begin MEASUREMENT Rte_PwrLmtFuncCr_ThresholdExceeded_Cnt_lgc "MICROSAR RTE" UBYTE RTE_CM_BOOLEAN 0 0 0 255 ECU_ADDRESS 0 /end MEASUREMENT
/begin MEASUREMENT Rte_QuadDet_InstMtrDir_Cnt_s08 "MICROSAR RTE" SBYTE NO_COMPU_METHOD 0 0 -128 127 ECU_ADDRESS 0 /end MEASUREMENT
/begin GROUP FaultLog.FaultLog "MICROSAR RTE"
 /begin REF_MEASUREMENT Rte_FaultLog_FaultLog.QueueData[42].Status_Cnt_u08 Rte_FaultLog_FaultLog.QueueData[43].QueueEventIdx_Cnt_u08 Rte_FaultLog_FaultLog.QueueData[43].Status_Cnt_u08 Rte_FaultLog_FaultLog.QueueData[44].QueueEventIdx_Cnt_u08 Rte_FaultLog_FaultLog.QueueData[44].Status_Cnt_u08 Rte_FaultLog_FaultLog.QueueData[45].QueueEventIdx_Cnt_u08 Rte_FaultLog_FaultLog.QueueData[45].Status_Cnt_u08 Rte_FaultLog_FaultLog.QueueData[46].QueueEventIdx_Cnt_u08 Rte_FaultLog_FaultLog.QueueData[46].Status_Cnt_u08 Rte_FaultLog_FaultLog.QueueData[47].QueueEventIdx_Cnt_u08 Rte_FaultLog_FaultLog.QueueData[47].Status_Cnt_u08 Rte_FaultLog_FaultLog.QueueData[48].QueueEventIdx_Cnt_u08 Rte_FaultLog_FaultLog.QueueData[48].Status_Cnt_u08 Rte_FaultLog_FaultLog.QueueData[49].QueueEventIdx_Cnt_u08 Rte_FaultLog_FaultLog.QueueData[49].Status_Cnt_u08 Rte_FaultLog_FaultLog.QueueData[4].QueueEventIdx_Cnt_u08 Rte_FaultLog_FaultLog.QueueData[4].Status_Cnt_u08 Rte_FaultLog_FaultLog.QueueData[50].QueueEventIdx_Cnt_u08 Rte_FaultLog_FaultLog.QueueData[50].Status_Cnt_u08 Rte_FaultLog_FaultLog.QueueData[51].QueueEventIdx_Cnt_u08 Rte_FaultLog_FaultLog.QueueData[51].Status_Cnt_u08 Rte_FaultLog_FaultLog.QueueData[52].QueueEventIdx_Cnt_u08 Rte_FaultLog_FaultLog.QueueData[52].Status_Cnt_u08 Rte_FaultLog_FaultLog.QueueData[53].QueueEventIdx_Cnt_u08 Rte_FaultLog_FaultLog.QueueData[53].Status_Cnt_u08 Rte_FaultLog_FaultLog.QueueData[54].QueueEventIdx_Cnt_u08 Rte_FaultLog_FaultLog.QueueData[54].Status_Cnt_u08 Rte_FaultLog_FaultLog.QueueData[55].QueueEventIdx_Cnt_u08 Rte_FaultLog_FaultLog.QueueData[55].Status_Cnt_u08 Rte_FaultLog_FaultLog.QueueData[56].QueueEventIdx_Cnt_u08 Rte_FaultLog_FaultLog.QueueData[56].Status_Cnt_u08 Rte_FaultLog_FaultLog.QueueData[57].QueueEventIdx_Cnt_u08 Rte_FaultLog_FaultLog.QueueData[57].Status_Cnt_u08 Rte_FaultLog_FaultLog.QueueData[58].QueueEventIdx_Cnt_u08 Rte_FaultLog_FaultLog.QueueData[58].Status_Cnt_u08 Rte_FaultLog_FaultLog.QueueData[59].QueueEventIdx_Cnt_u08 Rte_FaultLog_FaultLog.QueueData[59].Status_Cnt_u08 Rte_FaultLog_FaultLog.QueueData[5].QueueEventIdx_Cnt_u08 Rte_FaultLog_FaultLog.QueueData[5].Status_Cnt_u08 Rte_FaultLog_FaultLog.QueueData[60].QueueEventIdx_Cnt_u08 Rte_FaultLog_FaultLog.QueueData[60].Status_Cnt_u08 Rte_FaultLog_FaultLog.QueueData[61].QueueEventIdx_Cnt_u08 Rte_FaultLog_FaultLog.QueueData[61].Status_Cnt_u08 Rte_FaultLog_FaultLog.QueueData[62].QueueEventIdx_Cnt_u08 Rte_FaultLog_FaultLog.QueueData[62].Status_Cnt_u08 Rte_FaultLog_FaultLog.QueueData[63].QueueEventIdx_Cnt_u08 Rte_FaultLog_FaultLog.QueueData[63].Status_Cnt_u08 Rte_FaultLog_FaultLog.QueueData[64].QueueEventIdx_Cnt_u08 Rte_FaultLog_FaultLog.QueueData[64].Status_Cnt_u08 Rte_FaultLog_FaultLog.QueueData[65].QueueEventIdx_Cnt_u08 Rte_FaultLog_FaultLog.QueueData[65].Status_Cnt_u08 Rte_FaultLog_FaultLog.QueueData[66].QueueEventIdx_Cnt_u08 Rte_FaultLog_FaultLog.QueueData[66].Status_Cnt_u08 Rte_FaultLog_FaultLog.QueueData[67].QueueEventIdx_Cnt_u08 Rte_FaultLog_FaultLog.QueueData[67].Status_Cnt_u08 Rte_FaultLog_FaultLog.QueueData[68].QueueEventIdx_Cnt_u08 Rte_FaultLog_FaultLog.QueueData[68].Status_Cnt_u08 Rte_FaultLog_FaultLog.QueueData[69].QueueEventIdx_Cnt_u08 Rte_FaultLog_FaultLog.QueueData[69].Status_Cnt_u08 Rte_FaultLog_FaultLog.QueueData[6].QueueEventIdx_Cnt_u08 Rte_FaultLog_FaultLog.QueueData[6].Status_Cnt_u08 Rte_FaultLog_FaultLog.QueueData[70].QueueEventIdx_Cnt_u08 Rte_FaultLog_FaultLog.QueueData[70].Status_Cnt_u08 Rte_FaultLog_FaultLog.QueueData[71].QueueEventIdx_Cnt_u08 Rte_FaultLog_FaultLog.QueueData[71].Status_Cnt_u08 Rte_FaultLog_FaultLog.QueueData[72].QueueEventIdx_Cnt_u08 Rte_FaultLog_FaultLog.QueueData[72].Status_Cnt_u08 Rte_FaultLog_FaultLog.QueueData[73].QueueEventIdx_Cnt_u08 Rte_FaultLog_FaultLog.QueueData[73].Status_Cnt_u08 Rte_FaultLog_FaultLog.QueueData[74].QueueEventIdx_Cnt_u08 Rte_FaultLog_FaultLog.QueueData[74].Status_Cnt_u08 Rte_FaultLog_FaultLog.QueueData[75].QueueEventIdx_Cnt_u08 Rte_FaultLog_FaultLog.QueueData[75].Status_Cnt_u08 Rte_FaultLog_FaultLog.QueueData[76].QueueEventIdx_Cnt_u08 Rte_FaultLog_FaultLog.QueueData[76].Status_Cnt_u08 Rte_FaultLog_FaultLog.QueueData[77].QueueEventIdx_Cnt_u08 Rte_FaultLog_FaultLog.QueueData[77].Status_Cnt_u08 Rte_FaultLog_FaultLog.QueueData[78].QueueEventIdx_Cnt_u08 Rte_FaultLog_FaultLog.QueueData[78].Status_Cnt_u08 Rte_FaultLog_FaultLog.QueueData[79].QueueEventIdx_Cnt_u08 Rte_FaultLog_FaultLog.QueueData[79].Status_Cnt_u08 Rte_FaultLog_FaultLog.QueueData[7].QueueEventIdx_Cnt_u08 Rte_FaultLog_FaultLog.QueueData[7].Status_Cnt_u08 Rte_FaultLog_FaultLog.QueueData[80].QueueEventIdx_Cnt_u08 Rte_FaultLog_FaultLog.QueueData[80].Status_Cnt_u08 Rte_FaultLog_FaultLog.QueueData[81].QueueEventIdx_Cnt_u08 Rte_FaultLog_FaultLog.QueueData[81].Status_Cnt_u08 Rte_FaultLog_FaultLog.QueueData[82].QueueEventIdx_Cnt_u08 Rte_FaultLog_FaultLog.QueueData[82].Status_Cnt_u08 Rte_FaultLog_FaultLog.QueueData[83].QueueEventIdx_Cnt_u08 Rte_FaultLog_FaultLog.QueueData[83].Status_Cnt_u08 Rte_FaultLog_FaultLog.QueueData[84].QueueEventIdx_Cnt_u08 Rte_FaultLog_FaultLog.QueueData[84].Status_Cnt_u08 Rte_FaultLog_FaultLog.QueueData[85].QueueEventIdx_Cnt_u08 Rte_FaultLog_FaultLog.QueueData[85].Status_Cnt_u08 Rte_FaultLog_FaultLog.QueueData[86].QueueEventIdx_Cnt_u08 Rte_FaultLog_FaultLog.QueueData[86].Status_Cnt_u08 Rte_FaultLog_FaultLog.QueueData[87].QueueEventIdx_Cnt_u08 Rte_FaultLog_FaultLog.QueueData[87].Status_Cnt_u08 Rte_FaultLog_FaultLog.QueueData[88].QueueEventIdx_Cnt_u08 Rte_FaultLog_FaultLog.QueueData[88].Status_Cnt_u08 Rte_FaultLog_FaultLog.QueueData[89].QueueEventIdx_Cnt_u08 Rte_FaultLog_FaultLog.QueueData[89].Status_Cnt_u08 Rte_FaultLog_FaultLog.QueueData[8].QueueEventIdx_Cnt_u08 Rte_FaultLog_FaultLog.QueueData[8].Status_Cnt_u08 Rte_FaultLog_FaultLog.QueueData[90].QueueEventIdx_Cnt_u08 Rte_FaultLog_FaultLog.QueueData[90].Status_Cnt_u08 Rte_FaultLog_FaultLog.QueueData[91].QueueEventIdx_Cnt_u08 Rte_FaultLog_FaultLog.QueueData[91].Status_Cnt_u08 Rte_FaultLog_FaultLog.QueueData[92].QueueEventIdx_Cnt_u08 Rte_FaultLog_FaultLog.QueueData[92].Status_Cnt_u08 Rte_FaultLog_FaultLog.QueueData[93].QueueEventIdx_Cnt_u08 Rte_FaultLog_FaultLog.QueueData[93].Status_Cnt_u08 Rte_FaultLog_FaultLog.QueueData[94].QueueEventIdx_Cnt_u08 Rte_FaultLog_FaultLog.QueueData[94].Status_Cnt_u08 Rte_FaultLog_FaultLog.QueueData[95].QueueEventIdx_Cnt_u08 Rte_FaultLog_FaultLog.QueueData[95].Status_Cnt_u08 Rte_FaultLog_FaultLog.QueueData[96].QueueEventIdx_Cnt_u08 Rte_FaultLog_FaultLog.QueueData[96].Status_Cnt_u08 Rte_FaultLog_FaultLog.QueueData[97].QueueEventIdx_Cnt_u08 Rte_FaultLog_FaultLog.QueueData[97].Status_Cnt_u08 Rte_FaultLog_FaultLog.QueueData[98].QueueEventIdx_Cnt_u08 Rte_FaultLog_FaultLog.QueueData[98].Status_Cnt_u08 Rte_FaultLog_FaultLog.QueueData[99].QueueEventIdx_Cnt_u08 Rte_FaultLog_FaultLog.QueueData[99].Status_Cnt_u08 Rte_FaultLog_FaultLog.QueueData[9].QueueEventIdx_Cnt_u08 Rte_FaultLog_FaultLog.QueueData[9].Status_Cnt_u08 /end REF_MEASUREMENT
/end GROUP
/begin GROUP FaultLog.HandwheelPosition.HwDeg_f32 "MICROSAR RTE" /begin SUB_GROUP /end SUB_GROUP /begin FUNCTION_LIST /end FUNCTION_LIST /begin REF_CHARACTERISTIC /end REF_CHARACTERISTIC /end GROUP
/begin GROUP FaultLog.HandwheelTorque.HwNm_f32 "MICROSAR RTE" /begin SUB_GROUP /end SUB_GROUP /begin FUNCTION_LIST /end FUNCTION_LIST /begin REF_CHARACTERISTIC /end REF_CHARACTERISTIC /end GROUP
/begin GROUP FaultLog.Kilometrage.Cnt_u32 "MICROSAR RTE" /begin SUB_GROUP /end SUB_GROUP /begin FUNCTION_LIST /end FUNCTION_LIST /begin REF_CHARACTERISTIC /end REF_CHARACTERISTIC /begin REF_MEASUREMENT Rte_SrlComInput_Kilometrage_Cnt_u32 /end REF_MEASUREMENT /end GROUP
/begin GROUP FaultLog.ModeRequirePorts "MICROSAR RTE" /begin SUB_GROUP FaultLog.SystemState.Mode /end SUB_GROUP /begin FUNCTION_LIST /end FUNCTION_LIST /begin REF_CHARACTERISTIC /end REF_CHARACTERISTIC /begin REF_MEASUREMENT /end REF_MEASUREMENT /end GROUP
/begin GROUP FaultLog.MotorTorque.MtrNm_f32 "MICROSAR RTE" /begin SUB_GROUP /end SUB_GROUP /begin FUNCTION_LIST /end FUNCTION_LIST /begin REF_CHARACTERISTIC /end REF_CHARACTERISTIC /end GROUP
/begin GROUP FaultLog.PerInstanceMemories "MICROSAR RTE" /begin SUB_GROUP FaultLog.FaultLog /end SUB_GROUP /begin FUNCTION_LIST /end FUNCTION_LIST /begin REF_CHARACTERISTIC /end REF_CHARACTERISTIC /begin REF_MEASUREMENT /end REF_MEASUREMENT /end GROUP
/begin GROUP FaultLog.PowerSupplies.Cnt_u08 "MICROSAR RTE" /begin SUB_GROUP /end SUB_GROUP /begin FUNCTION_LIST /end FUNCTION_LIST /begin REF_CHARACTERISTIC /end REF_CHARACTERISTIC /begin REF_MEASUREMENT Rte_SrlComInput_PowerSupplies_Cnt_u08 /end REF_MEASUREMENT /end GROUP
/begin GROUP FaultLog.ReceiverPorts "MICROSAR RTE"
 /begin SUB_GROUP FaultLog.BSIDataMissing.Cnt_lgc FaultLog.BatteryVoltage.Volt_f32 FaultLog.CMMDataMissing.Cnt_lgc FaultLog.CompteurTemporelVehicule.Cnt_u32 FaultLog.ComputerRazGCT.Cnt_u08 FaultLog.CtrlTemp.DegC_f32 FaultLog.EngineState.Cnt_u08 FaultLog.EtatPrincipSev.Cnt_u08 FaultLog.EtatReseauElec.Cnt_u08 FaultLog.HandwheelPosition.HwDeg_f32 FaultLog.HandwheelTorque.HwNm_f32 FaultLog.Kilometrage.Cnt_u32 FaultLog.MotorTorque.MtrNm_f32 FaultLog.PowerSupplies.Cnt_u08 FaultLog.ShuntPosition.Cnt_u08 FaultLog.TxEnabled.Cnt_lgc FaultLog.VehicleSpeed.Kph_f32 /end SUB_GROUP
 /begin FUNCTION_LIST /end FUNCTION_LIST
 /begin REF_CHARACTERISTIC /end REF_CHARACTERISTIC
 /begin REF_MEASUREMENT /end REF_MEASUREMENT
/end GROUP
/begin GROUP FaultLog.ShuntPosition.Cnt_u08 "MICROSAR RTE" /begin SUB_GROUP /end SUB_GROUP /begin FUNCTION_LIST /end FUNCTION_LIST /begin REF_CHARACTERISTIC /end REF_CHARACTERISTIC /begin REF_MEASUREMENT Rte_SrlComInput_ShuntPosition_Cnt_u08 /end REF_MEASUREMENT /end GROUP
/begin GROUP FaultLog.SystemState.Mode "MICROSAR RTE" /begin SUB_GROUP /end SUB_GROUP /begin FUNCTION_LIST /end FUNCTION_LIST /begin REF_CHARACTERISTIC /end REF_CHARACTERISTIC /end GROUP
/begin GROUP FaultLog.TxEnabled.Cnt_lgc "MICROSAR RTE" /begin SUB_GROUP /end SUB_GROUP /begin FUNCTION_LIST /end FUNCTION_LIST /begin REF_CHARACTERISTIC /end REF_CHARACTERISTIC /begin REF_MEASUREMENT Rte_SrlComDriver_TxEnabled_Cnt_lgc /end REF_MEASUREMENT /end GROUP
/begin GROUP FaultLog.VehicleSpeed.Kph_f32 "MICROSAR RTE" /begin SUB_GROUP /end SUB_GROUP /begin FUNCTION_LIST /end FUNCTION_LIST /begin REF_CHARACTERISTIC /end REF_CHARACTERISTIC /end GROUP
/begin GROUP FltInjection "MICROSAR RTE" /begin SUB_GROUP FltInjection.ReceiverPorts /end SUB_GROUP /begin FUNCTION_LIST /end FUNCTION_LIST /begin REF_CHARACTERISTIC /end REF_CHARACTERISTIC /begin REF_MEASUREMENT /end REF_MEASUREMENT /end GROUP
/begin GROUP FltInjection.MotorVelCRF.MtrRadpS_f32 "MICROSAR RTE" /begin SUB_GROUP /end SUB_GROUP /begin FUNCTION_LIST /end FUNCTION_LIST /begin REF_CHARACTERISTIC /end REF_CHARACTERISTIC /end GROUP
/begin GROUP FltInjection.ReceiverPorts "MICROSAR RTE" /begin SUB_GROUP FltInjection.MotorVelCRF.MtrRadpS_f32 /end SUB_GROUP /begin FUNCTION_LIST /end FUNCTION_LIST /begin REF_CHARACTERISTIC /end REF_CHARACTERISTIC /begin REF_MEASUREMENT /end REF_MEASUREMENT /end GROUP
/begin GROUP FrqDepDmpnInrtCmp "MICROSAR RTE"
 /begin SUB_GROUP FrqDepDmpnInrtCmp.ModeRequirePorts FrqDepDmpnInrtCmp.ReceiverPorts FrqDepDmpnInrtCmp.SenderPorts /end SUB_GROUP
 /begin FUNCTION_LIST /end FUNCTION_LIST
 /begin REF_CHARACTERISTIC /end REF_CHARACTERISTIC
 /begin REF_MEASUREMENT /end REF_MEASUREMENT
/end GROUP
/begin GROUP FrqDepDmpnInrtCmp.BaseAssistCmd.MtrNm_f32 "MICROSAR RTE" /begin SUB_GROUP /end SUB_GROUP /begin FUNCTION_LIST /end FUNCTION_LIST /begin REF_CHARACTERISTIC /end REF_CHARACTERISTIC /end GROUP
/begin GROUP FrqDepDmpnInrtCmp.CRFMotorVel.MtrRadpS_f32 "MICROSAR RTE" /begin SUB_GROUP /end SUB_GROUP /begin FUNCTION_LIST /end FUNCTION_LIST /begin REF_CHARACTERISTIC /end REF_CHARACTERISTIC /end GROUP
/begin GROUP FrqDepDmpnInrtCmp.FreqDepDmpSrlComSvcDft.Cnt_lgc "MICROSAR RTE" /begin SUB_GROUP /end SUB_GROUP /begin FUNCTION_LIST /end FUNCTION_LIST /begin REF_CHARACTERISTIC /end REF_CHARACTERISTIC /end GROUP
/begin GROUP FrqDepDmpnInrtCmp.FrqDepDmpnInrtCmp.MtrNm_f32 "MICROSAR RTE" /begin SUB_GROUP /end SUB_GROUP /begin FUNCTION_LIST /end FUNCTION_LIST /begin REF_CHARACTERISTIC /end REF_CHARACTERISTIC /end GROUP
/begin GROUP FrqDepDmpnInrtCmp.HwTorque.HwNm_f32 "MICROSAR RTE" /begin SUB_GROUP /end SUB_GROUP /begin FUNCTION_LIST /end FUNCTION_LIST /begin REF_CHARACTERISTIC /end REF_CHARACTERISTIC /end GROUP
/begin GROUP FrqDepDmpnInrtCmp.ModeRequirePorts "MICROSAR RTE" /begin SUB_GROUP FrqDepDmpnInrtCmp.SystemState.Mode /end SUB_GROUP /begin FUNCTION_LIST /end FUNCTION_LIST /begin REF_CHARACTERISTIC /end REF_CHARACTERISTIC /begin REF_MEASUREMENT /end REF_MEASUREMENT /end GROUP
/begin GROUP FrqDepDmpnInrtCmp.ReceiverPorts "MICROSAR RTE"
 /begin SUB_GROUP FrqDepDmpnInrtCmp.BaseAssistCmd.MtrNm_f32 FrqDepDmpnInrtCmp.CRFMotorVel.MtrRadpS_f32 FrqDepDmpnInrtCmp.FreqDepDmpSrlComSvcDft.Cnt_lgc FrqDepDmpnInrtCmp.HwTorque.HwNm_f32 FrqDepDmpnInrtCmp.VehicleLonAccel.KphpS_f32 FrqDepDmpnInrtCmp.VehicleSpeed.Kph_f32 FrqDepDmpnInrtCmp.WIRCmdAmpBlnd.MtrNm_f32 /end SUB_GROUP
 /begin FUNCTION_LIST /end FUNCTION_LIST
 /begin REF_CHARACTERISTIC /end REF_CHARACTERISTIC
 /begin REF_MEASUREMENT /end REF_MEASUREMENT
/end GROUP
/begin GROUP FrqDepDmpnInrtCmp.SenderPorts "MICROSAR RTE" /begin SUB_GROUP FrqDepDmpnInrtCmp.FrqDepDmpnInrtCmp.MtrNm_f32 /end SUB_GROUP /begin FUNCTION_LIST /end FUNCTION_LIST /begin REF_CHARACTERISTIC /end REF_CHARACTERISTIC /begin REF_MEASUREMENT /end REF_MEASUREMENT /end GROUP
/begin GROUP FrqDepDmpnInrtCmp.SystemState.Mode "MICROSAR RTE" /begin SUB_GROUP /end SUB_GROUP /begin FUNCTION_LIST /end FUNCTION_LIST /begin REF_CHARACTERISTIC /end REF_CHARACTERISTIC /end GROUP
/begin GROUP FrqDepDmpnInrtCmp.VehicleLonAccel.KphpS_f32 "MICROSAR RTE" /begin SUB_GROUP /end SUB_GROUP /begin FUNCTION_LIST /end FUNCTION_LIST /begin REF_CHARACTERISTIC /end REF_CHARACTERISTIC /end GROUP
/begin GROUP FrqDepDmpnInrtCmp.VehicleSpeed.Kph_f32 "MICROSAR RTE" /begin SUB_GROUP /end SUB_GROUP /begin FUNCTION_LIST /end FUNCTION_LIST /begin REF_CHARACTERISTIC /end REF_CHARACTERISTIC /end GROUP
/begin GROUP FrqDepDmpnInrtCmp.WIRCmdAmpBlnd.MtrNm_f32 "MICROSAR RTE" /begin SUB_GROUP /end SUB_GROUP /begin FUNCTION_LIST /end FUNCTION_LIST /begin REF_CHARACTERISTIC /end REF_CHARACTERISTIC /begin REF_MEASUREMENT Rte_FrqDepDmpnInrtCmp_WIRCmdAmpBlnd_MtrNm_f32 /end REF_MEASUREMENT /end GROUP
/begin GROUP HOWDetect "MICROSAR RTE" /begin SUB_GROUP HOWDetect.ReceiverPorts HOWDetect.SenderPorts /end SUB_GROUP /begin FUNCTION_LIST /end FUNCTION_LIST /begin REF_CHARACTERISTIC /end REF_CHARACTERISTIC /begin REF_MEASUREMENT /end REF_MEASUREMENT /end GROUP
/begin GROUP HOWDetect.HOWEstimate.Uls_f32 "MICROSAR RTE" /begin SUB_GROUP /end SUB_GROUP /begin FUNCTION_LIST /end FUNCTION_LIST /begin REF_CHARACTERISTIC /end REF_CHARACTERISTIC /begin REF_MEASUREMENT Rte_HOWDetect_HOWEstimate_Uls_f32 /end REF_MEASUREMENT /end GROUP
/begin GROUP HOWDetect.HOWState.Cnt_s08 "MICROSAR RTE" /begin SUB_GROUP /end SUB_GROUP /begin FUNCTION_LIST /end FUNCTION_LIST /begin REF_CHARACTERISTIC /end REF_CHARACTERISTIC /begin REF_MEASUREMENT Rte_HOWDetect_HOWState_Cnt_s08 /end REF_MEASUREMENT /end GROUP
/begin GROUP HOWDetect.HwTrq.HwNm_f32 "MICROSAR RTE" /begin SUB_GROUP /end SUB_GROUP /begin FUNCTION_LIST /end FUNCTION_LIST /begin REF_CHARACTERISTIC /end REF_CHARACTERISTIC /end GROUP
/begin GROUP HOWDetect.ReceiverPorts "MICROSAR RTE" /begin SUB_GROUP HOWDetect.HwTrq.HwNm_f32 HOWDetect.VehSpd.Kph_f32 /end SUB_GROUP /begin FUNCTION_LIST /end FUNCTION_LIST /begin REF_CHARACTERISTIC /end REF_CHARACTERISTIC /begin REF_MEASUREMENT /end REF_MEASUREMENT /end GROUP
/begin GROUP HOWDetect.SenderPorts "MICROSAR RTE" /begin SUB_GROUP HOWDetect.HOWEstimate.Uls_f32 HOWDetect.HOWState.Cnt_s08 /end SUB_GROUP /begin FUNCTION_LIST /end FUNCTION_LIST /begin REF_CHARACTERISTIC /end REF_CHARACTERISTIC /begin REF_MEASUREMENT /end REF_MEASUREMENT /end GROUP
/begin GROUP HOWDetect.VehSpd.Kph_f32 "MICROSAR RTE" /begin SUB_GROUP /end SUB_GROUP /begin FUNCTION_LIST /end FUNCTION_LIST /begin REF_CHARACTERISTIC /end REF_CHARACTERISTIC /end GROUP
/begin GROUP HiLoadStall "MICROSAR RTE" /begin SUB_GROUP HiLoadStall.ReceiverPorts HiLoadStall.SenderPorts /end SUB_GROUP /begin FUNCTION_LIST /end FUNCTION_LIST /begin REF_CHARACTERISTIC /end REF_CHARACTERISTIC /begin REF_MEASUREMENT /end REF_MEASUREMENT /end GROUP
/begin GROUP HiLoadStall.AssistStallLimit.MtrNm_f32 "MICROSAR RTE" /begin SUB_GROUP /end SUB_GROUP /begin FUNCTION_LIST /end FUNCTION_LIST /begin REF_CHARACTERISTIC /end REF_CHARACTERISTIC /begin REF_MEASUREMENT Rte_HiLoadStall_AssistStallLimit_MtrNm_f32 /end REF_MEASUREMENT /end GROUP
/begin GROUP HiLoadStall.DftStallLimit.Cnt_lgc "MICROSAR RTE" /begin SUB_GROUP /end SUB_GROUP /begin FUNCTION_LIST /end FUNCTION_LIST /begin REF_CHARACTERISTIC /end REF_CHARACTERISTIC /end GROUP
/begin GROUP HiLoadStall.MtrVelCRF.MtrRadpS_f32 "MICROSAR RTE" /begin SUB_GROUP /end SUB_GROUP /begin FUNCTION_LIST /end FUNCTION_LIST /begin REF_CHARACTERISTIC /end REF_CHARACTERISTIC /end GROUP
/begin GROUP HiLoadStall.PreLimitForStall.MtrNm_f32 "MICROSAR RTE" /begin SUB_GROUP /end SUB_GROUP /begin FUNCTION_LIST /end FUNCTION_LIST /begin REF_CHARACTERISTIC /end REF_CHARACTERISTIC /end GROUP
/begin GROUP HiLoadStall.ReceiverPorts "MICROSAR RTE"
 /begin SUB_GROUP HiLoadStall.DftStallLimit.Cnt_lgc HiLoadStall.MtrVelCRF.MtrRadpS_f32 HiLoadStall.PreLimitForStall.MtrNm_f32 /end SUB_GROUP
 /begin FUNCTION_LIST /end FUNCTION_LIST
 /begin REF_CHARACTERISTIC /end REF_CHARACTERISTIC
 /begin REF_MEASUREMENT /end REF_MEASUREMENT
/end GROUP
/begin GROUP HiLoadStall.SenderPorts "MICROSAR RTE" /begin SUB_GROUP HiLoadStall.AssistStallLimit.MtrNm_f32 /end SUB_GROUP /begin FUNCTION_LIST /end FUNCTION_LIST /begin REF_CHARACTERISTIC /end REF_CHARACTERISTIC /begin REF_MEASUREMENT /end REF_MEASUREMENT /end GROUP
/begin GROUP HighFreqAssist "MICROSAR RTE" /begin SUB_GROUP HighFreqAssist.ReceiverPorts HighFreqAssist.SenderPorts /end SUB_GROUP /begin FUNCTION_LIST /end FUNCTION_LIST /begin REF_CHARACTERISTIC /end REF_CHARACTERISTIC /begin REF_MEASUREMENT /end REF_MEASUREMENT /end GROUP
/begin GROUP HighFreqAssist.HighFreqAssist.MtrNm_f32 "MICROSAR RTE" /begin SUB_GROUP /end SUB_GROUP /begin FUNCTION_LIST /end FUNCTION_LIST /begin REF_CHARACTERISTIC /end REF_CHARACTERISTIC /end GROUP
/begin GROUP HighFreqAssist.HwTorque.HwNm_f32 "MICROSAR RTE" /begin SUB_GROUP /end SUB_GROUP /begin FUNCTION_LIST /end FUNCTION_LIST /begin REF_CHARACTERISTIC /end REF_CHARACTERISTIC /end GROUP
/begin GROUP HighFreqAssist.ReceiverPorts "MICROSAR RTE"
 /begin SUB_GROUP HighFreqAssist.HwTorque.HwNm_f32 HighFreqAssist.VehicleSpeed.Kph_f32 HighFreqAssist.WIRCmdAmpBlnd.MtrNm_f32 /end SUB_GROUP
 /begin FUNCTION_LIST /end FUNCTION_LIST
 /begin REF_CHARACTERISTIC /end REF_CHARACTERISTIC
 /begin REF_MEASUREMENT /end REF_MEASUREMENT
/end GROUP
/begin GROUP HighFreqAssist.SenderPorts "MICROSAR RTE" /begin SUB_GROUP HighFreqAssist.HighFreqAssist.MtrNm_f32 /end SUB_GROUP /begin FUNCTION_LIST /end FUNCTION_LIST /begin REF_CHARACTERISTIC /end REF_CHARACTERISTIC /begin REF_MEASUREMENT /end REF_MEASUREMENT /end GROUP
/begin GROUP HighFreqAssist.VehicleSpeed.Kph_f32 "MICROSAR RTE" /begin SUB_GROUP /end SUB_GROUP /begin FUNCTION_LIST /end FUNCTION_LIST /begin REF_CHARACTERISTIC /end REF_CHARACTERISTIC /end GROUP
/begin GROUP HighFreqAssist.WIRCmdAmpBlnd.MtrNm_f32 "MICROSAR RTE" /begin SUB_GROUP /end SUB_GROUP /begin FUNCTION_LIST /end FUNCTION_LIST /begin REF_CHARACTERISTIC /end REF_CHARACTERISTIC /begin REF_MEASUREMENT Rte_HighFreqAssist_WIRCmdAmpBlnd_MtrNm_f32 /end REF_MEASUREMENT /end GROUP
/begin GROUP HwPwUp "MICROSAR RTE"
 /begin SUB_GROUP HwPwUp.ModeRequirePorts HwPwUp.ReceiverPorts HwPwUp.SenderPorts /end SUB_GROUP
 /begin FUNCTION_LIST /end FUNCTION_LIST
 /begin REF_CHARACTERISTIC /end REF_CHARACTERISTIC
 /begin REF_MEASUREMENT /end REF_MEASUREMENT
/end GROUP
/begin GROUP HwPwUp.ModeRequirePorts "MICROSAR RTE" /begin SUB_GROUP HwPwUp.SystemState.Mode /end SUB_GROUP /begin FUNCTION_LIST /end FUNCTION_LIST /begin REF_CHARACTERISTIC /end REF_CHARACTERISTIC /begin REF_MEASUREMENT /end REF_MEASUREMENT /end GROUP
/begin GROUP HwPwUp.MtrDrvrInitComplete.Cnt_lgc "MICROSAR RTE" /begin SUB_GROUP /end SUB_GROUP /begin FUNCTION_LIST /end FUNCTION_LIST /begin REF_CHARACTERISTIC /end REF_CHARACTERISTIC /begin REF_MEASUREMENT Rte_MtrDrvDiag_MtrDrvrInitComplete_Cnt_lgc /end REF_MEASUREMENT /end GROUP
/begin GROUP HwPwUp.MtrDrvrInitStart.Cnt_lgc "MICROSAR RTE" /begin SUB_GROUP /end SUB_GROUP /begin FUNCTION_LIST /end FUNCTION_LIST /begin REF_CHARACTERISTIC /end REF_CHARACTERISTIC /begin REF_MEASUREMENT Rte_HwPwUp_MtrDrvrInitStart_Cnt_lgc /end REF_MEASUREMENT /end GROUP
/begin GROUP HwPwUp.PwrDiscATestComplete.Cnt_lgc "MICROSAR RTE" /begin SUB_GROUP /end SUB_GROUP /begin FUNCTION_LIST /end FUNCTION_LIST /begin REF_CHARACTERISTIC /end REF_CHARACTERISTIC /end GROUP
/begin GROUP HwPwUp.PwrDiscATestStart.Cnt_lgc "MICROSAR RTE" /begin SUB_GROUP /end SUB_GROUP /begin FUNCTION_LIST /end FUNCTION_LIST /begin REF_CHARACTERISTIC /end REF_CHARACTERISTIC /end GROUP
/begin GROUP HwPwUp.PwrDiscBTestComplete.Cnt_lgc "MICROSAR RTE" /begin SUB_GROUP /end SUB_GROUP /begin FUNCTION_LIST /end FUNCTION_LIST /begin REF_CHARACTERISTIC /end REF_CHARACTERISTIC /end GROUP
/begin GROUP HwPwUp.PwrDiscBTestStart.Cnt_lgc "MICROSAR RTE" /begin SUB_GROUP /end SUB_GROUP /begin FUNCTION_LIST /end FUNCTION_LIST /begin REF_CHARACTERISTIC /end REF_CHARACTERISTIC /end GROUP
/begin GROUP HwPwUp.ReceiverPorts "MICROSAR RTE"
 /begin SUB_GROUP HwPwUp.MtrDrvrInitComplete.Cnt_lgc HwPwUp.PwrDiscATestComplete.Cnt_lgc HwPwUp.PwrDiscBTestComplete.Cnt_lgc HwPwUp.TMFTestComplete.Cnt_lgc /end SUB_GROUP
 /begin FUNCTION_LIST /end FUNCTION_LIST
 /begin REF_CHARACTERISTIC /end REF_CHARACTERISTIC
 /begin REF_MEASUREMENT /end REF_MEASUREMENT
/end GROUP
/begin GROUP HwPwUp.SenderPorts "MICROSAR RTE"
 /begin SUB_GROUP HwPwUp.MtrDrvrInitStart.Cnt_lgc HwPwUp.PwrDiscATestStart.Cnt_lgc HwPwUp.PwrDiscBTestStart.Cnt_lgc HwPwUp.TMFTestStart.Cnt_lgc /end SUB_GROUP
 /begin FUNCTION_LIST /end FUNCTION_LIST
 /begin REF_CHARACTERISTIC /end REF_CHARACTERISTIC
 /begin REF_MEASUREMENT /end REF_MEASUREMENT
/end GROUP
/begin GROUP HwPwUp.SystemState.Mode "MICROSAR RTE" /begin SUB_GROUP /end SUB_GROUP /begin FUNCTION_LIST /end FUNCTION_LIST /begin REF_CHARACTERISTIC /end REF_CHARACTERISTIC /end GROUP
/begin GROUP HwPwUp.TMFTestComplete.Cnt_lgc "MICROSAR RTE" /begin SUB_GROUP /end SUB_GROUP /begin FUNCTION_LIST /end FUNCTION_LIST /begin REF_CHARACTERISTIC /end REF_CHARACTERISTIC /begin REF_MEASUREMENT Rte_TmprlMon_TMFTestComplete_Cnt_lgc /end REF_MEASUREMENT /end GROUP
/begin GROUP HwPwUp.TMFTestStart.Cnt_lgc "MICROSAR RTE" /begin SUB_GROUP /end SUB_GROUP /begin FUNCTION_LIST /end FUNCTION_LIST /begin REF_CHARACTERISTIC /end REF_CHARACTERISTIC /begin REF_MEASUREMENT Rte_HwPwUp_TMFTestStart_Cnt_lgc /end REF_MEASUREMENT /end GROUP
/begin GROUP HwTqArbn "MICROSAR RTE"
 /begin SUB_GROUP HwTqArbn.PerInstanceMemories HwTqArbn.ReceiverPorts HwTqArbn.SenderPorts /end SUB_GROUP
 /begin FUNCTION_LIST /end FUNCTION_LIST
 /begin REF_CHARACTERISTIC /end REF_CHARACTERISTIC
 /begin REF_MEASUREMENT /end REF_MEASUREMENT
/end GROUP
/begin GROUP HwTqArbn.HwTq1Qlfr.State_enum "MICROSAR RTE" /begin SUB_GROUP /end SUB_GROUP /begin FUNCTION_LIST /end FUNCTION_LIST /begin REF_CHARACTERISTIC /end REF_CHARACTERISTIC /begin REF_MEASUREMENT Rte_Nhet1CfgAndUse_HwTq1Qlfr_State_enum /end REF_MEASUREMENT /end GROUP
/begin GROUP HwTqArbn.HwTq1RollgCntr.Cnt_u08 "MICROSAR RTE" /begin SUB_GROUP /end SUB_GROUP /begin FUNCTION_LIST /end FUNCTION_LIST /begin REF_CHARACTERISTIC /end REF_CHARACTERISTIC /begin REF_MEASUREMENT Rte_Nhet1CfgAndUse_HwTq1RollgCntr_Cnt_u08 /end REF_MEASUREMENT /end GROUP
/begin GROUP HwTqArbn.HwTq1Val.HwNm_f32 "MICROSAR RTE" /begin SUB_GROUP /end SUB_GROUP /begin FUNCTION_LIST /end FUNCTION_LIST /begin REF_CHARACTERISTIC /end REF_CHARACTERISTIC /begin REF_MEASUREMENT Rte_Nhet1CfgAndUse_HwTq1Val_HwNm_f32 /end REF_MEASUREMENT /end GROUP
/begin GROUP HwTqArbn.HwTq2Qlfr.State_enum "MICROSAR RTE" /begin SUB_GROUP /end SUB_GROUP /begin FUNCTION_LIST /end FUNCTION_LIST /begin REF_CHARACTERISTIC /end REF_CHARACTERISTIC /begin REF_MEASUREMENT Rte_Nhet1CfgAndUse_HwTq2Qlfr_State_enum /end REF_MEASUREMENT /end GROUP
/begin GROUP HwTqArbn.HwTq2RollgCntr.Cnt_u08 "MICROSAR RTE" /begin SUB_GROUP /end SUB_GROUP /begin FUNCTION_LIST /end FUNCTION_LIST /begin REF_CHARACTERISTIC /end REF_CHARACTERISTIC /begin REF_MEASUREMENT Rte_Nhet1CfgAndUse_HwTq2RollgCntr_Cnt_u08 /end REF_MEASUREMENT /end GROUP
/begin GROUP HwTqArbn.HwTq2Val.HwNm_f32 "MICROSAR RTE" /begin SUB_GROUP /end SUB_GROUP /begin FUNCTION_LIST /end FUNCTION_LIST /begin REF_CHARACTERISTIC /end REF_CHARACTERISTIC /begin REF_MEASUREMENT Rte_Nhet1CfgAndUse_HwTq2Val_HwNm_f32 /end REF_MEASUREMENT /end GROUP
/begin GROUP HwTqArbn.HwTqArbnEOLCh1OffsetTrimData "MICROSAR RTE" /begin SUB_GROUP /end SUB_GROUP /begin FUNCTION_LIST /end FUNCTION_LIST /begin REF_CHARACTERISTIC /end REF_CHARACTERISTIC
 /begin REF_MEASUREMENT Rte_HwTqArbn_HwTqArbnEOLCh1OffsetTrimData.HwTqArb_EOLChOffsetTrimPerf_Cnt_lgc Rte_HwTqArbn_HwTqArbnEOLCh1OffsetTrimData.HwTqArb_EOLChOffsetTrim_HwNm_f32 /end REF_MEASUREMENT
/end GROUP
/begin GROUP HwTqArbn.HwTqCorrlnSts.Cnt_u16 "MICROSAR RTE" /begin SUB_GROUP /end SUB_GROUP /begin FUNCTION_LIST /end FUNCTION_LIST /begin REF_CHARACTERISTIC /end REF_CHARACTERISTIC /begin REF_MEASUREMENT Rte_HwTqCorrln_HwTqCorrlnSts_Cnt_u16 /end REF_MEASUREMENT /end GROUP
/begin GROUP HwTqArbn.HwTqVal.HwNm_f32 "MICROSAR RTE" /begin SUB_GROUP /end SUB_GROUP /begin FUNCTION_LIST /end FUNCTION_LIST /begin REF_CHARACTERISTIC /end REF_CHARACTERISTIC /begin REF_MEASUREMENT Rte_HwTqArbn_HwTqVal_HwNm_f32 /end REF_MEASUREMENT /end GROUP
/begin GROUP HwTqArbn.MEC_Counter.Cnt_u08 "MICROSAR RTE" /begin SUB_GROUP /end SUB_GROUP /begin FUNCTION_LIST /end FUNCTION_LIST /begin REF_CHARACTERISTIC /end REF_CHARACTERISTIC /end GROUP
/begin GROUP HwTqArbn.PerInstanceMemories "MICROSAR RTE" /begin SUB_GROUP HwTqArbn.HwTqArbnEOLCh1OffsetTrimData /end SUB_GROUP /begin FUNCTION_LIST /end FUNCTION_LIST /begin REF_CHARACTERISTIC /end REF_CHARACTERISTIC /begin REF_MEASUREMENT /end REF_MEASUREMENT /end GROUP
/begin GROUP HwTqArbn.ReceiverPorts "MICROSAR RTE"
 /begin SUB_GROUP HwTqArbn.HwTq1Qlfr.State_enum HwTqArbn.HwTq1RollgCntr.Cnt_u08 HwTqArbn.HwTq1Val.HwNm_f32 HwTqArbn.HwTq2Qlfr.State_enum HwTqArbn.HwTq2RollgCntr.Cnt_u08 HwTqArbn.HwTq2Val.HwNm_f32 HwTqArbn.HwTqCorrlnSts.Cnt_u16 HwTqArbn.MEC_Counter.Cnt_u08 HwTqArbn.SVC_ClearCodes.Cnt_lgc /end SUB_GROUP
 /begin FUNCTION_LIST /end FUNCTION_LIST
 /begin REF_CHARACTERISTIC /end REF_CHARACTERISTIC
 /begin REF_MEASUREMENT /end REF_MEASUREMENT
/end GROUP
/begin GROUP HwTqArbn.SVC_ClearCodes.Cnt_lgc "MICROSAR RTE" /begin SUB_GROUP /end SUB_GROUP /begin FUNCTION_LIST /end FUNCTION_LIST /begin REF_CHARACTERISTIC /end REF_CHARACTERISTIC /begin REF_MEASUREMENT Rte_HwTqArbn_SVC_ClearCodes_Cnt_lgc /end REF_MEASUREMENT /end GROUP
/begin GROUP HwTqArbn.SenderPorts "MICROSAR RTE" /begin SUB_GROUP HwTqArbn.HwTqVal.HwNm_f32 /end SUB_GROUP /begin FUNCTION_LIST /end FUNCTION_LIST /begin REF_CHARACTERISTIC /end REF_CHARACTERISTIC /begin REF_MEASUREMENT /end REF_MEASUREMENT /end GROUP
/begin GROUP HwTqCorrln "MICROSAR RTE"
 /begin SUB_GROUP HwTqCorrln.PerInstanceMemories HwTqCorrln.ReceiverPorts HwTqCorrln.SenderPorts /end SUB_GROUP
 /begin FUNCTION_LIST /end FUNCTION_LIST
 /begin REF_CHARACTERISTIC /end REF_CHARACTERISTIC
 /begin REF_MEASUREMENT /end REF_MEASUREMENT
/end GROUP
/begin GROUP HwTqCorrln.HwTq1Qlfr.State_enum "MICROSAR RTE" /begin SUB_GROUP /end SUB_GROUP /begin FUNCTION_LIST /end FUNCTION_LIST /begin REF_CHARACTERISTIC /end REF_CHARACTERISTIC /begin REF_MEASUREMENT Rte_Nhet1CfgAndUse_HwTq1Qlfr_State_enum /end REF_MEASUREMENT /end GROUP
/begin GROUP HwTqCorrln.HwTq1RollgCntr.Cnt_u08 "MICROSAR RTE" /begin SUB_GROUP /end SUB_GROUP /begin FUNCTION_LIST /end FUNCTION_LIST /begin REF_CHARACTERISTIC /end REF_CHARACTERISTIC /begin REF_MEASUREMENT Rte_Nhet1CfgAndUse_HwTq1RollgCntr_Cnt_u08 /end REF_MEASUREMENT /end GROUP
/begin GROUP HwTqCorrln.HwTq1Val.HwNm_f32 "MICROSAR RTE" /begin SUB_GROUP /end SUB_GROUP /begin FUNCTION_LIST /end FUNCTION_LIST /begin REF_CHARACTERISTIC /end REF_CHARACTERISTIC /begin REF_MEASUREMENT Rte_Nhet1CfgAndUse_HwTq1Val_HwNm_f32 /end REF_MEASUREMENT /end GROUP
/begin GROUP HwTqCorrln.HwTq2Qlfr.State_enum "MICROSAR RTE" /begin SUB_GROUP /end SUB_GROUP /begin FUNCTION_LIST /end FUNCTION_LIST /begin REF_CHARACTERISTIC /end REF_CHARACTERISTIC /begin REF_MEASUREMENT Rte_Nhet1CfgAndUse_HwTq2Qlfr_State_enum /end REF_MEASUREMENT /end GROUP
/begin GROUP HwTqCorrln.HwTq2RollgCntr.Cnt_u08 "MICROSAR RTE" /begin SUB_GROUP /end SUB_GROUP /begin FUNCTION_LIST /end FUNCTION_LIST /begin REF_CHARACTERISTIC /end REF_CHARACTERISTIC /begin REF_MEASUREMENT Rte_Nhet1CfgAndUse_HwTq2RollgCntr_Cnt_u08 /end REF_MEASUREMENT /end GROUP
/begin GROUP HwTqCorrln.HwTq2Val.HwNm_f32 "MICROSAR RTE" /begin SUB_GROUP /end SUB_GROUP /begin FUNCTION_LIST /end FUNCTION_LIST /begin REF_CHARACTERISTIC /end REF_CHARACTERISTIC /begin REF_MEASUREMENT Rte_Nhet1CfgAndUse_HwTq2Val_HwNm_f32 /end REF_MEASUREMENT /end GROUP
/begin GROUP HwTqCorrln.HwTqCorrlnCh1CMCLPFSvData "MICROSAR RTE" /begin SUB_GROUP /end SUB_GROUP /begin FUNCTION_LIST /end FUNCTION_LIST /begin REF_CHARACTERISTIC /end REF_CHARACTERISTIC /begin REF_MEASUREMENT Rte_HwTqCorrln_HwTqCorrlnCh1CMCLPFSvData /end REF_MEASUREMENT /end GROUP
/begin GROUP HwTqCorrln.HwTqCorrlnSts.Cnt_u16 "MICROSAR RTE" /begin SUB_GROUP /end SUB_GROUP /begin FUNCTION_LIST /end FUNCTION_LIST /begin REF_CHARACTERISTIC /end REF_CHARACTERISTIC /begin REF_MEASUREMENT Rte_HwTqCorrln_HwTqCorrlnSts_Cnt_u16 /end REF_MEASUREMENT /end GROUP
/begin GROUP HwTqCorrln.HwTqIdptSig.Cnt_u08 "MICROSAR RTE" /begin SUB_GROUP /end SUB_GROUP /begin FUNCTION_LIST /end FUNCTION_LIST /begin REF_CHARACTERISTIC /end REF_CHARACTERISTIC /begin REF_MEASUREMENT Rte_HwTqCorrln_HwTqIdptSig_Cnt_u08 /end REF_MEASUREMENT /end GROUP
/begin GROUP HwTqCorrln.HwTqVal.HwNm_f32 "MICROSAR RTE" /begin SUB_GROUP /end SUB_GROUP /begin FUNCTION_LIST /end FUNCTION_LIST /begin REF_CHARACTERISTIC /end REF_CHARACTERISTIC /begin REF_MEASUREMENT Rte_HwTqArbn_HwTqVal_HwNm_f32 /end REF_MEASUREMENT /end GROUP
/begin GROUP HwTqCorrln.PerInstanceMemories "MICROSAR RTE" /begin SUB_GROUP HwTqCorrln.HwTqCorrlnCh1CMCLPFSvData /end SUB_GROUP /begin FUNCTION_LIST /end FUNCTION_LIST /begin REF_CHARACTERISTIC /end REF_CHARACTERISTIC /begin REF_MEASUREMENT /end REF_MEASUREMENT /end GROUP
/begin GROUP HwTqCorrln.ReceiverPorts "MICROSAR RTE"
 /begin SUB_GROUP HwTqCorrln.HwTq1Qlfr.State_enum HwTqCorrln.HwTq1RollgCntr.Cnt_u08 HwTqCorrln.HwTq1Val.HwNm_f32 HwTqCorrln.HwTq2Qlfr.State_enum HwTqCorrln.HwTq2RollgCntr.Cnt_u08 HwTqCorrln.HwTq2Val.HwNm_f32 HwTqCorrln.HwTqVal.HwNm_f32 /end SUB_GROUP
 /begin FUNCTION_LIST /end FUNCTION_LIST
 /begin REF_CHARACTERISTIC /end REF_CHARACTERISTIC
 /begin REF_MEASUREMENT /end REF_MEASUREMENT
/end GROUP
/begin GROUP HwTqCorrln.SenderPorts "MICROSAR RTE"
 /begin SUB_GROUP HwTqCorrln.HwTqCorrlnSts.Cnt_u16 HwTqCorrln.HwTqIdptSig.Cnt_u08 /end SUB_GROUP
 /begin FUNCTION_LIST /end FUNCTION_LIST
 /begin REF_CHARACTERISTIC /end REF_CHARACTERISTIC
 /begin REF_MEASUREMENT /end REF_MEASUREMENT
/end GROUP
/begin GROUP HystComp "MICROSAR RTE" /begin SUB_GROUP HystComp.ReceiverPorts HystComp.SenderPorts /end SUB_GROUP /begin FUNCTION_LIST /end FUNCTION_LIST /begin REF_CHARACTERISTIC /end REF_CHARACTERISTIC /begin REF_MEASUREMENT /end REF_MEASUREMENT /end GROUP
/begin GROUP HystComp.AssistMechTempEst.DegC_f32 "MICROSAR RTE" /begin SUB_GROUP /end SUB_GROUP /begin FUNCTION_LIST /end FUNCTION_LIST /begin REF_CHARACTERISTIC /end REF_CHARACTERISTIC /end GROUP
/begin GROUP HystComp.BaseAssistCmd.MtrNm_f32 "MICROSAR RTE" /begin SUB_GROUP /end SUB_GROUP /begin FUNCTION_LIST /end FUNCTION_LIST /begin REF_CHARACTERISTIC /end REF_CHARACTERISTIC /end GROUP
/begin GROUP HystComp.DefeatHystService.Cnt_lgc "MICROSAR RTE" /begin SUB_GROUP /end SUB_GROUP /begin FUNCTION_LIST /end FUNCTION_LIST /begin REF_CHARACTERISTIC /end REF_CHARACTERISTIC /end GROUP
/begin GROUP HystComp.FricOffset.HwNm_f32 "MICROSAR RTE" /begin SUB_GROUP /end SUB_GROUP /begin FUNCTION_LIST /end FUNCTION_LIST /begin REF_CHARACTERISTIC /end REF_CHARACTERISTIC /end GROUP
/begin GROUP HystComp.HwTorque.HwNm_f32 "MICROSAR RTE" /begin SUB_GROUP /end SUB_GROUP /begin FUNCTION_LIST /end FUNCTION_LIST /begin REF_CHARACTERISTIC /end REF_CHARACTERISTIC /end GROUP
/begin GROUP HystComp.HysteresisComp.MtrNm_f32 "MICROSAR RTE" /begin SUB_GROUP /end SUB_GROUP /begin FUNCTION_LIST /end FUNCTION_LIST /begin REF_CHARACTERISTIC /end REF_CHARACTERISTIC /end GROUP
/begin GROUP HystComp.ReceiverPorts "MICROSAR RTE"
 /begin SUB_GROUP HystComp.AssistMechTempEst.DegC_f32 HystComp.BaseAssistCmd.MtrNm_f32 HystComp.DefeatHystService.Cnt_lgc HystComp.FricOffset.HwNm_f32 HystComp.HwTorque.HwNm_f32 HystComp.VehicleSpeed.Kph_f32 HystComp.WIRCmdAmpBlnd.MtrNm_f32 /end SUB_GROUP
 /begin FUNCTION_LIST /end FUNCTION_LIST
 /begin REF_CHARACTERISTIC /end REF_CHARACTERISTIC
 /begin REF_MEASUREMENT /end REF_MEASUREMENT
/end GROUP
/begin GROUP HystComp.SenderPorts "MICROSAR RTE" /begin SUB_GROUP HystComp.HysteresisComp.MtrNm_f32 /end SUB_GROUP /begin FUNCTION_LIST /end FUNCTION_LIST /begin REF_CHARACTERISTIC /end REF_CHARACTERISTIC /begin REF_MEASUREMENT /end REF_MEASUREMENT /end GROUP
/begin GROUP HystComp.VehicleSpeed.Kph_f32 "MICROSAR RTE" /begin SUB_GROUP /end SUB_GROUP /begin FUNCTION_LIST /end FUNCTION_LIST /begin REF_CHARACTERISTIC /end REF_CHARACTERISTIC /end GROUP
/begin GROUP HystComp.WIRCmdAmpBlnd.MtrNm_f32 "MICROSAR RTE" /begin SUB_GROUP /end SUB_GROUP /begin FUNCTION_LIST /end FUNCTION_LIST /begin REF_CHARACTERISTIC /end REF_CHARACTERISTIC /begin REF_MEASUREMENT Rte_HystComp_WIRCmdAmpBlnd_MtrNm_f32 /end REF_MEASUREMENT /end GROUP
/begin GROUP IoHwAb10 "MICROSAR RTE" /begin SUB_GROUP IoHwAb10.ReceiverPorts IoHwAb10.SenderPorts /end SUB_GROUP /begin FUNCTION_LIST /end FUNCTION_LIST /begin REF_CHARACTERISTIC /end REF_CHARACTERISTIC /begin REF_MEASUREMENT /end REF_MEASUREMENT /end GROUP
/begin GROUP IoHwAb10.Batt.Volt_f32 "MICROSAR RTE" /begin SUB_GROUP /end SUB_GROUP /begin FUNCTION_LIST /end FUNCTION_LIST /begin REF_CHARACTERISTIC /end REF_CHARACTERISTIC /end GROUP
/begin GROUP IoHwAb10.BattSwitched.Volt_f32 "MICROSAR RTE" /begin SUB_GROUP /end SUB_GROUP /begin FUNCTION_LIST /end FUNCTION_LIST /begin REF_CHARACTERISTIC /end REF_CHARACTERISTIC /end GROUP
/begin GROUP IoHwAb10.ReceiverPorts "MICROSAR RTE" /begin SUB_GROUP IoHwAb10.SysCVSwitchADC.Cnt_u16 /end SUB_GROUP /begin FUNCTION_LIST /end FUNCTION_LIST /begin REF_CHARACTERISTIC /end REF_CHARACTERISTIC /begin REF_MEASUREMENT /end REF_MEASUREMENT /end GROUP
/begin GROUP IoHwAb10.SenderPorts "MICROSAR RTE"
 /begin SUB_GROUP IoHwAb10.Batt.Volt_f32 IoHwAb10.BattSwitched.Volt_f32 IoHwAb10.SysCVSwitch.Volt_f32 IoHwAb10.TemperatureADC.Volt_f32 /end SUB_GROUP
 /begin FUNCTION_LIST /end FUNCTION_LIST
 /begin REF_CHARACTERISTIC /end REF_CHARACTERISTIC
 /begin REF_MEASUREMENT /end REF_MEASUREMENT
/end GROUP
/begin GROUP IoHwAb10.SysCVSwitch.Volt_f32 "MICROSAR RTE" /begin SUB_GROUP /end SUB_GROUP /begin FUNCTION_LIST /end FUNCTION_LIST /begin REF_CHARACTERISTIC /end REF_CHARACTERISTIC /end GROUP
/begin GROUP IoHwAb10.SysCVSwitchADC.Cnt_u16 "MICROSAR RTE" /begin SUB_GROUP /end SUB_GROUP /begin FUNCTION_LIST /end FUNCTION_LIST /begin REF_CHARACTERISTIC /end REF_CHARACTERISTIC /end GROUP
/begin GROUP IoHwAb10.TemperatureADC.Volt_f32 "MICROSAR RTE" /begin SUB_GROUP /end SUB_GROUP /begin FUNCTION_LIST /end FUNCTION_LIST /begin REF_CHARACTERISTIC /end REF_CHARACTERISTIC /end GROUP
/begin GROUP LmtCod "MICROSAR RTE" /begin SUB_GROUP LmtCod.ReceiverPorts LmtCod.SenderPorts /end SUB_GROUP /begin FUNCTION_LIST /end FUNCTION_LIST /begin REF_CHARACTERISTIC /end REF_CHARACTERISTIC /begin REF_MEASUREMENT /end REF_MEASUREMENT /end GROUP
/begin GROUP LmtCod.AssistEOTGain.Uls_f32 "MICROSAR RTE" /begin SUB_GROUP /end SUB_GROUP /begin FUNCTION_LIST /end FUNCTION_LIST /begin REF_CHARACTERISTIC /end REF_CHARACTERISTIC /end GROUP
/begin GROUP LmtCod.AssistEOTLimit.MtrNm_f32 "MICROSAR RTE" /begin SUB_GROUP /end SUB_GROUP /begin FUNCTION_LIST /end FUNCTION_LIST /begin REF_CHARACTERISTIC /end REF_CHARACTERISTIC /end GROUP
/begin GROUP LmtCod.AssistStallLimit.MtrNm_f32 "MICROSAR RTE" /begin SUB_GROUP /end SUB_GROUP /begin FUNCTION_LIST /end FUNCTION_LIST /begin REF_CHARACTERISTIC /end REF_CHARACTERISTIC /begin REF_MEASUREMENT Rte_HiLoadStall_AssistStallLimit_MtrNm_f32 /end REF_MEASUREMENT /end GROUP
/begin GROUP LmtCod.AstVehSpdLimit.MtrNm_f32 "MICROSAR RTE" /begin SUB_GROUP /end SUB_GROUP /begin FUNCTION_LIST /end FUNCTION_LIST /begin REF_CHARACTERISTIC /end REF_CHARACTERISTIC /begin REF_MEASUREMENT Rte_VehSpdLmt_AstVehSpdLimit_MtrNm_f32 /end REF_MEASUREMENT /end GROUP
/begin GROUP LmtCod.EOTGainLtd.Uls_f32 "MICROSAR RTE" /begin SUB_GROUP /end SUB_GROUP /begin FUNCTION_LIST /end FUNCTION_LIST /begin REF_CHARACTERISTIC /end REF_CHARACTERISTIC /end GROUP
/begin GROUP LmtCod.EOTLimitLtd.MtrNm_f32 "MICROSAR RTE" /begin SUB_GROUP /end SUB_GROUP /begin FUNCTION_LIST /end FUNCTION_LIST /begin REF_CHARACTERISTIC /end REF_CHARACTERISTIC /end GROUP
/begin GROUP LmtCod.OutputRampMult.Uls_f32 "MICROSAR RTE" /begin SUB_GROUP /end SUB_GROUP /begin FUNCTION_LIST /end FUNCTION_LIST /begin REF_CHARACTERISTIC /end REF_CHARACTERISTIC /begin REF_MEASUREMENT Rte_StOpCtrl_OutputRampMult_Uls_f32 /end REF_MEASUREMENT /end GROUP
/begin GROUP LmtCod.OutputRampMultLtd.Uls_f32 "MICROSAR RTE" /begin SUB_GROUP /end SUB_GROUP /begin FUNCTION_LIST /end FUNCTION_LIST /begin REF_CHARACTERISTIC /end REF_CHARACTERISTIC /end GROUP
/begin GROUP LmtCod.ReceiverPorts "MICROSAR RTE"
 /begin SUB_GROUP LmtCod.AssistEOTGain.Uls_f32 LmtCod.AssistEOTLimit.MtrNm_f32 LmtCod.AssistStallLimit.MtrNm_f32 LmtCod.AstVehSpdLimit.MtrNm_f32 LmtCod.OutputRampMult.Uls_f32 LmtCod.ThermalLimit.MtrNm_f32 LmtCod.VehicleSpeed.Kph_f32 /end SUB_GROUP
 /begin FUNCTION_LIST /end FUNCTION_LIST
 /begin REF_CHARACTERISTIC /end REF_CHARACTERISTIC
 /begin REF_MEASUREMENT /end REF_MEASUREMENT
/end GROUP
/begin GROUP LmtCod.SenderPorts "MICROSAR RTE"
 /begin SUB_GROUP LmtCod.EOTGainLtd.Uls_f32 LmtCod.EOTLimitLtd.MtrNm_f32 LmtCod.OutputRampMultLtd.Uls_f32 LmtCod.StallLimitLtd.MtrNm_f32 LmtCod.ThermalLimitLtd.MtrNm_f32 LmtCod.VehSpdLimitLtd.MtrNm_f32 /end SUB_GROUP
 /begin FUNCTION_LIST /end FUNCTION_LIST
 /begin REF_CHARACTERISTIC /end REF_CHARACTERISTIC
 /begin REF_MEASUREMENT /end REF_MEASUREMENT
/end GROUP
/begin GROUP LmtCod.StallLimitLtd.MtrNm_f32 "MICROSAR RTE" /begin SUB_GROUP /end SUB_GROUP /begin FUNCTION_LIST /end FUNCTION_LIST /begin REF_CHARACTERISTIC /end REF_CHARACTERISTIC /end GROUP
/begin GROUP LmtCod.ThermalLimit.MtrNm_f32 "MICROSAR RTE" /begin SUB_GROUP /end SUB_GROUP /begin FUNCTION_LIST /end FUNCTION_LIST /begin REF_CHARACTERISTIC /end REF_CHARACTERISTIC /begin REF_MEASUREMENT Rte_ThrmlDutyCycle_ThermalLimit_MtrNm_f32 /end REF_MEASUREMENT /end GROUP
/begin GROUP LmtCod.ThermalLimitLtd.MtrNm_f32 "MICROSAR RTE" /begin SUB_GROUP /end SUB_GROUP /begin FUNCTION_LIST /end FUNCTION_LIST /begin REF_CHARACTERISTIC /end REF_CHARACTERISTIC /end GROUP
/begin GROUP LmtCod.VehSpdLimitLtd.MtrNm_f32 "MICROSAR RTE" /begin SUB_GROUP /end SUB_GROUP /begin FUNCTION_LIST /end FUNCTION_LIST /begin REF_CHARACTERISTIC /end REF_CHARACTERISTIC /end GROUP
/begin GROUP LmtCod.VehicleSpeed.Kph_f32 "MICROSAR RTE" /begin SUB_GROUP /end SUB_GROUP /begin FUNCTION_LIST /end FUNCTION_LIST /begin REF_CHARACTERISTIC /end REF_CHARACTERISTIC /end GROUP
/begin GROUP LoaMgr "MICROSAR RTE" /begin SUB_GROUP LoaMgr.ReceiverPorts LoaMgr.SenderPorts /end SUB_GROUP /begin FUNCTION_LIST /end FUNCTION_LIST /begin REF_CHARACTERISTIC /end REF_CHARACTERISTIC /begin REF_MEASUREMENT /end REF_MEASUREMENT /end GROUP
/begin GROUP LoaMgr.DiagcStsIvtr1Inactv.Cnt_lgc "MICROSAR RTE" /begin SUB_GROUP /end SUB_GROUP /begin FUNCTION_LIST /end FUNCTION_LIST /begin REF_CHARACTERISTIC /end REF_CHARACTERISTIC /end GROUP
/begin GROUP LoaMgr.DiagcStsIvtr2Inactv.Cnt_lgc "MICROSAR RTE" /begin SUB_GROUP /end SUB_GROUP /begin FUNCTION_LIST /end FUNCTION_LIST /begin REF_CHARACTERISTIC /end REF_CHARACTERISTIC /end GROUP
/begin GROUP LoaMgr.HwTqIdptSig.Cnt_u08 "MICROSAR RTE" /begin SUB_GROUP /end SUB_GROUP /begin FUNCTION_LIST /end FUNCTION_LIST /begin REF_CHARACTERISTIC /end REF_CHARACTERISTIC /begin REF_MEASUREMENT Rte_HwTqCorrln_HwTqIdptSig_Cnt_u08 /end REF_MEASUREMENT /end GROUP
/begin GROUP LoaMgr.HwTqLoaMtgtnEn.Cnt_lgc "MICROSAR RTE" /begin SUB_GROUP /end SUB_GROUP /begin FUNCTION_LIST /end FUNCTION_LIST /begin REF_CHARACTERISTIC /end REF_CHARACTERISTIC /end GROUP
/begin GROUP LoaMgr.IvtrLoaMtgtnEn.Cnt_lgc "MICROSAR RTE" /begin SUB_GROUP /end SUB_GROUP /begin FUNCTION_LIST /end FUNCTION_LIST /begin REF_CHARACTERISTIC /end REF_CHARACTERISTIC /end GROUP
/begin GROUP LoaMgr.LOASt.State_enum "MICROSAR RTE" /begin SUB_GROUP /end SUB_GROUP /begin FUNCTION_LIST /end FUNCTION_LIST /begin REF_CHARACTERISTIC /end REF_CHARACTERISTIC /begin REF_MEASUREMENT Rte_LoaMgr_LOASt_State_enum /end REF_MEASUREMENT /end GROUP
/begin GROUP LoaMgr.LoaRateLimit.UlspS_f32 "MICROSAR RTE" /begin SUB_GROUP /end SUB_GROUP /begin FUNCTION_LIST /end FUNCTION_LIST /begin REF_CHARACTERISTIC /end REF_CHARACTERISTIC /begin REF_MEASUREMENT Rte_LoaMgr_LoaRateLimit_UlspS_f32 /end REF_MEASUREMENT /end GROUP
/begin GROUP LoaMgr.LoaScaDi.Cnt_lgc "MICROSAR RTE" /begin SUB_GROUP /end SUB_GROUP /begin FUNCTION_LIST /end FUNCTION_LIST /begin REF_CHARACTERISTIC /end REF_CHARACTERISTIC /end GROUP
/begin GROUP LoaMgr.LoaScaleFctr.Uls_f32 "MICROSAR RTE" /begin SUB_GROUP /end SUB_GROUP /begin FUNCTION_LIST /end FUNCTION_LIST /begin REF_CHARACTERISTIC /end REF_CHARACTERISTIC /begin REF_MEASUREMENT Rte_LoaMgr_LoaScaleFctr_Uls_f32 /end REF_MEASUREMENT /end GROUP
/begin GROUP LoaMgr.MotAgLoaMtgtnEn.Cnt_lgc "MICROSAR RTE" /begin SUB_GROUP /end SUB_GROUP /begin FUNCTION_LIST /end FUNCTION_LIST /begin REF_CHARACTERISTIC /end REF_CHARACTERISTIC /begin REF_MEASUREMENT Rte_LoaMgr_MotAgLoaMtgtnEn_Cnt_lgc /end REF_MEASUREMENT /end GROUP
/begin GROUP LoaMgr.MotCurrIdptSig.Cnt_u08 "MICROSAR RTE" /begin SUB_GROUP /end SUB_GROUP /begin FUNCTION_LIST /end FUNCTION_LIST /begin REF_CHARACTERISTIC /end REF_CHARACTERISTIC /begin REF_MEASUREMENT Rte_TqRsDg_MtrCurrIdptSig_Cnt_u08 /end REF_MEASUREMENT /end GROUP
/begin GROUP LoaMgr.MotCurrLoaMtgtnEn.Cnt_lgc "MICROSAR RTE" /begin SUB_GROUP /end SUB_GROUP /begin FUNCTION_LIST /end FUNCTION_LIST /begin REF_CHARACTERISTIC /end REF_CHARACTERISTIC /end GROUP
/begin GROUP LoaMgr.MtrPosIdptSig.Cnt_u08 "MICROSAR RTE" /begin SUB_GROUP /end SUB_GROUP /begin FUNCTION_LIST /end FUNCTION_LIST /begin REF_CHARACTERISTIC /end REF_CHARACTERISTIC /begin REF_MEASUREMENT Rte_LoaMgr_MtrPosIdptSig_Cnt_u08 /end REF_MEASUREMENT /end GROUP
/begin GROUP LoaMgr.ReceiverPorts "MICROSAR RTE"
 /begin SUB_GROUP LoaMgr.DiagcStsIvtr1Inactv.Cnt_lgc LoaMgr.DiagcStsIvtr2Inactv.Cnt_lgc LoaMgr.HwTqIdptSig.Cnt_u08 LoaMgr.LoaScaDi.Cnt_lgc LoaMgr.MotCurrIdptSig.Cnt_u08 LoaMgr.MtrPosIdptSig.Cnt_u08 LoaMgr.SteerMod.Cnt_enum LoaMgr.TloaAvail.Cnt_lgc LoaMgr.TloaDi.Cnt_lgc /end SUB_GROUP
 /begin FUNCTION_LIST /end FUNCTION_LIST
 /begin REF_CHARACTERISTIC /end REF_CHARACTERISTIC
 /begin REF_MEASUREMENT /end REF_MEASUREMENT
/end GROUP
/begin GROUP LoaMgr.SenderPorts "MICROSAR RTE"
 /begin SUB_GROUP LoaMgr.HwTqLoaMtgtnEn.Cnt_lgc LoaMgr.IvtrLoaMtgtnEn.Cnt_lgc LoaMgr.LOASt.State_enum LoaMgr.LoaRateLimit.UlspS_f32 LoaMgr.LoaScaleFctr.Uls_f32 LoaMgr.MotAgLoaMtgtnEn.Cnt_lgc LoaMgr.MotCurrLoaMtgtnEn.Cnt_lgc /end SUB_GROUP
 /begin FUNCTION_LIST /end FUNCTION_LIST
 /begin REF_CHARACTERISTIC /end REF_CHARACTERISTIC
 /begin REF_MEASUREMENT /end REF_MEASUREMENT
/end GROUP
/begin GROUP LoaMgr.SteerMod.Cnt_enum "MICROSAR RTE" /begin SUB_GROUP /end SUB_GROUP /begin FUNCTION_LIST /end FUNCTION_LIST /begin REF_CHARACTERISTIC /end REF_CHARACTERISTIC /begin REF_MEASUREMENT Rte_LoaMgr_SteerMod_Cnt_enum /end REF_MEASUREMENT /end GROUP
/begin GROUP LoaMgr.TloaAvail.Cnt_lgc "MICROSAR RTE" /begin SUB_GROUP /end SUB_GROUP /begin FUNCTION_LIST /end FUNCTION_LIST /begin REF_CHARACTERISTIC /end REF_CHARACTERISTIC /begin REF_MEASUREMENT Rte_TrqLOA_TrqLOAAvail_Cnt_lgc /end REF_MEASUREMENT /end GROUP
/begin GROUP LoaMgr.TloaDi.Cnt_lgc "MICROSAR RTE" /begin SUB_GROUP /end SUB_GROUP /begin FUNCTION_LIST /end FUNCTION_LIST /begin REF_CHARACTERISTIC /end REF_CHARACTERISTIC /begin REF_MEASUREMENT Rte_LoaMgr_TloaDi_Cnt_lgc /end REF_MEASUREMENT /end GROUP
/begin GROUP LrnEOT "MICROSAR RTE"
 /begin SUB_GROUP LrnEOT.PerInstanceMemories LrnEOT.ReceiverPorts LrnEOT.SenderPorts /end SUB_GROUP
 /begin FUNCTION_LIST /end FUNCTION_LIST
 /begin REF_CHARACTERISTIC /end REF_CHARACTERISTIC
 /begin REF_MEASUREMENT /end REF_MEASUREMENT
/end GROUP
/begin GROUP LrnEOT.CCWFound.Cnt_lgc "MICROSAR RTE" /begin SUB_GROUP /end SUB_GROUP /begin FUNCTION_LIST /end FUNCTION_LIST /begin REF_CHARACTERISTIC /end REF_CHARACTERISTIC /end GROUP
/begin GROUP LrnEOT.CCWPosition.HwDeg_f32 "MICROSAR RTE" /begin SUB_GROUP /end SUB_GROUP /begin FUNCTION_LIST /end FUNCTION_LIST /begin REF_CHARACTERISTIC /end REF_CHARACTERISTIC /end GROUP
/begin GROUP LrnEOT.CWFound.Cnt_lgc "MICROSAR RTE" /begin SUB_GROUP /end SUB_GROUP /begin FUNCTION_LIST /end FUNCTION_LIST /begin REF_CHARACTERISTIC /end REF_CHARACTERISTIC /end GROUP
/begin GROUP LrnEOT.CWPosition.HwDeg_f32 "MICROSAR RTE" /begin SUB_GROUP /end SUB_GROUP /begin FUNCTION_LIST /end FUNCTION_LIST /begin REF_CHARACTERISTIC /end REF_CHARACTERISTIC /end GROUP
/begin GROUP LrnEOT.DiagStsHwPosDis.Cnt_lgc "MICROSAR RTE" /begin SUB_GROUP /end SUB_GROUP /begin FUNCTION_LIST /end FUNCTION_LIST /begin REF_CHARACTERISTIC /end REF_CHARACTERISTIC /end GROUP
/begin GROUP LrnEOT.HandwheelAuthority.Uls_f32 "MICROSAR RTE" /begin SUB_GROUP /end SUB_GROUP /begin FUNCTION_LIST /end FUNCTION_LIST /begin REF_CHARACTERISTIC /end REF_CHARACTERISTIC /end GROUP
/begin GROUP LrnEOT.HandwheelPosition.HwDeg_f32 "MICROSAR RTE" /begin SUB_GROUP /end SUB_GROUP /begin FUNCTION_LIST /end FUNCTION_LIST /begin REF_CHARACTERISTIC /end REF_CHARACTERISTIC /end GROUP
/begin GROUP LrnEOT.HwTorque.HwNm_f32 "MICROSAR RTE" /begin SUB_GROUP /end SUB_GROUP /begin FUNCTION_LIST /end FUNCTION_LIST /begin REF_CHARACTERISTIC /end REF_CHARACTERISTIC /end GROUP
/begin GROUP LrnEOT.LearnedEOT "MICROSAR RTE" /begin SUB_GROUP /end SUB_GROUP /begin FUNCTION_LIST /end FUNCTION_LIST /begin REF_CHARACTERISTIC /end REF_CHARACTERISTIC
 /begin REF_MEASUREMENT Rte_LrnEOT_LearnedEOT.CCWEOTFound_Cnt_lgc Rte_LrnEOT_LearnedEOT.CCWEOTPosition_HwDeg_f32 Rte_LrnEOT_LearnedEOT.CWEOTFound_Cnt_lgc Rte_LrnEOT_LearnedEOT.CWEOTPosition_HwDeg_f32 /end REF_MEASUREMENT
/end GROUP
/begin GROUP LrnEOT.MtrVelCRF.MtrRadpS_f32 "MICROSAR RTE" /begin SUB_GROUP /end SUB_GROUP /begin FUNCTION_LIST /end FUNCTION_LIST /begin REF_CHARACTERISTIC /end REF_CHARACTERISTIC /end GROUP
/begin GROUP LrnEOT.PerInstanceMemories "MICROSAR RTE" /begin SUB_GROUP LrnEOT.LearnedEOT /end SUB_GROUP /begin FUNCTION_LIST /end FUNCTION_LIST /begin REF_CHARACTERISTIC /end REF_CHARACTERISTIC /begin REF_MEASUREMENT /end REF_MEASUREMENT /end GROUP
/begin GROUP LrnEOT.ReceiverPorts "MICROSAR RTE"
 /begin SUB_GROUP LrnEOT.DiagStsHwPosDis.Cnt_lgc LrnEOT.HandwheelAuthority.Uls_f32 LrnEOT.HandwheelPosition.HwDeg_f32 LrnEOT.HwTorque.HwNm_f32 LrnEOT.MtrVelCRF.MtrRadpS_f32 /end SUB_GROUP
 /begin FUNCTION_LIST /end FUNCTION_LIST
 /begin REF_CHARACTERISTIC /end REF_CHARACTERISTIC
 /begin REF_MEASUREMENT /end REF_MEASUREMENT
/end GROUP
/begin GROUP LrnEOT.SenderPorts "MICROSAR RTE"
 /begin SUB_GROUP LrnEOT.CCWFound.Cnt_lgc LrnEOT.CCWPosition.HwDeg_f32 LrnEOT.CWFound.Cnt_lgc LrnEOT.CWPosition.HwDeg_f32 /end SUB_GROUP
 /begin FUNCTION_LIST /end FUNCTION_LIST
 /begin REF_CHARACTERISTIC /end REF_CHARACTERISTIC
 /begin REF_MEASUREMENT /end REF_MEASUREMENT
/end GROUP
/begin GROUP MtrDrvDiag "MICROSAR RTE"
 /begin SUB_GROUP MtrDrvDiag.ModeRequirePorts MtrDrvDiag.ReceiverPorts MtrDrvDiag.SenderPorts /end SUB_GROUP
 /begin FUNCTION_LIST /end FUNCTION_LIST
 /begin REF_CHARACTERISTIC /end REF_CHARACTERISTIC
 /begin REF_MEASUREMENT /end REF_MEASUREMENT
/end GROUP
/begin GROUP MtrDrvDiag.FETFaultPhase.Cnt_enum "MICROSAR RTE" /begin SUB_GROUP /end SUB_GROUP /begin FUNCTION_LIST /end FUNCTION_LIST /begin REF_CHARACTERISTIC /end REF_CHARACTERISTIC /begin REF_MEASUREMENT Rte_MtrDrvDiag_FETFaultPhase_Cnt_enum /end REF_MEASUREMENT /end GROUP
/begin GROUP MtrDrvDiag.FETFaultType.Cnt_enum "MICROSAR RTE" /begin SUB_GROUP /end SUB_GROUP /begin FUNCTION_LIST /end FUNCTION_LIST /begin REF_CHARACTERISTIC /end REF_CHARACTERISTIC /begin REF_MEASUREMENT Rte_MtrDrvDiag_FETFaultType_Cnt_enum /end REF_MEASUREMENT /end GROUP
/begin GROUP MtrDrvDiag.GateDriveResetActive.Cnt_lgc "MICROSAR RTE" /begin SUB_GROUP /end SUB_GROUP /begin FUNCTION_LIST /end FUNCTION_LIST /begin REF_CHARACTERISTIC /end REF_CHARACTERISTIC /end GROUP
/begin GROUP MtrDrvDiag.ModeRequirePorts "MICROSAR RTE" /begin SUB_GROUP MtrDrvDiag.SystemState.Mode /end SUB_GROUP /begin FUNCTION_LIST /end FUNCTION_LIST /begin REF_CHARACTERISTIC /end REF_CHARACTERISTIC /begin REF_MEASUREMENT /end REF_MEASUREMENT /end GROUP
/begin GROUP MtrDrvDiag.MtrDrvrInitComplete.Cnt_lgc "MICROSAR RTE" /begin SUB_GROUP /end SUB_GROUP /begin FUNCTION_LIST /end FUNCTION_LIST /begin REF_CHARACTERISTIC /end REF_CHARACTERISTIC /begin REF_MEASUREMENT Rte_MtrDrvDiag_MtrDrvrInitComplete_Cnt_lgc /end REF_MEASUREMENT /end GROUP
/begin GROUP MtrDrvDiag.MtrDrvrInitStart.Cnt_lgc "MICROSAR RTE" /begin SUB_GROUP /end SUB_GROUP /begin FUNCTION_LIST /end FUNCTION_LIST /begin REF_CHARACTERISTIC /end REF_CHARACTERISTIC /begin REF_MEASUREMENT Rte_HwPwUp_MtrDrvrInitStart_Cnt_lgc /end REF_MEASUREMENT /end GROUP
/begin GROUP MtrDrvDiag.ReceiverPorts "MICROSAR RTE" /begin SUB_GROUP MtrDrvDiag.MtrDrvrInitStart.Cnt_lgc /end SUB_GROUP /begin FUNCTION_LIST /end FUNCTION_LIST /begin REF_CHARACTERISTIC /end REF_CHARACTERISTIC /begin REF_MEASUREMENT /end REF_MEASUREMENT /end GROUP
/begin GROUP MtrDrvDiag.SenderPorts "MICROSAR RTE"
 /begin SUB_GROUP MtrDrvDiag.FETFaultPhase.Cnt_enum MtrDrvDiag.FETFaultType.Cnt_enum MtrDrvDiag.GateDriveResetActive.Cnt_lgc MtrDrvDiag.MtrDrvrInitComplete.Cnt_lgc /end SUB_GROUP
 /begin FUNCTION_LIST /end FUNCTION_LIST
 /begin REF_CHARACTERISTIC /end REF_CHARACTERISTIC
 /begin REF_MEASUREMENT /end REF_MEASUREMENT
/end GROUP
/begin GROUP MtrDrvDiag.SystemState.Mode "MICROSAR RTE" /begin SUB_GROUP /end SUB_GROUP /begin FUNCTION_LIST /end FUNCTION_LIST /begin REF_CHARACTERISTIC /end REF_CHARACTERISTIC /end GROUP
/begin GROUP MtrTempEst "MICROSAR RTE" /begin SUB_GROUP MtrTempEst.ReceiverPorts MtrTempEst.SenderPorts /end SUB_GROUP /begin FUNCTION_LIST /end FUNCTION_LIST /begin REF_CHARACTERISTIC /end REF_CHARACTERISTIC /begin REF_MEASUREMENT /end REF_MEASUREMENT /end GROUP
/begin GROUP MtrTempEst.AmbTemp.DegC_f32 "MICROSAR RTE" /begin SUB_GROUP /end SUB_GROUP /begin FUNCTION_LIST /end FUNCTION_LIST /begin REF_CHARACTERISTIC /end REF_CHARACTERISTIC /begin REF_MEASUREMENT Rte_MtrTempEst_AmbTemp_DegC_f32 /end REF_MEASUREMENT /end GROUP
/begin GROUP MtrTempEst.AssistMechTempEst.DegC_f32 "MICROSAR RTE" /begin SUB_GROUP /end SUB_GROUP /begin FUNCTION_LIST /end FUNCTION_LIST /begin REF_CHARACTERISTIC /end REF_CHARACTERISTIC /end GROUP
/begin GROUP MtrTempEst.CtrlTempFinal.DegC_f32 "MICROSAR RTE" /begin SUB_GROUP /end SUB_GROUP /begin FUNCTION_LIST /end FUNCTION_LIST /begin REF_CHARACTERISTIC /end REF_CHARACTERISTIC /end GROUP
/begin GROUP MtrTempEst.CuTempEst.DegC_f32 "MICROSAR RTE" /begin SUB_GROUP /end SUB_GROUP /begin FUNCTION_LIST /end FUNCTION_LIST /begin REF_CHARACTERISTIC /end REF_CHARACTERISTIC /end GROUP
/begin GROUP MtrTempEst.EngTemp.DegC_f32 "MICROSAR RTE" /begin SUB_GROUP /end SUB_GROUP /begin FUNCTION_LIST /end FUNCTION_LIST /begin REF_CHARACTERISTIC /end REF_CHARACTERISTIC /begin REF_MEASUREMENT Rte_MtrTempEst_EngTemp_DegC_f32 /end REF_MEASUREMENT /end GROUP
/begin GROUP MtrTempEst.EstPkCurr.AmpSq_f32 "MICROSAR RTE" /begin SUB_GROUP /end SUB_GROUP /begin FUNCTION_LIST /end FUNCTION_LIST /begin REF_CHARACTERISTIC /end REF_CHARACTERISTIC /begin REF_MEASUREMENT Rte_PeakCurrEst_EstPkCurr_AmpSq_f32 /end REF_MEASUREMENT /end GROUP
/begin GROUP MtrTempEst.HwVel.HwRadpS_f32 "MICROSAR RTE" /begin SUB_GROUP /end SUB_GROUP /begin FUNCTION_LIST /end FUNCTION_LIST /begin REF_CHARACTERISTIC /end REF_CHARACTERISTIC /end GROUP
/begin GROUP MtrTempEst.MagTempEst.DegC_f32 "MICROSAR RTE" /begin SUB_GROUP /end SUB_GROUP /begin FUNCTION_LIST /end FUNCTION_LIST /begin REF_CHARACTERISTIC /end REF_CHARACTERISTIC /end GROUP
/begin GROUP MtrTempEst.ReceiverPorts "MICROSAR RTE"
 /begin SUB_GROUP MtrTempEst.AmbTemp.DegC_f32 MtrTempEst.CtrlTempFinal.DegC_f32 MtrTempEst.EngTemp.DegC_f32 MtrTempEst.EstPkCurr.AmpSq_f32 MtrTempEst.HwVel.HwRadpS_f32 MtrTempEst.ScomAMDefeat.Cnt_lgc MtrTempEst.ScomTempDataRcvd.Cnt_lgc /end SUB_GROUP
 /begin FUNCTION_LIST /end FUNCTION_LIST
 /begin REF_CHARACTERISTIC /end REF_CHARACTERISTIC
 /begin REF_MEASUREMENT /end REF_MEASUREMENT
/end GROUP
/begin GROUP MtrTempEst.ScomAMDefeat.Cnt_lgc "MICROSAR RTE" /begin SUB_GROUP /end SUB_GROUP /begin FUNCTION_LIST /end FUNCTION_LIST /begin REF_CHARACTERISTIC /end REF_CHARACTERISTIC /begin REF_MEASUREMENT Rte_MtrTempEst_ScomAMDefeat_Cnt_lgc /end REF_MEASUREMENT /end GROUP
/begin GROUP MtrTempEst.ScomTempDataRcvd.Cnt_lgc "MICROSAR RTE" /begin SUB_GROUP /end SUB_GROUP /begin FUNCTION_LIST /end FUNCTION_LIST /begin REF_CHARACTERISTIC /end REF_CHARACTERISTIC /begin REF_MEASUREMENT Rte_MtrTempEst_ScomTempDataRcvd_Cnt_lgc /end REF_MEASUREMENT /end GROUP
/begin GROUP MtrTempEst.SenderPorts "MICROSAR RTE"
 /begin SUB_GROUP MtrTempEst.AssistMechTempEst.DegC_f32 MtrTempEst.CuTempEst.DegC_f32 MtrTempEst.MagTempEst.DegC_f32 MtrTempEst.SiTempEst.DegC_f32 /end SUB_GROUP
 /begin FUNCTION_LIST /end FUNCTION_LIST
 /begin REF_CHARACTERISTIC /end REF_CHARACTERISTIC
 /begin REF_MEASUREMENT /end REF_MEASUREMENT
/end GROUP
/begin GROUP MtrTempEst.SiTempEst.DegC_f32 "MICROSAR RTE" /begin SUB_GROUP /end SUB_GROUP /begin FUNCTION_LIST /end FUNCTION_LIST /begin REF_CHARACTERISTIC /end REF_CHARACTERISTIC /end GROUP
/begin GROUP MtrVel "MICROSAR RTE" /begin SUB_GROUP MtrVel.ReceiverPorts MtrVel.SenderPorts /end SUB_GROUP /begin FUNCTION_LIST /end FUNCTION_LIST /begin REF_CHARACTERISTIC /end REF_CHARACTERISTIC /begin REF_MEASUREMENT /end REF_MEASUREMENT /end GROUP
/begin GROUP MtrVel.AsstAssemblyPolarity.Cnt_s08 "MICROSAR RTE" /begin SUB_GROUP /end SUB_GROUP /begin FUNCTION_LIST /end FUNCTION_LIST /begin REF_CHARACTERISTIC /end REF_CHARACTERISTIC /end GROUP
/begin GROUP MtrVel.HandwheelVel.HwRadpS_f32 "MICROSAR RTE" /begin SUB_GROUP /end SUB_GROUP /begin FUNCTION_LIST /end FUNCTION_LIST /begin REF_CHARACTERISTIC /end REF_CHARACTERISTIC /end GROUP
/begin GROUP MtrVel.HwVelValid.Cnt_lgc "MICROSAR RTE" /begin SUB_GROUP /end SUB_GROUP /begin FUNCTION_LIST /end FUNCTION_LIST /begin REF_CHARACTERISTIC /end REF_CHARACTERISTIC /begin REF_MEASUREMENT Rte_MtrVel_HwVelValid_Cnt_lgc /end REF_MEASUREMENT /end GROUP
/begin GROUP MtrVel.MechMtrPos2.Rev_u0p16 "MICROSAR RTE" /begin SUB_GROUP /end SUB_GROUP /begin FUNCTION_LIST /end FUNCTION_LIST /begin REF_CHARACTERISTIC /end REF_CHARACTERISTIC /end GROUP
/begin GROUP MtrVel.MechMtrPos2Timestamp.USec_u32 "MICROSAR RTE" /begin SUB_GROUP /end SUB_GROUP /begin FUNCTION_LIST /end FUNCTION_LIST /begin REF_CHARACTERISTIC /end REF_CHARACTERISTIC /end GROUP
/begin GROUP MtrVel.MotorVelCRF.MtrRadpS_f32 "MICROSAR RTE" /begin SUB_GROUP /end SUB_GROUP /begin FUNCTION_LIST /end FUNCTION_LIST /begin REF_CHARACTERISTIC /end REF_CHARACTERISTIC /end GROUP
/begin GROUP MtrVel.MotorVelMRF.MtrRadpS_f32 "MICROSAR RTE" /begin SUB_GROUP /end SUB_GROUP /begin FUNCTION_LIST /end FUNCTION_LIST /begin REF_CHARACTERISTIC /end REF_CHARACTERISTIC /end GROUP
/begin GROUP MtrVel.ReceiverPorts "MICROSAR RTE"
 /begin SUB_GROUP MtrVel.AsstAssemblyPolarity.Cnt_s08 MtrVel.MechMtrPos2.Rev_u0p16 MtrVel.MechMtrPos2Timestamp.USec_u32 MtrVel.SysCDiagHwVel.HwRadpS_f32 MtrVel.SysCDiagMtrVelMRF.MtrRadpS_f32 /end SUB_GROUP
 /begin FUNCTION_LIST /end FUNCTION_LIST
 /begin REF_CHARACTERISTIC /end REF_CHARACTERISTIC
 /begin REF_MEASUREMENT /end REF_MEASUREMENT
/end GROUP
/begin GROUP MtrVel.SenderPorts "MICROSAR RTE"
 /begin SUB_GROUP MtrVel.HandwheelVel.HwRadpS_f32 MtrVel.HwVelValid.Cnt_lgc MtrVel.MotorVelCRF.MtrRadpS_f32 MtrVel.MotorVelMRF.MtrRadpS_f32 MtrVel.SysCHandwheelVel.HwRadpS_f32 MtrVel.SysCMotorVelMRF.MtrRadpS_f32 /end SUB_GROUP
 /begin FUNCTION_LIST /end FUNCTION_LIST
 /begin REF_CHARACTERISTIC /end REF_CHARACTERISTIC
 /begin REF_MEASUREMENT /end REF_MEASUREMENT
/end GROUP
/begin GROUP MtrVel.SysCDiagHwVel.HwRadpS_f32 "MICROSAR RTE" /begin SUB_GROUP /end SUB_GROUP /begin FUNCTION_LIST /end FUNCTION_LIST /begin REF_CHARACTERISTIC /end REF_CHARACTERISTIC /begin REF_MEASUREMENT Rte_MtrVel2_SysCDiagHwVel_HwRadpS_f32 /end REF_MEASUREMENT /end GROUP
/begin GROUP MtrVel.SysCDiagMtrVelMRF.MtrRadpS_f32 "MICROSAR RTE" /begin SUB_GROUP /end SUB_GROUP /begin FUNCTION_LIST /end FUNCTION_LIST /begin REF_CHARACTERISTIC /end REF_CHARACTERISTIC /begin REF_MEASUREMENT Rte_MtrVel2_SysCDiagMtrVelMRF_MtrRadpS_f32 /end REF_MEASUREMENT /end GROUP
/begin GROUP MtrVel.SysCHandwheelVel.HwRadpS_f32 "MICROSAR RTE" /begin SUB_GROUP /end SUB_GROUP /begin FUNCTION_LIST /end FUNCTION_LIST /begin REF_CHARACTERISTIC /end REF_CHARACTERISTIC /begin REF_MEASUREMENT Rte_MtrVel_SysCHandwheelVel_HwRadpS_f32 /end REF_MEASUREMENT /end GROUP
/begin GROUP MtrVel.SysCMotorVelMRF.MtrRadpS_f32 "MICROSAR RTE" /begin SUB_GROUP /end SUB_GROUP /begin FUNCTION_LIST /end FUNCTION_LIST /begin REF_CHARACTERISTIC /end REF_CHARACTERISTIC /begin REF_MEASUREMENT Rte_MtrVel_SysCMotorVelMRF_MtrRadpS_f32 /end REF_MEASUREMENT /end GROUP
/begin GROUP MtrVel2 "MICROSAR RTE" /begin SUB_GROUP MtrVel2.ReceiverPorts MtrVel2.SenderPorts /end SUB_GROUP /begin FUNCTION_LIST /end FUNCTION_LIST /begin REF_CHARACTERISTIC /end REF_CHARACTERISTIC /begin REF_MEASUREMENT /end REF_MEASUREMENT /end GROUP
/begin GROUP MtrVel2.AsstAssemblyPolarity.Cnt_s08 "MICROSAR RTE" /begin SUB_GROUP /end SUB_GROUP /begin FUNCTION_LIST /end FUNCTION_LIST /begin REF_CHARACTERISTIC /end REF_CHARACTERISTIC /end GROUP
/begin GROUP MtrVel2.CumMechMtrPosMRF.Deg_f32 "MICROSAR RTE" /begin SUB_GROUP /end SUB_GROUP /begin FUNCTION_LIST /end FUNCTION_LIST /begin REF_CHARACTERISTIC /end REF_CHARACTERISTIC /end GROUP
/begin GROUP MtrVel2.HandwheelVel.HwRadpS_f32 "MICROSAR RTE" /begin SUB_GROUP /end SUB_GROUP /begin FUNCTION_LIST /end FUNCTION_LIST /begin REF_CHARACTERISTIC /end REF_CHARACTERISTIC /end GROUP
/begin GROUP MtrVel2.MechMtrPos1Timestamp.USec_u32 "MICROSAR RTE" /begin SUB_GROUP /end SUB_GROUP /begin FUNCTION_LIST /end FUNCTION_LIST /begin REF_CHARACTERISTIC /end REF_CHARACTERISTIC /end GROUP
/begin GROUP MtrVel2.MotorVelMRF.MtrRadpS_f32 "MICROSAR RTE" /begin SUB_GROUP /end SUB_GROUP /begin FUNCTION_LIST /end FUNCTION_LIST /begin REF_CHARACTERISTIC /end REF_CHARACTERISTIC /end GROUP
/begin GROUP MtrVel2.ReceiverPorts "MICROSAR RTE"
 /begin SUB_GROUP MtrVel2.AsstAssemblyPolarity.Cnt_s08 MtrVel2.CumMechMtrPosMRF.Deg_f32 MtrVel2.HandwheelVel.HwRadpS_f32 MtrVel2.MechMtrPos1Timestamp.USec_u32 MtrVel2.MotorVelMRF.MtrRadpS_f32 /end SUB_GROUP
 /begin FUNCTION_LIST /end FUNCTION_LIST
 /begin REF_CHARACTERISTIC /end REF_CHARACTERISTIC
 /begin REF_MEASUREMENT /end REF_MEASUREMENT
/end GROUP
/begin GROUP MtrVel2.SenderPorts "MICROSAR RTE"
 /begin SUB_GROUP MtrVel2.SysCDiagHwVel.HwRadpS_f32 MtrVel2.SysCDiagMtrVelMRF.MtrRadpS_f32 /end SUB_GROUP
 /begin FUNCTION_LIST /end FUNCTION_LIST
 /begin REF_CHARACTERISTIC /end REF_CHARACTERISTIC
 /begin REF_MEASUREMENT /end REF_MEASUREMENT
/end GROUP
/begin GROUP MtrVel2.SysCDiagHwVel.HwRadpS_f32 "MICROSAR RTE" /begin SUB_GROUP /end SUB_GROUP /begin FUNCTION_LIST /end FUNCTION_LIST /begin REF_CHARACTERISTIC /end REF_CHARACTERISTIC /begin REF_MEASUREMENT Rte_MtrVel2_SysCDiagHwVel_HwRadpS_f32 /end REF_MEASUREMENT /end GROUP
/begin GROUP MtrVel2.SysCDiagMtrVelMRF.MtrRadpS_f32 "MICROSAR RTE" /begin SUB_GROUP /end SUB_GROUP /begin FUNCTION_LIST /end FUNCTION_LIST /begin REF_CHARACTERISTIC /end REF_CHARACTERISTIC /begin REF_MEASUREMENT Rte_MtrVel2_SysCDiagMtrVelMRF_MtrRadpS_f32 /end REF_MEASUREMENT /end GROUP
/begin GROUP Nhet1CfgAndUse "MICROSAR RTE" /begin SUB_GROUP Nhet1CfgAndUse.ReceiverPorts Nhet1CfgAndUse.SenderPorts /end SUB_GROUP /begin FUNCTION_LIST /end FUNCTION_LIST /begin REF_CHARACTERISTIC /end REF_CHARACTERISTIC /begin REF_MEASUREMENT /end REF_MEASUREMENT /end GROUP
/begin GROUP Nhet1CfgAndUse.HwTq1Polarity.Cnt_s08 "MICROSAR RTE" /begin SUB_GROUP /end SUB_GROUP /begin FUNCTION_LIST /end FUNCTION_LIST /begin REF_CHARACTERISTIC /end REF_CHARACTERISTIC /end GROUP
/begin GROUP Nhet1CfgAndUse.HwTq1Qlfr.State_enum "MICROSAR RTE" /begin SUB_GROUP /end SUB_GROUP /begin FUNCTION_LIST /end FUNCTION_LIST /begin REF_CHARACTERISTIC /end REF_CHARACTERISTIC /begin REF_MEASUREMENT Rte_Nhet1CfgAndUse_HwTq1Qlfr_State_enum /end REF_MEASUREMENT /end GROUP
/begin GROUP Nhet1CfgAndUse.HwTq1RollgCntr.Cnt_u08 "MICROSAR RTE" /begin SUB_GROUP /end SUB_GROUP /begin FUNCTION_LIST /end FUNCTION_LIST /begin REF_CHARACTERISTIC /end REF_CHARACTERISTIC /begin REF_MEASUREMENT Rte_Nhet1CfgAndUse_HwTq1RollgCntr_Cnt_u08 /end REF_MEASUREMENT /end GROUP
/begin GROUP Nhet1CfgAndUse.HwTq1Val.HwNm_f32 "MICROSAR RTE" /begin SUB_GROUP /end SUB_GROUP /begin FUNCTION_LIST /end FUNCTION_LIST /begin REF_CHARACTERISTIC /end REF_CHARACTERISTIC /begin REF_MEASUREMENT Rte_Nhet1CfgAndUse_HwTq1Val_HwNm_f32 /end REF_MEASUREMENT /end GROUP
/begin GROUP Nhet1CfgAndUse.HwTq2Polarity.Cnt_s08 "MICROSAR RTE" /begin SUB_GROUP /end SUB_GROUP /begin FUNCTION_LIST /end FUNCTION_LIST /begin REF_CHARACTERISTIC /end REF_CHARACTERISTIC /end GROUP
/begin GROUP Nhet1CfgAndUse.HwTq2Qlfr.State_enum "MICROSAR RTE" /begin SUB_GROUP /end SUB_GROUP /begin FUNCTION_LIST /end FUNCTION_LIST /begin REF_CHARACTERISTIC /end REF_CHARACTERISTIC /begin REF_MEASUREMENT Rte_Nhet1CfgAndUse_HwTq2Qlfr_State_enum /end REF_MEASUREMENT /end GROUP
/begin GROUP Nhet1CfgAndUse.HwTq2RollgCntr.Cnt_u08 "MICROSAR RTE" /begin SUB_GROUP /end SUB_GROUP /begin FUNCTION_LIST /end FUNCTION_LIST /begin REF_CHARACTERISTIC /end REF_CHARACTERISTIC /begin REF_MEASUREMENT Rte_Nhet1CfgAndUse_HwTq2RollgCntr_Cnt_u08 /end REF_MEASUREMENT /end GROUP
/begin GROUP Nhet1CfgAndUse.HwTq2Val.HwNm_f32 "MICROSAR RTE" /begin SUB_GROUP /end SUB_GROUP /begin FUNCTION_LIST /end FUNCTION_LIST /begin REF_CHARACTERISTIC /end REF_CHARACTERISTIC /begin REF_MEASUREMENT Rte_Nhet1CfgAndUse_HwTq2Val_HwNm_f32 /end REF_MEASUREMENT /end GROUP
/begin GROUP Nhet1CfgAndUse.ReceiverPorts "MICROSAR RTE"
 /begin SUB_GROUP Nhet1CfgAndUse.HwTq1Polarity.Cnt_s08 Nhet1CfgAndUse.HwTq2Polarity.Cnt_s08 /end SUB_GROUP
 /begin FUNCTION_LIST /end FUNCTION_LIST
 /begin REF_CHARACTERISTIC /end REF_CHARACTERISTIC
 /begin REF_MEASUREMENT /end REF_MEASUREMENT
/end GROUP
/begin GROUP Nhet1CfgAndUse.SenderPorts "MICROSAR RTE"
 /begin SUB_GROUP Nhet1CfgAndUse.HwTq1Qlfr.State_enum Nhet1CfgAndUse.HwTq1RollgCntr.Cnt_u08 Nhet1CfgAndUse.HwTq1Val.HwNm_f32 Nhet1CfgAndUse.HwTq2Qlfr.State_enum Nhet1CfgAndUse.HwTq2RollgCntr.Cnt_u08 Nhet1CfgAndUse.HwTq2Val.HwNm_f32 /end SUB_GROUP
 /begin FUNCTION_LIST /end FUNCTION_LIST
 /begin REF_CHARACTERISTIC /end REF_CHARACTERISTIC
 /begin REF_MEASUREMENT /end REF_MEASUREMENT
/end GROUP
/begin GROUP OvrVoltMon "MICROSAR RTE" /begin SUB_GROUP OvrVoltMon.ModeRequirePorts OvrVoltMon.ReceiverPorts /end SUB_GROUP /begin FUNCTION_LIST /end FUNCTION_LIST /begin REF_CHARACTERISTIC /end REF_CHARACTERISTIC /begin REF_MEASUREMENT /end REF_MEASUREMENT /end GROUP
/begin GROUP OvrVoltMon.ModeRequirePorts "MICROSAR RTE" /begin SUB_GROUP OvrVoltMon.SystemState.Mode /end SUB_GROUP /begin FUNCTION_LIST /end FUNCTION_LIST /begin REF_CHARACTERISTIC /end REF_CHARACTERISTIC /begin REF_MEASUREMENT /end REF_MEASUREMENT /end GROUP
/begin GROUP OvrVoltMon.PwrDiscBTestStart.Cnt_lgc "MICROSAR RTE" /begin SUB_GROUP /end SUB_GROUP /begin FUNCTION_LIST /end FUNCTION_LIST /begin REF_CHARACTERISTIC /end REF_CHARACTERISTIC /end GROUP
/begin GROUP OvrVoltMon.ReceiverPorts "MICROSAR RTE" /begin SUB_GROUP OvrVoltMon.PwrDiscBTestStart.Cnt_lgc /end SUB_GROUP /begin FUNCTION_LIST /end FUNCTION_LIST /begin REF_CHARACTERISTIC /end REF_CHARACTERISTIC /begin REF_MEASUREMENT /end REF_MEASUREMENT /end GROUP
/begin GROUP OvrVoltMon.SystemState.Mode "MICROSAR RTE" /begin SUB_GROUP /end SUB_GROUP /begin FUNCTION_LIST /end FUNCTION_LIST /begin REF_CHARACTERISTIC /end REF_CHARACTERISTIC /end GROUP
/begin GROUP PICurrCntrl "MICROSAR RTE" /begin SUB_GROUP PICurrCntrl.ModeRequirePorts /end SUB_GROUP /begin FUNCTION_LIST /end FUNCTION_LIST /begin REF_CHARACTERISTIC /end REF_CHARACTERISTIC /begin REF_MEASUREMENT /end REF_MEASUREMENT /end GROUP
/begin GROUP PICurrCntrl.ModeRequirePorts "MICROSAR RTE" /begin SUB_GROUP PICurrCntrl.SystemState.Mode /end SUB_GROUP /begin FUNCTION_LIST /end FUNCTION_LIST /begin REF_CHARACTERISTIC /end REF_CHARACTERISTIC /begin REF_MEASUREMENT /end REF_MEASUREMENT /end GROUP
/begin GROUP PICurrCntrl.SystemState.Mode "MICROSAR RTE" /begin SUB_GROUP /end SUB_GROUP /begin FUNCTION_LIST /end FUNCTION_LIST /begin REF_CHARACTERISTIC /end REF_CHARACTERISTIC /end GROUP
/begin GROUP PSADMQ "MICROSAR RTE" /begin SUB_GROUP PSADMQ.ReceiverPorts PSADMQ.SenderPorts /end SUB_GROUP /begin FUNCTION_LIST /end FUNCTION_LIST /begin REF_CHARACTERISTIC /end REF_CHARACTERISTIC /begin REF_MEASUREMENT /end REF_MEASUREMENT /end GROUP
/begin GROUP PSADMQ.DesiredTunPers.Cnt_u16 "MICROSAR RTE" /begin SUB_GROUP /end SUB_GROUP /begin FUNCTION_LIST /end FUNCTION_LIST /begin REF_CHARACTERISTIC /end REF_CHARACTERISTIC /end GROUP
/begin GROUP PSADMQ.MultiModSwt.Cnt_enum "MICROSAR RTE" /begin SUB_GROUP /end SUB_GROUP /begin FUNCTION_LIST /end FUNCTION_LIST /begin REF_CHARACTERISTIC /end REF_CHARACTERISTIC /begin REF_MEASUREMENT Rte_SrlComInput_ReqModeDAFinal_Cnt_enum /end REF_MEASUREMENT /end GROUP
/begin GROUP PSADMQ.MultiModeSelected.Cnt_lgc "MICROSAR RTE" /begin SUB_GROUP /end SUB_GROUP /begin FUNCTION_LIST /end FUNCTION_LIST /begin REF_CHARACTERISTIC /end REF_CHARACTERISTIC /end GROUP
/begin GROUP PSADMQ.PersSelnInpVld.Cnt_lgc "MICROSAR RTE" /begin SUB_GROUP /end SUB_GROUP /begin FUNCTION_LIST /end FUNCTION_LIST /begin REF_CHARACTERISTIC /end REF_CHARACTERISTIC /begin REF_MEASUREMENT Rte_SrlComInput_MultiModeVld_Cnt_lgc /end REF_MEASUREMENT /end GROUP
/begin GROUP PSADMQ.ReceiverPorts "MICROSAR RTE"
 /begin SUB_GROUP PSADMQ.MultiModSwt.Cnt_enum PSADMQ.MultiModeSelected.Cnt_lgc PSADMQ.PersSelnInpVld.Cnt_lgc PSADMQ.TunReqGranted.Cnt_lgc /end SUB_GROUP
 /begin FUNCTION_LIST /end FUNCTION_LIST
 /begin REF_CHARACTERISTIC /end REF_CHARACTERISTIC
 /begin REF_MEASUREMENT /end REF_MEASUREMENT
/end GROUP
/begin GROUP PSADMQ.SenderPorts "MICROSAR RTE" /begin SUB_GROUP PSADMQ.DesiredTunPers.Cnt_u16 PSADMQ.TunModSt.Cnt_enum /end SUB_GROUP /begin FUNCTION_LIST /end FUNCTION_LIST /begin REF_CHARACTERISTIC /end REF_CHARACTERISTIC /begin REF_MEASUREMENT /end REF_MEASUREMENT /end GROUP
/begin GROUP PSADMQ.TunModSt.Cnt_enum "MICROSAR RTE" /begin SUB_GROUP /end SUB_GROUP /begin FUNCTION_LIST /end FUNCTION_LIST /begin REF_CHARACTERISTIC /end REF_CHARACTERISTIC /begin REF_MEASUREMENT Rte_PSADMQ_TunModSt_Cnt_enum /end REF_MEASUREMENT /end GROUP
/begin GROUP PSADMQ.TunReqGranted.Cnt_lgc "MICROSAR RTE" /begin SUB_GROUP /end SUB_GROUP /begin FUNCTION_LIST /end FUNCTION_LIST /begin REF_CHARACTERISTIC /end REF_CHARACTERISTIC /begin REF_MEASUREMENT Rte_TuningSelAuth_TunReqGranted_Cnt_lgc /end REF_MEASUREMENT /end GROUP
/begin GROUP PSADSG "MICROSAR RTE" /begin SUB_GROUP PSADSG.ReceiverPorts PSADSG.SenderPorts /end SUB_GROUP /begin FUNCTION_LIST /end FUNCTION_LIST /begin REF_CHARACTERISTIC /end REF_CHARACTERISTIC /begin REF_MEASUREMENT /end REF_MEASUREMENT /end GROUP
/begin GROUP PSADSG.DampingCmd.MtrNm_f32 "MICROSAR RTE" /begin SUB_GROUP /end SUB_GROUP /begin FUNCTION_LIST /end FUNCTION_LIST /begin REF_CHARACTERISTIC /end REF_CHARACTERISTIC /end GROUP
/begin GROUP PSADSG.HwTorque.HwNm_f32 "MICROSAR RTE" /begin SUB_GROUP /end SUB_GROUP /begin FUNCTION_LIST /end FUNCTION_LIST /begin REF_CHARACTERISTIC /end REF_CHARACTERISTIC /end GROUP
/begin GROUP PSADSG.PsaDampgCmd.MtrNm_f32 "MICROSAR RTE" /begin SUB_GROUP /end SUB_GROUP /begin FUNCTION_LIST /end FUNCTION_LIST /begin REF_CHARACTERISTIC /end REF_CHARACTERISTIC /end GROUP
/begin GROUP PSADSG.ReceiverPorts "MICROSAR RTE"
 /begin SUB_GROUP PSADSG.DampingCmd.MtrNm_f32 PSADSG.HwTorque.HwNm_f32 PSADSG.VehicleSpeed.Kph_f32 /end SUB_GROUP
 /begin FUNCTION_LIST /end FUNCTION_LIST
 /begin REF_CHARACTERISTIC /end REF_CHARACTERISTIC
 /begin REF_MEASUREMENT /end REF_MEASUREMENT
/end GROUP
/begin GROUP PSADSG.SenderPorts "MICROSAR RTE" /begin SUB_GROUP PSADSG.PsaDampgCmd.MtrNm_f32 /end SUB_GROUP /begin FUNCTION_LIST /end FUNCTION_LIST /begin REF_CHARACTERISTIC /end REF_CHARACTERISTIC /begin REF_MEASUREMENT /end REF_MEASUREMENT /end GROUP
/begin GROUP PSADSG.VehicleSpeed.Kph_f32 "MICROSAR RTE" /begin SUB_GROUP /end SUB_GROUP /begin FUNCTION_LIST /end FUNCTION_LIST /begin REF_CHARACTERISTIC /end REF_CHARACTERISTIC /end GROUP
/begin GROUP PSASH "MICROSAR RTE"
 /begin SUB_GROUP PSASH.ModeRequirePorts PSASH.ReceiverPorts PSASH.SenderPorts /end SUB_GROUP
 /begin FUNCTION_LIST /end FUNCTION_LIST
 /begin REF_CHARACTERISTIC /end REF_CHARACTERISTIC
 /begin REF_MEASUREMENT /end REF_MEASUREMENT
/end GROUP
/begin GROUP PSASH.AbsActv.Cnt_lgc "MICROSAR RTE" /begin SUB_GROUP /end SUB_GROUP /begin FUNCTION_LIST /end FUNCTION_LIST /begin REF_CHARACTERISTIC /end REF_CHARACTERISTIC /begin REF_MEASUREMENT Rte_SrlComInput_AbsActv_Cnt_lgc /end REF_MEASUREMENT /end GROUP
/begin GROUP PSASH.ApaAuthn.Cnt_lgc "MICROSAR RTE" /begin SUB_GROUP /end SUB_GROUP /begin FUNCTION_LIST /end FUNCTION_LIST /begin REF_CHARACTERISTIC /end REF_CHARACTERISTIC /begin REF_MEASUREMENT Rte_SrlComInput_APAAuthn_Cnt_lgc /end REF_MEASUREMENT /end GROUP
/begin GROUP PSASH.ApaCmdReq.Cnt_lgc "MICROSAR RTE" /begin SUB_GROUP /end SUB_GROUP /begin FUNCTION_LIST /end FUNCTION_LIST /begin REF_CHARACTERISTIC /end REF_CHARACTERISTIC /begin REF_MEASUREMENT Rte_SrlComInput_APARequest_Cnt_lgc /end REF_MEASUREMENT /end GROUP
/begin GROUP PSASH.ApaEna.Cnt_lgc "MICROSAR RTE" /begin SUB_GROUP /end SUB_GROUP /begin FUNCTION_LIST /end FUNCTION_LIST /begin REF_CHARACTERISTIC /end REF_CHARACTERISTIC /end GROUP
/begin GROUP PSASH.ApaHwAgCmd.HwDeg_f32 "MICROSAR RTE" /begin SUB_GROUP /end SUB_GROUP /begin FUNCTION_LIST /end FUNCTION_LIST /begin REF_CHARACTERISTIC /end REF_CHARACTERISTIC /begin REF_MEASUREMENT Rte_SrlComInput_PosSrvoHwAngle_HwDeg_f32 /end REF_MEASUREMENT /end GROUP
/begin GROUP PSASH.ApaPosSrvoFlt.Cnt_lgc "MICROSAR RTE" /begin SUB_GROUP /end SUB_GROUP /begin FUNCTION_LIST /end FUNCTION_LIST /begin REF_CHARACTERISTIC /end REF_CHARACTERISTIC /begin REF_MEASUREMENT Rte_PSATA_ApaPosSrvoFlt_Cnt_lgc /end REF_MEASUREMENT /end GROUP
/begin GROUP PSASH.ApaRelaxReq.Cnt_lgc "MICROSAR RTE" /begin SUB_GROUP /end SUB_GROUP /begin FUNCTION_LIST /end FUNCTION_LIST /begin REF_CHARACTERISTIC /end REF_CHARACTERISTIC /begin REF_MEASUREMENT Rte_SrlComInput_ApaRelaxReq_Cnt_lgc /end REF_MEASUREMENT /end GROUP
/begin GROUP PSASH.ApaState.Cnt_enum "MICROSAR RTE" /begin SUB_GROUP /end SUB_GROUP /begin FUNCTION_LIST /end FUNCTION_LIST /begin REF_CHARACTERISTIC /end REF_CHARACTERISTIC /begin REF_MEASUREMENT Rte_PSASH_ApaState_Cnt_enum /end REF_MEASUREMENT /end GROUP
/begin GROUP PSASH.ApaStateTransitionCause.Cnt_enum "MICROSAR RTE" /begin SUB_GROUP /end SUB_GROUP /begin FUNCTION_LIST /end FUNCTION_LIST /begin REF_CHARACTERISTIC /end REF_CHARACTERISTIC /begin REF_MEASUREMENT Rte_PSASH_ApaStateTransitionCause_Cnt_enum /end REF_MEASUREMENT /end GROUP
/begin GROUP PSASH.AssistStallLimit.MtrNm_f32 "MICROSAR RTE" /begin SUB_GROUP /end SUB_GROUP /begin FUNCTION_LIST /end FUNCTION_LIST /begin REF_CHARACTERISTIC /end REF_CHARACTERISTIC /begin REF_MEASUREMENT Rte_HiLoadStall_AssistStallLimit_MtrNm_f32 /end REF_MEASUREMENT /end GROUP
/begin GROUP PSASH.CpkOk.Cnt_lgc "MICROSAR RTE" /begin SUB_GROUP /end SUB_GROUP /begin FUNCTION_LIST /end FUNCTION_LIST /begin REF_CHARACTERISTIC /end REF_CHARACTERISTIC /begin REF_MEASUREMENT Rte_SrlComInput_CPKOK_Cnt_lgc /end REF_MEASUREMENT /end GROUP
/begin GROUP PSASH.DrvrIntvDetd.Cnt_lgc "MICROSAR RTE" /begin SUB_GROUP /end SUB_GROUP /begin FUNCTION_LIST /end FUNCTION_LIST /begin REF_CHARACTERISTIC /end REF_CHARACTERISTIC /begin REF_MEASUREMENT Rte_PSASH_DrvrIntvDetd_Cnt_lgc /end REF_MEASUREMENT /end GROUP
/begin GROUP PSASH.EPSStateForLxa.Cnt_enum "MICROSAR RTE" /begin SUB_GROUP /end SUB_GROUP /begin FUNCTION_LIST /end FUNCTION_LIST /begin REF_CHARACTERISTIC /end REF_CHARACTERISTIC /begin REF_MEASUREMENT Rte_PSASH_EPSStateForLxa_Cnt_enum /end REF_MEASUREMENT /end GROUP
/begin GROUP PSASH.EscActv.Cnt_lgc "MICROSAR RTE" /begin SUB_GROUP /end SUB_GROUP /begin FUNCTION_LIST /end FUNCTION_LIST /begin REF_CHARACTERISTIC /end REF_CHARACTERISTIC /begin REF_MEASUREMENT Rte_SrlComInput_EscActv_Cnt_lgc /end REF_MEASUREMENT /end GROUP
/begin GROUP PSASH.EscEna.Cnt_lgc "MICROSAR RTE" /begin SUB_GROUP /end SUB_GROUP /begin FUNCTION_LIST /end FUNCTION_LIST /begin REF_CHARACTERISTIC /end REF_CHARACTERISTIC /begin REF_MEASUREMENT Rte_SrlComInput_EscEna_Cnt_lgc /end REF_MEASUREMENT /end GROUP
/begin GROUP PSASH.EscFltPrsnt.Cnt_lgc "MICROSAR RTE" /begin SUB_GROUP /end SUB_GROUP /begin FUNCTION_LIST /end FUNCTION_LIST /begin REF_CHARACTERISTIC /end REF_CHARACTERISTIC /begin REF_MEASUREMENT Rte_SrlComInput_EscFltPrsnt_Cnt_lgc /end REF_MEASUREMENT /end GROUP
/begin GROUP PSASH.FTermActv.Cnt_lgc "MICROSAR RTE" /begin SUB_GROUP /end SUB_GROUP /begin FUNCTION_LIST /end FUNCTION_LIST /begin REF_CHARACTERISTIC /end REF_CHARACTERISTIC /end GROUP
/begin GROUP PSASH.HOWState.Cnt_s08 "MICROSAR RTE" /begin SUB_GROUP /end SUB_GROUP /begin FUNCTION_LIST /end FUNCTION_LIST /begin REF_CHARACTERISTIC /end REF_CHARACTERISTIC /begin REF_MEASUREMENT Rte_HOWDetect_HOWState_Cnt_s08 /end REF_MEASUREMENT /end GROUP
/begin GROUP PSASH.HandwheelAuthority.Uls_f32 "MICROSAR RTE" /begin SUB_GROUP /end SUB_GROUP /begin FUNCTION_LIST /end FUNCTION_LIST /begin REF_CHARACTERISTIC /end REF_CHARACTERISTIC /end GROUP
/begin GROUP PSASH.HandwheelPosition.HwDeg_f32 "MICROSAR RTE" /begin SUB_GROUP /end SUB_GROUP /begin FUNCTION_LIST /end FUNCTION_LIST /begin REF_CHARACTERISTIC /end REF_CHARACTERISTIC /end GROUP
/begin GROUP PSASH.HandwheelVelocity.HwRadpS_f32 "MICROSAR RTE" /begin SUB_GROUP /end SUB_GROUP /begin FUNCTION_LIST /end FUNCTION_LIST /begin REF_CHARACTERISTIC /end REF_CHARACTERISTIC /end GROUP
/begin GROUP PSASH.HwTorque.HwNm_f32 "MICROSAR RTE" /begin SUB_GROUP /end SUB_GROUP /begin FUNCTION_LIST /end FUNCTION_LIST /begin REF_CHARACTERISTIC /end REF_CHARACTERISTIC /end GROUP
/begin GROUP PSASH.HwTrqRate.HwNmpS_f32 "MICROSAR RTE" /begin SUB_GROUP /end SUB_GROUP /begin FUNCTION_LIST /end FUNCTION_LIST /begin REF_CHARACTERISTIC /end REF_CHARACTERISTIC /begin REF_MEASUREMENT Rte_PSASH_HwTrqRate_HwNmpS_f32 /end REF_MEASUREMENT /end GROUP
/begin GROUP PSASH.LpaSeld.Cnt_lgc "MICROSAR RTE" /begin SUB_GROUP /end SUB_GROUP /begin FUNCTION_LIST /end FUNCTION_LIST /begin REF_CHARACTERISTIC /end REF_CHARACTERISTIC /begin REF_MEASUREMENT Rte_SrlComInput_LxaSeln_Cnt_lgc /end REF_MEASUREMENT /end GROUP
/begin GROUP PSASH.LxaApaConflictReqNTC.Cnt_lgc "MICROSAR RTE" /begin SUB_GROUP /end SUB_GROUP /begin FUNCTION_LIST /end FUNCTION_LIST /begin REF_CHARACTERISTIC /end REF_CHARACTERISTIC /begin REF_MEASUREMENT Rte_PSASH_LxaApaConflictReqNTC_Cnt_lgc /end REF_MEASUREMENT /end GROUP
/begin GROUP PSASH.LxaCorrnFacReqLimd.Uls_f32 "MICROSAR RTE" /begin SUB_GROUP /end SUB_GROUP /begin FUNCTION_LIST /end FUNCTION_LIST /begin REF_CHARACTERISTIC /end REF_CHARACTERISTIC /begin REF_MEASUREMENT Rte_PSASH_LxaCorrnFacReqLimd_Uls_f32 /end REF_MEASUREMENT /end GROUP
/begin GROUP PSASH.LxaDrvrAbsntDetd.Cnt_lgc "MICROSAR RTE" /begin SUB_GROUP /end SUB_GROUP /begin FUNCTION_LIST /end FUNCTION_LIST /begin REF_CHARACTERISTIC /end REF_CHARACTERISTIC /begin REF_MEASUREMENT Rte_PSASH_LxaDrvrAbsntDetd_Cnt_lgc /end REF_MEASUREMENT /end GROUP
/begin GROUP PSASH.LxaDrvrAbsntHwVelDetd.Cnt_lgc "MICROSAR RTE" /begin SUB_GROUP /end SUB_GROUP /begin FUNCTION_LIST /end FUNCTION_LIST /begin REF_CHARACTERISTIC /end REF_CHARACTERISTIC /begin REF_MEASUREMENT Rte_PSASH_LxaDrvrAbsntHwVelDetd_Cnt_lgc /end REF_MEASUREMENT /end GROUP
/begin GROUP PSASH.LxaDrvrAbsntWarn.Cnt_lgc "MICROSAR RTE" /begin SUB_GROUP /end SUB_GROUP /begin FUNCTION_LIST /end FUNCTION_LIST /begin REF_CHARACTERISTIC /end REF_CHARACTERISTIC /begin REF_MEASUREMENT Rte_PSASH_LxaDrvrAbsntWarn_Cnt_lgc /end REF_MEASUREMENT /end GROUP
/begin GROUP PSASH.LxaHwAgCmd.HwDeg_f32 "MICROSAR RTE" /begin SUB_GROUP /end SUB_GROUP /begin FUNCTION_LIST /end FUNCTION_LIST /begin REF_CHARACTERISTIC /end REF_CHARACTERISTIC /begin REF_MEASUREMENT Rte_SrlComInput_ColAngleSetpoint_HwDeg_f32 /end REF_MEASUREMENT /end GROUP
/begin GROUP PSASH.LxaHwAgDetd.Cnt_lgc "MICROSAR RTE" /begin SUB_GROUP /end SUB_GROUP /begin FUNCTION_LIST /end FUNCTION_LIST /begin REF_CHARACTERISTIC /end REF_CHARACTERISTIC /begin REF_MEASUREMENT Rte_PSASH_LxaHwAgDetd_Cnt_lgc /end REF_MEASUREMENT /end GROUP
/begin GROUP PSASH.LxaInactivOnDrvrBhvr.Cnt_lgc "MICROSAR RTE" /begin SUB_GROUP /end SUB_GROUP /begin FUNCTION_LIST /end FUNCTION_LIST /begin REF_CHARACTERISTIC /end REF_CHARACTERISTIC /begin REF_MEASUREMENT Rte_PSASH_LxaInactivOnDrvrBhvr_Cnt_lgc /end REF_MEASUREMENT /end GROUP
/begin GROUP PSASH.LxaInpVld.Cnt_lgc "MICROSAR RTE" /begin SUB_GROUP /end SUB_GROUP /begin FUNCTION_LIST /end FUNCTION_LIST /begin REF_CHARACTERISTIC /end REF_CHARACTERISTIC /begin REF_MEASUREMENT Rte_SrlComInput_LxaInpVld_Cnt_lgc /end REF_MEASUREMENT /end GROUP
/begin GROUP PSASH.LxaSelected.Cnt_lgc "MICROSAR RTE" /begin SUB_GROUP /end SUB_GROUP /begin FUNCTION_LIST /end FUNCTION_LIST /begin REF_CHARACTERISTIC /end REF_CHARACTERISTIC /end GROUP
/begin GROUP PSASH.LxaState.Cnt_enum "MICROSAR RTE" /begin SUB_GROUP /end SUB_GROUP /begin FUNCTION_LIST /end FUNCTION_LIST /begin REF_CHARACTERISTIC /end REF_CHARACTERISTIC /begin REF_MEASUREMENT Rte_SrlComInput_LxaStateFilt_Cnt_enum /end REF_MEASUREMENT /end GROUP
/begin GROUP PSASH.LxaTqFacReq.Uls_f32 "MICROSAR RTE" /begin SUB_GROUP /end SUB_GROUP /begin FUNCTION_LIST /end FUNCTION_LIST /begin REF_CHARACTERISTIC /end REF_CHARACTERISTIC /begin REF_MEASUREMENT Rte_SrlComInput_LxaTqFacReq_Uls_f32 /end REF_MEASUREMENT /end GROUP
/begin GROUP PSASH.ModeRequirePorts "MICROSAR RTE" /begin SUB_GROUP PSASH.SystemState.Mode /end SUB_GROUP /begin FUNCTION_LIST /end FUNCTION_LIST /begin REF_CHARACTERISTIC /end REF_CHARACTERISTIC /begin REF_MEASUREMENT /end REF_MEASUREMENT /end GROUP
/begin GROUP PSASH.OutputRampMult.Uls_f32 "MICROSAR RTE" /begin SUB_GROUP /end SUB_GROUP /begin FUNCTION_LIST /end FUNCTION_LIST /begin REF_CHARACTERISTIC /end REF_CHARACTERISTIC /begin REF_MEASUREMENT Rte_StOpCtrl_OutputRampMult_Uls_f32 /end REF_MEASUREMENT /end GROUP
/begin GROUP PSASH.PosSrvoEnable.Cnt_lgc "MICROSAR RTE" /begin SUB_GROUP /end SUB_GROUP /begin FUNCTION_LIST /end FUNCTION_LIST /begin REF_CHARACTERISTIC /end REF_CHARACTERISTIC /begin REF_MEASUREMENT Rte_PSASH_PosSrvoEnable_Cnt_lgc /end REF_MEASUREMENT /end GROUP
/begin GROUP PSASH.PosSrvoHwAngle.HwDeg_f32 "MICROSAR RTE" /begin SUB_GROUP /end SUB_GROUP /begin FUNCTION_LIST /end FUNCTION_LIST /begin REF_CHARACTERISTIC /end REF_CHARACTERISTIC /begin REF_MEASUREMENT Rte_PSASH_PosSrvoHwAngle_HwDeg_f32 /end REF_MEASUREMENT /end GROUP
/begin GROUP PSASH.ReceiverPorts "MICROSAR RTE"
 /begin SUB_GROUP PSASH.AbsActv.Cnt_lgc PSASH.ApaAuthn.Cnt_lgc PSASH.ApaCmdReq.Cnt_lgc PSASH.ApaEna.Cnt_lgc PSASH.ApaHwAgCmd.HwDeg_f32 PSASH.ApaPosSrvoFlt.Cnt_lgc PSASH.ApaRelaxReq.Cnt_lgc PSASH.AssistStallLimit.MtrNm_f32 PSASH.CpkOk.Cnt_lgc PSASH.EscActv.Cnt_lgc PSASH.EscEna.Cnt_lgc PSASH.EscFltPrsnt.Cnt_lgc PSASH.FTermActv.Cnt_lgc PSASH.HOWState.Cnt_s08 PSASH.HandwheelAuthority.Uls_f32 PSASH.HandwheelPosition.HwDeg_f32 PSASH.HandwheelVelocity.HwRadpS_f32 PSASH.HwTorque.HwNm_f32 PSASH.LpaSeld.Cnt_lgc PSASH.LxaHwAgCmd.HwDeg_f32 PSASH.LxaInpVld.Cnt_lgc PSASH.LxaSelected.Cnt_lgc PSASH.LxaState.Cnt_enum PSASH.LxaTqFacReq.Uls_f32 PSASH.OutputRampMult.Uls_f32 PSASH.ThermLimitPerc.Uls_f32 PSASH.VehicleSpeed.Kph_f32 PSASH.VehicleSpeedValid.Cnt_lgc /end SUB_GROUP
 /begin FUNCTION_LIST /end FUNCTION_LIST
 /begin REF_CHARACTERISTIC /end REF_CHARACTERISTIC
 /begin REF_MEASUREMENT /end REF_MEASUREMENT
/end GROUP
/begin GROUP PSASH.SenderPorts "MICROSAR RTE"
 /begin SUB_GROUP PSASH.ApaState.Cnt_enum PSASH.ApaStateTransitionCause.Cnt_enum PSASH.DrvrIntvDetd.Cnt_lgc PSASH.EPSStateForLxa.Cnt_enum PSASH.HwTrqRate.HwNmpS_f32 PSASH.LxaApaConflictReqNTC.Cnt_lgc PSASH.LxaCorrnFacReqLimd.Uls_f32 PSASH.LxaDrvrAbsntDetd.Cnt_lgc PSASH.LxaDrvrAbsntHwVelDetd.Cnt_lgc PSASH.LxaDrvrAbsntWarn.Cnt_lgc PSASH.LxaHwAgDetd.Cnt_lgc PSASH.LxaInactivOnDrvrBhvr.Cnt_lgc PSASH.PosSrvoEnable.Cnt_lgc PSASH.PosSrvoHwAngle.HwDeg_f32 /end SUB_GROUP
 /begin FUNCTION_LIST /end FUNCTION_LIST
 /begin REF_CHARACTERISTIC /end REF_CHARACTERISTIC
 /begin REF_MEASUREMENT /end REF_MEASUREMENT
/end GROUP
/begin GROUP PSASH.SystemState.Mode "MICROSAR RTE" /begin SUB_GROUP /end SUB_GROUP /begin FUNCTION_LIST /end FUNCTION_LIST /begin REF_CHARACTERISTIC /end REF_CHARACTERISTIC /end GROUP
/begin GROUP PSASH.ThermLimitPerc.Uls_f32 "MICROSAR RTE" /begin SUB_GROUP /end SUB_GROUP /begin FUNCTION_LIST /end FUNCTION_LIST /begin REF_CHARACTERISTIC /end REF_CHARACTERISTIC /end GROUP
/begin GROUP PSASH.VehicleSpeed.Kph_f32 "MICROSAR RTE" /begin SUB_GROUP /end SUB_GROUP /begin FUNCTION_LIST /end FUNCTION_LIST /begin REF_CHARACTERISTIC /end REF_CHARACTERISTIC /end GROUP
/begin GROUP PSASH.VehicleSpeedValid.Cnt_lgc "MICROSAR RTE" /begin SUB_GROUP /end SUB_GROUP /begin FUNCTION_LIST /end FUNCTION_LIST /begin REF_CHARACTERISTIC /end REF_CHARACTERISTIC /begin REF_MEASUREMENT Rte_SrlComInput_ApaVehicleSpeedValid_Cnt_lgc /end REF_MEASUREMENT /end GROUP
/begin GROUP PSATA "MICROSAR RTE" /begin SUB_GROUP PSATA.ReceiverPorts PSATA.SenderPorts /end SUB_GROUP /begin FUNCTION_LIST /end FUNCTION_LIST /begin REF_CHARACTERISTIC /end REF_CHARACTERISTIC /begin REF_MEASUREMENT /end REF_MEASUREMENT /end GROUP
/begin GROUP PSATA.ApaOpTrqOv.MtrNm_f32 "MICROSAR RTE" /begin SUB_GROUP /end SUB_GROUP /begin FUNCTION_LIST /end FUNCTION_LIST /begin REF_CHARACTERISTIC /end REF_CHARACTERISTIC /begin REF_MEASUREMENT Rte_PSATA_ApaOpTrqOv_MtrNm_f32 /end REF_MEASUREMENT /end GROUP
/begin GROUP PSATA.ApaPosSrvoFlt.Cnt_lgc "MICROSAR RTE" /begin SUB_GROUP /end SUB_GROUP /begin FUNCTION_LIST /end FUNCTION_LIST /begin REF_CHARACTERISTIC /end REF_CHARACTERISTIC /begin REF_MEASUREMENT Rte_PSATA_ApaPosSrvoFlt_Cnt_lgc /end REF_MEASUREMENT /end GROUP
/begin GROUP PSATA.ApaState.Cnt_enum "MICROSAR RTE" /begin SUB_GROUP /end SUB_GROUP /begin FUNCTION_LIST /end FUNCTION_LIST /begin REF_CHARACTERISTIC /end REF_CHARACTERISTIC /begin REF_MEASUREMENT Rte_PSASH_ApaState_Cnt_enum /end REF_MEASUREMENT /end GROUP
/begin GROUP PSATA.EPSStateForLxa.Cnt_enum "MICROSAR RTE" /begin SUB_GROUP /end SUB_GROUP /begin FUNCTION_LIST /end FUNCTION_LIST /begin REF_CHARACTERISTIC /end REF_CHARACTERISTIC /begin REF_MEASUREMENT Rte_PSASH_EPSStateForLxa_Cnt_enum /end REF_MEASUREMENT /end GROUP
/begin GROUP PSATA.HandwheelVelocity.HwRadpS_f32 "MICROSAR RTE" /begin SUB_GROUP /end SUB_GROUP /begin FUNCTION_LIST /end FUNCTION_LIST /begin REF_CHARACTERISTIC /end REF_CHARACTERISTIC /end GROUP
/begin GROUP PSATA.HwTorque.HwNm_f32 "MICROSAR RTE" /begin SUB_GROUP /end SUB_GROUP /begin FUNCTION_LIST /end FUNCTION_LIST /begin REF_CHARACTERISTIC /end REF_CHARACTERISTIC /end GROUP
/begin GROUP PSATA.HwTrqRate.HwNmpS_f32 "MICROSAR RTE" /begin SUB_GROUP /end SUB_GROUP /begin FUNCTION_LIST /end FUNCTION_LIST /begin REF_CHARACTERISTIC /end REF_CHARACTERISTIC /begin REF_MEASUREMENT Rte_PSASH_HwTrqRate_HwNmpS_f32 /end REF_MEASUREMENT /end GROUP
/begin GROUP PSATA.LxaCorrnFacReqLimd.Uls_f32 "MICROSAR RTE" /begin SUB_GROUP /end SUB_GROUP /begin FUNCTION_LIST /end FUNCTION_LIST /begin REF_CHARACTERISTIC /end REF_CHARACTERISTIC /begin REF_MEASUREMENT Rte_PSASH_LxaCorrnFacReqLimd_Uls_f32 /end REF_MEASUREMENT /end GROUP
/begin GROUP PSATA.LxaDrvrAbsntHwVelDetd.Cnt_lgc "MICROSAR RTE" /begin SUB_GROUP /end SUB_GROUP /begin FUNCTION_LIST /end FUNCTION_LIST /begin REF_CHARACTERISTIC /end REF_CHARACTERISTIC /begin REF_MEASUREMENT Rte_PSASH_LxaDrvrAbsntHwVelDetd_Cnt_lgc /end REF_MEASUREMENT /end GROUP
/begin GROUP PSATA.LxaHwAgDetd.Cnt_lgc "MICROSAR RTE" /begin SUB_GROUP /end SUB_GROUP /begin FUNCTION_LIST /end FUNCTION_LIST /begin REF_CHARACTERISTIC /end REF_CHARACTERISTIC /begin REF_MEASUREMENT Rte_PSASH_LxaHwAgDetd_Cnt_lgc /end REF_MEASUREMENT /end GROUP
/begin GROUP PSATA.LxaOpTrqOv.MtrNm_f32 "MICROSAR RTE" /begin SUB_GROUP /end SUB_GROUP /begin FUNCTION_LIST /end FUNCTION_LIST /begin REF_CHARACTERISTIC /end REF_CHARACTERISTIC /begin REF_MEASUREMENT Rte_PSATA_LxaOpTrqOv_MtrNm_f32 /end REF_MEASUREMENT /end GROUP
/begin GROUP PSATA.LxaTqLimnActv.Cnt_lgc "MICROSAR RTE" /begin SUB_GROUP /end SUB_GROUP /begin FUNCTION_LIST /end FUNCTION_LIST /begin REF_CHARACTERISTIC /end REF_CHARACTERISTIC /begin REF_MEASUREMENT Rte_PSATA_LxaTqLimnActv_Cnt_lgc /end REF_MEASUREMENT /end GROUP
/begin GROUP PSATA.OpTrqOv.MtrNm_f32 "MICROSAR RTE" /begin SUB_GROUP /end SUB_GROUP /begin FUNCTION_LIST /end FUNCTION_LIST /begin REF_CHARACTERISTIC /end REF_CHARACTERISTIC /end GROUP
/begin GROUP PSATA.PosSrvoCmd.MtrNm_f32 "MICROSAR RTE" /begin SUB_GROUP /end SUB_GROUP /begin FUNCTION_LIST /end FUNCTION_LIST /begin REF_CHARACTERISTIC /end REF_CHARACTERISTIC /begin REF_MEASUREMENT Rte_PosServo_PosSrvoCmd_MtrNm_f32 /end REF_MEASUREMENT /end GROUP
/begin GROUP PSATA.PosSrvoEnable.Cnt_lgc "MICROSAR RTE" /begin SUB_GROUP /end SUB_GROUP /begin FUNCTION_LIST /end FUNCTION_LIST /begin REF_CHARACTERISTIC /end REF_CHARACTERISTIC /begin REF_MEASUREMENT Rte_PSASH_PosSrvoEnable_Cnt_lgc /end REF_MEASUREMENT /end GROUP
/begin GROUP PSATA.ReceiverPorts "MICROSAR RTE"
 /begin SUB_GROUP PSATA.ApaState.Cnt_enum PSATA.EPSStateForLxa.Cnt_enum PSATA.HandwheelVelocity.HwRadpS_f32 PSATA.HwTorque.HwNm_f32 PSATA.HwTrqRate.HwNmpS_f32 PSATA.LxaCorrnFacReqLimd.Uls_f32 PSATA.LxaDrvrAbsntHwVelDetd.Cnt_lgc PSATA.LxaHwAgDetd.Cnt_lgc PSATA.PosSrvoCmd.MtrNm_f32 PSATA.PosSrvoEnable.Cnt_lgc PSATA.VehicleSpeed.Kph_f32 /end SUB_GROUP
 /begin FUNCTION_LIST /end FUNCTION_LIST
 /begin REF_CHARACTERISTIC /end REF_CHARACTERISTIC
 /begin REF_MEASUREMENT /end REF_MEASUREMENT
/end GROUP
/begin GROUP PSATA.SenderPorts "MICROSAR RTE"
 /begin SUB_GROUP PSATA.ApaOpTrqOv.MtrNm_f32 PSATA.ApaPosSrvoFlt.Cnt_lgc PSATA.LxaOpTrqOv.MtrNm_f32 PSATA.LxaTqLimnActv.Cnt_lgc PSATA.OpTrqOv.MtrNm_f32 /end SUB_GROUP
 /begin FUNCTION_LIST /end FUNCTION_LIST
 /begin REF_CHARACTERISTIC /end REF_CHARACTERISTIC
 /begin REF_MEASUREMENT /end REF_MEASUREMENT
/end GROUP
/begin GROUP PSATA.VehicleSpeed.Kph_f32 "MICROSAR RTE" /begin SUB_GROUP /end SUB_GROUP /begin FUNCTION_LIST /end FUNCTION_LIST /begin REF_CHARACTERISTIC /end REF_CHARACTERISTIC /end GROUP
/begin GROUP PeakCurrEst "MICROSAR RTE"
 /begin SUB_GROUP PeakCurrEst.ModeRequirePorts PeakCurrEst.ReceiverPorts PeakCurrEst.SenderPorts /end SUB_GROUP
 /begin FUNCTION_LIST /end FUNCTION_LIST
 /begin REF_CHARACTERISTIC /end REF_CHARACTERISTIC
 /begin REF_MEASUREMENT /end REF_MEASUREMENT
/end GROUP
/begin GROUP PeakCurrEst.DualEcuMotCtrlMtgnEna.Cnt_lgc "MICROSAR RTE" /begin SUB_GROUP /end SUB_GROUP /begin FUNCTION_LIST /end FUNCTION_LIST /begin REF_CHARACTERISTIC /end REF_CHARACTERISTIC /begin REF_MEASUREMENT Rte_PeakCurrEst_DualEcuMotCtrlMtgnEna_Cnt_lgc /end REF_MEASUREMENT /end GROUP
/begin GROUP PeakCurrEst.EstPkCurr.AmpSq_f32 "MICROSAR RTE" /begin SUB_GROUP /end SUB_GROUP /begin FUNCTION_LIST /end FUNCTION_LIST /begin REF_CHARACTERISTIC /end REF_CHARACTERISTIC /begin REF_MEASUREMENT Rte_PeakCurrEst_EstPkCurr_AmpSq_f32 /end REF_MEASUREMENT /end GROUP
/begin GROUP PeakCurrEst.FiltEstPkCurr.AmpSq_f32 "MICROSAR RTE" /begin SUB_GROUP /end SUB_GROUP /begin FUNCTION_LIST /end FUNCTION_LIST /begin REF_CHARACTERISTIC /end REF_CHARACTERISTIC /begin REF_MEASUREMENT Rte_PeakCurrEst_FiltEstPkCurr_AmpSq_f32 /end REF_MEASUREMENT /end GROUP
/begin GROUP PeakCurrEst.IvtrLoaMtgtnEn.Cnt_lgc "MICROSAR RTE" /begin SUB_GROUP /end SUB_GROUP /begin FUNCTION_LIST /end FUNCTION_LIST /begin REF_CHARACTERISTIC /end REF_CHARACTERISTIC /end GROUP
/begin GROUP PeakCurrEst.ModeRequirePorts "MICROSAR RTE" /begin SUB_GROUP PeakCurrEst.SystemState.Mode /end SUB_GROUP /begin FUNCTION_LIST /end FUNCTION_LIST /begin REF_CHARACTERISTIC /end REF_CHARACTERISTIC /begin REF_MEASUREMENT /end REF_MEASUREMENT /end GROUP
/begin GROUP PeakCurrEst.MotCurrLoaMtgtnEn.Cnt_lgc "MICROSAR RTE" /begin SUB_GROUP /end SUB_GROUP /begin FUNCTION_LIST /end FUNCTION_LIST /begin REF_CHARACTERISTIC /end REF_CHARACTERISTIC /begin REF_MEASUREMENT Rte_LoaMgr_MotAgLoaMtgtnEn_Cnt_lgc /end REF_MEASUREMENT /end GROUP
/begin GROUP PeakCurrEst.MtrCurrDax.Amp_f32 "MICROSAR RTE" /begin SUB_GROUP /end SUB_GROUP /begin FUNCTION_LIST /end FUNCTION_LIST /begin REF_CHARACTERISTIC /end REF_CHARACTERISTIC /end GROUP
/begin GROUP PeakCurrEst.MtrCurrDaxRef.Amp_f32 "MICROSAR RTE" /begin SUB_GROUP /end SUB_GROUP /begin FUNCTION_LIST /end FUNCTION_LIST /begin REF_CHARACTERISTIC /end REF_CHARACTERISTIC /end GROUP
/begin GROUP PeakCurrEst.MtrCurrQax.Amp_f32 "MICROSAR RTE" /begin SUB_GROUP /end SUB_GROUP /begin FUNCTION_LIST /end FUNCTION_LIST /begin REF_CHARACTERISTIC /end REF_CHARACTERISTIC /end GROUP
/begin GROUP PeakCurrEst.MtrCurrQaxRef.Amp_f32 "MICROSAR RTE" /begin SUB_GROUP /end SUB_GROUP /begin FUNCTION_LIST /end FUNCTION_LIST /begin REF_CHARACTERISTIC /end REF_CHARACTERISTIC /end GROUP
/begin GROUP PeakCurrEst.ReceiverPorts "MICROSAR RTE"
 /begin SUB_GROUP PeakCurrEst.DualEcuMotCtrlMtgnEna.Cnt_lgc PeakCurrEst.IvtrLoaMtgtnEn.Cnt_lgc PeakCurrEst.MotCurrLoaMtgtnEn.Cnt_lgc PeakCurrEst.MtrCurrDax.Amp_f32 PeakCurrEst.MtrCurrDaxRef.Amp_f32 PeakCurrEst.MtrCurrQax.Amp_f32 PeakCurrEst.MtrCurrQaxRef.Amp_f32 /end SUB_GROUP
 /begin FUNCTION_LIST /end FUNCTION_LIST
 /begin REF_CHARACTERISTIC /end REF_CHARACTERISTIC
 /begin REF_MEASUREMENT /end REF_MEASUREMENT
/end GROUP
/begin GROUP PeakCurrEst.SenderPorts "MICROSAR RTE"
 /begin SUB_GROUP PeakCurrEst.EstPkCurr.AmpSq_f32 PeakCurrEst.FiltEstPkCurr.AmpSq_f32 /end SUB_GROUP
 /begin FUNCTION_LIST /end FUNCTION_LIST
 /begin REF_CHARACTERISTIC /end REF_CHARACTERISTIC
 /begin REF_MEASUREMENT /end REF_MEASUREMENT
/end GROUP
/begin GROUP PeakCurrEst.SystemState.Mode "MICROSAR RTE" /begin SUB_GROUP /end SUB_GROUP /begin FUNCTION_LIST /end FUNCTION_LIST /begin REF_CHARACTERISTIC /end REF_CHARACTERISTIC /end GROUP
/begin GROUP PhaseAbcFdbkMeas "MICROSAR RTE" /begin SUB_GROUP PhaseAbcFdbkMeas.SenderPorts /end SUB_GROUP /begin FUNCTION_LIST /end FUNCTION_LIST /begin REF_CHARACTERISTIC /end REF_CHARACTERISTIC /begin REF_MEASUREMENT /end REF_MEASUREMENT /end GROUP
/begin GROUP PhaseAbcFdbkMeas.MeasuredOnTimeA.Cnt_u32 "MICROSAR RTE" /begin SUB_GROUP /end SUB_GROUP /begin FUNCTION_LIST /end FUNCTION_LIST /begin REF_CHARACTERISTIC /end REF_CHARACTERISTIC /end GROUP
/begin GROUP PhaseAbcFdbkMeas.MeasuredOnTimeB.Cnt_u32 "MICROSAR RTE" /begin SUB_GROUP /end SUB_GROUP /begin FUNCTION_LIST /end FUNCTION_LIST /begin REF_CHARACTERISTIC /end REF_CHARACTERISTIC /end GROUP
/begin GROUP PhaseAbcFdbkMeas.MeasuredOnTimeC.Cnt_u32 "MICROSAR RTE" /begin SUB_GROUP /end SUB_GROUP /begin FUNCTION_LIST /end FUNCTION_LIST /begin REF_CHARACTERISTIC /end REF_CHARACTERISTIC /end GROUP
/begin GROUP PhaseAbcFdbkMeas.SenderPorts "MICROSAR RTE"
 /begin SUB_GROUP PhaseAbcFdbkMeas.MeasuredOnTimeA.Cnt_u32 PhaseAbcFdbkMeas.MeasuredOnTimeB.Cnt_u32 PhaseAbcFdbkMeas.MeasuredOnTimeC.Cnt_u32 /end SUB_GROUP
 /begin FUNCTION_LIST /end FUNCTION_LIST
 /begin REF_CHARACTERISTIC /end REF_CHARACTERISTIC
 /begin REF_MEASUREMENT /end REF_MEASUREMENT
/end GROUP
/begin GROUP PosServo "MICROSAR RTE" /begin SUB_GROUP PosServo.ReceiverPorts PosServo.SenderPorts /end SUB_GROUP /begin FUNCTION_LIST /end FUNCTION_LIST /begin REF_CHARACTERISTIC /end REF_CHARACTERISTIC /begin REF_MEASUREMENT /end REF_MEASUREMENT /end GROUP
/begin GROUP PosServo.HandwheelPosition.HwDeg_f32 "MICROSAR RTE" /begin SUB_GROUP /end SUB_GROUP /begin FUNCTION_LIST /end FUNCTION_LIST /begin REF_CHARACTERISTIC /end REF_CHARACTERISTIC /end GROUP
/begin GROUP PosServo.HwTorque.HwNm_f32 "MICROSAR RTE" /begin SUB_GROUP /end SUB_GROUP /begin FUNCTION_LIST /end FUNCTION_LIST /begin REF_CHARACTERISTIC /end REF_CHARACTERISTIC /end GROUP
/begin GROUP PosServo.MotorVelCRF.MtrRadpS_f32 "MICROSAR RTE" /begin SUB_GROUP /end SUB_GROUP /begin FUNCTION_LIST /end FUNCTION_LIST /begin REF_CHARACTERISTIC /end REF_CHARACTERISTIC /end GROUP
/begin GROUP PosServo.PosSrvoCmd.MtrNm_f32 "MICROSAR RTE" /begin SUB_GROUP /end SUB_GROUP /begin FUNCTION_LIST /end FUNCTION_LIST /begin REF_CHARACTERISTIC /end REF_CHARACTERISTIC /begin REF_MEASUREMENT Rte_PosServo_PosSrvoCmd_MtrNm_f32 /end REF_MEASUREMENT /end GROUP
/begin GROUP PosServo.PosSrvoEnable.Cnt_lgc "MICROSAR RTE" /begin SUB_GROUP /end SUB_GROUP /begin FUNCTION_LIST /end FUNCTION_LIST /begin REF_CHARACTERISTIC /end REF_CHARACTERISTIC /begin REF_MEASUREMENT Rte_PSASH_PosSrvoEnable_Cnt_lgc /end REF_MEASUREMENT /end GROUP
/begin GROUP PosServo.PosSrvoHwAngle.HwDeg_f32 "MICROSAR RTE" /begin SUB_GROUP /end SUB_GROUP /begin FUNCTION_LIST /end FUNCTION_LIST /begin REF_CHARACTERISTIC /end REF_CHARACTERISTIC /begin REF_MEASUREMENT Rte_PSASH_PosSrvoHwAngle_HwDeg_f32 /end REF_MEASUREMENT /end GROUP
/begin GROUP PosServo.PosSrvoReturnSclFct.Uls_f32 "MICROSAR RTE" /begin SUB_GROUP /end SUB_GROUP /begin FUNCTION_LIST /end FUNCTION_LIST /begin REF_CHARACTERISTIC /end REF_CHARACTERISTIC /begin REF_MEASUREMENT Rte_PosServo_PosSrvoReturnSclFct_Uls_f32 /end REF_MEASUREMENT /end GROUP
/begin GROUP PosServo.PosSrvoSmoothEnable.Uls_f32 "MICROSAR RTE" /begin SUB_GROUP /end SUB_GROUP /begin FUNCTION_LIST /end FUNCTION_LIST /begin REF_CHARACTERISTIC /end REF_CHARACTERISTIC /begin REF_MEASUREMENT Rte_PosServo_PosSrvoSmoothEnable_Uls_f32 /end REF_MEASUREMENT /end GROUP
/begin GROUP PosServo.ReceiverPorts "MICROSAR RTE"
 /begin SUB_GROUP PosServo.HandwheelPosition.HwDeg_f32 PosServo.HwTorque.HwNm_f32 PosServo.MotorVelCRF.MtrRadpS_f32 PosServo.PosSrvoEnable.Cnt_lgc PosServo.PosSrvoHwAngle.HwDeg_f32 PosServo.VehicleSpeed.Kph_f32 /end SUB_GROUP
 /begin FUNCTION_LIST /end FUNCTION_LIST
 /begin REF_CHARACTERISTIC /end REF_CHARACTERISTIC
 /begin REF_MEASUREMENT /end REF_MEASUREMENT
/end GROUP
/begin GROUP PosServo.SenderPorts "MICROSAR RTE"
 /begin SUB_GROUP PosServo.PosSrvoCmd.MtrNm_f32 PosServo.PosSrvoReturnSclFct.Uls_f32 PosServo.PosSrvoSmoothEnable.Uls_f32 /end SUB_GROUP
 /begin FUNCTION_LIST /end FUNCTION_LIST
 /begin REF_CHARACTERISTIC /end REF_CHARACTERISTIC
 /begin REF_MEASUREMENT /end REF_MEASUREMENT
/end GROUP
/begin GROUP PosServo.VehicleSpeed.Kph_f32 "MICROSAR RTE" /begin SUB_GROUP /end SUB_GROUP /begin FUNCTION_LIST /end FUNCTION_LIST /begin REF_CHARACTERISTIC /end REF_CHARACTERISTIC /end GROUP
/begin GROUP PsaAgArbn "MICROSAR RTE"
 /begin SUB_GROUP PsaAgArbn.PerInstanceMemories PsaAgArbn.ReceiverPorts PsaAgArbn.SenderPorts /end SUB_GROUP
 /begin FUNCTION_LIST /end FUNCTION_LIST
 /begin REF_CHARACTERISTIC /end REF_CHARACTERISTIC
 /begin REF_MEASUREMENT /end REF_MEASUREMENT
/end GROUP
/begin GROUP PsaAgArbn.AbsltHwPosn.HwDeg_f32 "MICROSAR RTE" /begin SUB_GROUP /end SUB_GROUP /begin FUNCTION_LIST /end FUNCTION_LIST /begin REF_CHARACTERISTIC /end REF_CHARACTERISTIC /begin REF_MEASUREMENT Rte_PsaAgArbn_AbsltHwPosn_HwDeg_f32 /end REF_MEASUREMENT /end GROUP
/begin GROUP PsaAgArbn.AbsltHwPosnLvl1.Cnt_lgc "MICROSAR RTE" /begin SUB_GROUP /end SUB_GROUP /begin FUNCTION_LIST /end FUNCTION_LIST /begin REF_CHARACTERISTIC /end REF_CHARACTERISTIC /begin REF_MEASUREMENT Rte_PsaAgArbn_AbsltHwPosnLvl1_Cnt_lgc /end REF_MEASUREMENT /end GROUP
/begin GROUP PsaAgArbn.AbsltHwPosnLvl2.Cnt_lgc "MICROSAR RTE" /begin SUB_GROUP /end SUB_GROUP /begin FUNCTION_LIST /end FUNCTION_LIST /begin REF_CHARACTERISTIC /end REF_CHARACTERISTIC /begin REF_MEASUREMENT Rte_PsaAgArbn_AbsltHwPosnLvl2_Cnt_lgc /end REF_MEASUREMENT /end GROUP
/begin GROUP PsaAgArbn.AbsltHwPosnPrecision.HwDeg_f32 "MICROSAR RTE" /begin SUB_GROUP /end SUB_GROUP /begin FUNCTION_LIST /end FUNCTION_LIST /begin REF_CHARACTERISTIC /end REF_CHARACTERISTIC /begin REF_MEASUREMENT Rte_PsaAgArbn_AbsltHwPosnPrecision_HwDeg_f32 /end REF_MEASUREMENT /end GROUP
/begin GROUP PsaAgArbn.AbsltHwPosnVld.Cnt_lgc "MICROSAR RTE" /begin SUB_GROUP /end SUB_GROUP /begin FUNCTION_LIST /end FUNCTION_LIST /begin REF_CHARACTERISTIC /end REF_CHARACTERISTIC /begin REF_MEASUREMENT Rte_PsaAgArbn_AbsltHwPosnVld_Cnt_lgc /end REF_MEASUREMENT /end GROUP
/begin GROUP PsaAgArbn.AgArbnStToSerlCom.Cnt_enum "MICROSAR RTE" /begin SUB_GROUP /end SUB_GROUP /begin FUNCTION_LIST /end FUNCTION_LIST /begin REF_CHARACTERISTIC /end REF_CHARACTERISTIC /begin REF_MEASUREMENT Rte_PsaAgArbn_AgArbnStToSerlCom_Cnt_enum /end REF_MEASUREMENT /end GROUP
/begin GROUP PsaAgArbn.AlignedCumMechMtrPosStatus.Cnt_u08 "MICROSAR RTE" /begin SUB_GROUP /end SUB_GROUP /begin FUNCTION_LIST /end FUNCTION_LIST /begin REF_CHARACTERISTIC /end REF_CHARACTERISTIC /end GROUP
/begin GROUP PsaAgArbn.AlignedRelHwPos.HwDeg_f32 "MICROSAR RTE" /begin SUB_GROUP /end SUB_GROUP /begin FUNCTION_LIST /end FUNCTION_LIST /begin REF_CHARACTERISTIC /end REF_CHARACTERISTIC /end GROUP
/begin GROUP PsaAgArbn.CumMechMtrPosStatus.Cnt_u08 "MICROSAR RTE" /begin SUB_GROUP /end SUB_GROUP /begin FUNCTION_LIST /end FUNCTION_LIST /begin REF_CHARACTERISTIC /end REF_CHARACTERISTIC /end GROUP
/begin GROUP PsaAgArbn.EscAckFromSerlCom.Cnt_lgc "MICROSAR RTE" /begin SUB_GROUP /end SUB_GROUP /begin FUNCTION_LIST /end FUNCTION_LIST /begin REF_CHARACTERISTIC /end REF_CHARACTERISTIC /begin REF_MEASUREMENT Rte_SrlComInput_EscAckFromSerlCom_Cnt_lgc /end REF_MEASUREMENT /end GROUP
/begin GROUP PsaAgArbn.EscDataVldFromSerlCom.Cnt_lgc "MICROSAR RTE" /begin SUB_GROUP /end SUB_GROUP /begin FUNCTION_LIST /end FUNCTION_LIST /begin REF_CHARACTERISTIC /end REF_CHARACTERISTIC /begin REF_MEASUREMENT Rte_SrlComInput_EscDataVldFromSerlCom_Cnt_lgc /end REF_MEASUREMENT /end GROUP
/begin GROUP PsaAgArbn.EscOffsEna.Cnt_lgc "MICROSAR RTE" /begin SUB_GROUP /end SUB_GROUP /begin FUNCTION_LIST /end FUNCTION_LIST /begin REF_CHARACTERISTIC /end REF_CHARACTERISTIC /end GROUP
/begin GROUP PsaAgArbn.EscOffsFromSerlCom.HwDeg_f32 "MICROSAR RTE" /begin SUB_GROUP /end SUB_GROUP /begin FUNCTION_LIST /end FUNCTION_LIST /begin REF_CHARACTERISTIC /end REF_CHARACTERISTIC /begin REF_MEASUREMENT Rte_SrlComInput_EscOffsFromSerlCom_HwDeg_f32 /end REF_MEASUREMENT /end GROUP
/begin GROUP PsaAgArbn.EscPrecisionFromSerlCom.HwDeg_f32 "MICROSAR RTE" /begin SUB_GROUP /end SUB_GROUP /begin FUNCTION_LIST /end FUNCTION_LIST /begin REF_CHARACTERISTIC /end REF_CHARACTERISTIC /begin REF_MEASUREMENT Rte_SrlComInput_EscPrecisionFromSerlCom_HwDeg_f32 /end REF_MEASUREMENT /end GROUP
/begin GROUP PsaAgArbn.HandwheelAuthority.Uls_f32 "MICROSAR RTE" /begin SUB_GROUP /end SUB_GROUP /begin FUNCTION_LIST /end FUNCTION_LIST /begin REF_CHARACTERISTIC /end REF_CHARACTERISTIC /end GROUP
/begin GROUP PsaAgArbn.HandwheelPosition.HwDeg_f32 "MICROSAR RTE" /begin SUB_GROUP /end SUB_GROUP /begin FUNCTION_LIST /end FUNCTION_LIST /begin REF_CHARACTERISTIC /end REF_CHARACTERISTIC /end GROUP
/begin GROUP PsaAgArbn.HwTorque.HwNm_f32 "MICROSAR RTE" /begin SUB_GROUP /end SUB_GROUP /begin FUNCTION_LIST /end FUNCTION_LIST /begin REF_CHARACTERISTIC /end REF_CHARACTERISTIC /end GROUP
/begin GROUP PsaAgArbn.MtrVelCRF.MtrRadpS_f32 "MICROSAR RTE" /begin SUB_GROUP /end SUB_GROUP /begin FUNCTION_LIST /end FUNCTION_LIST /begin REF_CHARACTERISTIC /end REF_CHARACTERISTIC /end GROUP
/begin GROUP PsaAgArbn.PerInstanceMemories "MICROSAR RTE" /begin SUB_GROUP PsaAgArbn.PsaAgArbnLrndOffsData /end SUB_GROUP /begin FUNCTION_LIST /end FUNCTION_LIST /begin REF_CHARACTERISTIC /end REF_CHARACTERISTIC /begin REF_MEASUREMENT /end REF_MEASUREMENT /end GROUP
/begin GROUP PsaAgArbn.PsaAgArbnLrndOffsData "MICROSAR RTE" /begin SUB_GROUP /end SUB_GROUP /begin FUNCTION_LIST /end FUNCTION_LIST /begin REF_CHARACTERISTIC /end REF_CHARACTERISTIC
 /begin REF_MEASUREMENT Rte_PsaAgArbn_PsaAgArbnLrndOffsData.MaxOffset Rte_PsaAgArbn_PsaAgArbnLrndOffsData.MaxSrc Rte_PsaAgArbn_PsaAgArbnLrndOffsData.MinOffset Rte_PsaAgArbn_PsaAgArbnLrndOffsData.MinSrc /end REF_MEASUREMENT
/end GROUP
/begin GROUP PsaAgArbn.ReceiverPorts "MICROSAR RTE"
 /begin SUB_GROUP PsaAgArbn.AlignedCumMechMtrPosStatus.Cnt_u08 PsaAgArbn.AlignedRelHwPos.HwDeg_f32 PsaAgArbn.CumMechMtrPosStatus.Cnt_u08 PsaAgArbn.EscAckFromSerlCom.Cnt_lgc PsaAgArbn.EscDataVldFromSerlCom.Cnt_lgc PsaAgArbn.EscOffsEna.Cnt_lgc PsaAgArbn.EscOffsFromSerlCom.HwDeg_f32 PsaAgArbn.EscPrecisionFromSerlCom.HwDeg_f32 PsaAgArbn.HwTorque.HwNm_f32 PsaAgArbn.MtrVelCRF.MtrRadpS_f32 PsaAgArbn.RelHwPos.HwDeg_f32 PsaAgArbn.SensorlessAuthority.Uls_f32 PsaAgArbn.SensorlessHwPos.HwDeg_f32 PsaAgArbn.TorqueCmdCRF.MtrNm_f32 PsaAgArbn.VehicleSpeed.Kph_f32 PsaAgArbn.VehicleSpeedValid.Cnt_lgc /end SUB_GROUP
 /begin FUNCTION_LIST /end FUNCTION_LIST
 /begin REF_CHARACTERISTIC /end REF_CHARACTERISTIC
 /begin REF_MEASUREMENT /end REF_MEASUREMENT
/end GROUP
/begin GROUP PsaAgArbn.RelHwPos.HwDeg_f32 "MICROSAR RTE" /begin SUB_GROUP /end SUB_GROUP /begin FUNCTION_LIST /end FUNCTION_LIST /begin REF_CHARACTERISTIC /end REF_CHARACTERISTIC /end GROUP
/begin GROUP PsaAgArbn.RelHwPosnToSerlCom.HwDeg_f32 "MICROSAR RTE" /begin SUB_GROUP /end SUB_GROUP /begin FUNCTION_LIST /end FUNCTION_LIST /begin REF_CHARACTERISTIC /end REF_CHARACTERISTIC /begin REF_MEASUREMENT Rte_PsaAgArbn_RelHwPosnToSerlCom_HwDeg_f32 /end REF_MEASUREMENT /end GROUP
/begin GROUP PsaAgArbn.RelHwPosnVldToSerlCom.Cnt_lgc "MICROSAR RTE" /begin SUB_GROUP /end SUB_GROUP /begin FUNCTION_LIST /end FUNCTION_LIST /begin REF_CHARACTERISTIC /end REF_CHARACTERISTIC /begin REF_MEASUREMENT Rte_PsaAgArbn_RelHwPosnVldToSerlCom_Cnt_lgc /end REF_MEASUREMENT /end GROUP
/begin GROUP PsaAgArbn.SenderPorts "MICROSAR RTE"
 /begin SUB_GROUP PsaAgArbn.AbsltHwPosn.HwDeg_f32 PsaAgArbn.AbsltHwPosnLvl1.Cnt_lgc PsaAgArbn.AbsltHwPosnLvl2.Cnt_lgc PsaAgArbn.AbsltHwPosnPrecision.HwDeg_f32 PsaAgArbn.AbsltHwPosnVld.Cnt_lgc PsaAgArbn.AgArbnStToSerlCom.Cnt_enum PsaAgArbn.HandwheelAuthority.Uls_f32 PsaAgArbn.HandwheelPosition.HwDeg_f32 PsaAgArbn.RelHwPosnToSerlCom.HwDeg_f32 PsaAgArbn.RelHwPosnVldToSerlCom.Cnt_lgc /end SUB_GROUP
 /begin FUNCTION_LIST /end FUNCTION_LIST
 /begin REF_CHARACTERISTIC /end REF_CHARACTERISTIC
 /begin REF_MEASUREMENT /end REF_MEASUREMENT
/end GROUP
/begin GROUP PsaAgArbn.SensorlessAuthority.Uls_f32 "MICROSAR RTE" /begin SUB_GROUP /end SUB_GROUP /begin FUNCTION_LIST /end FUNCTION_LIST /begin REF_CHARACTERISTIC /end REF_CHARACTERISTIC /end GROUP
/begin GROUP PsaAgArbn.SensorlessHwPos.HwDeg_f32 "MICROSAR RTE" /begin SUB_GROUP /end SUB_GROUP /begin FUNCTION_LIST /end FUNCTION_LIST /begin REF_CHARACTERISTIC /end REF_CHARACTERISTIC /end GROUP
/begin GROUP PsaAgArbn.TorqueCmdCRF.MtrNm_f32 "MICROSAR RTE" /begin SUB_GROUP /end SUB_GROUP /begin FUNCTION_LIST /end FUNCTION_LIST /begin REF_CHARACTERISTIC /end REF_CHARACTERISTIC /end GROUP
/begin GROUP PsaAgArbn.VehicleSpeed.Kph_f32 "MICROSAR RTE" /begin SUB_GROUP /end SUB_GROUP /begin FUNCTION_LIST /end FUNCTION_LIST /begin REF_CHARACTERISTIC /end REF_CHARACTERISTIC /end GROUP
/begin GROUP PsaAgArbn.VehicleSpeedValid.Cnt_lgc "MICROSAR RTE" /begin SUB_GROUP /end SUB_GROUP /begin FUNCTION_LIST /end FUNCTION_LIST /begin REF_CHARACTERISTIC /end REF_CHARACTERISTIC /end GROUP
/begin GROUP PwrLmtFuncCr "MICROSAR RTE"
 /begin SUB_GROUP PwrLmtFuncCr.ModeRequirePorts PwrLmtFuncCr.ReceiverPorts PwrLmtFuncCr.SenderPorts /end SUB_GROUP
 /begin FUNCTION_LIST /end FUNCTION_LIST
 /begin REF_CHARACTERISTIC /end REF_CHARACTERISTIC
 /begin REF_MEASUREMENT /end REF_MEASUREMENT
/end GROUP
/begin GROUP PwrLmtFuncCr.CntDisMtrTrqCmdMRF.MtrNm_f32 "MICROSAR RTE" /begin SUB_GROUP /end SUB_GROUP /begin FUNCTION_LIST /end FUNCTION_LIST /begin REF_CHARACTERISTIC /end REF_CHARACTERISTIC /end GROUP
/begin GROUP PwrLmtFuncCr.EstKe.VpRadpS_f32 "MICROSAR RTE" /begin SUB_GROUP /end SUB_GROUP /begin FUNCTION_LIST /end FUNCTION_LIST /begin REF_CHARACTERISTIC /end REF_CHARACTERISTIC /end GROUP
/begin GROUP PwrLmtFuncCr.FltTrqLmt.Uls_f32 "MICROSAR RTE" /begin SUB_GROUP /end SUB_GROUP /begin FUNCTION_LIST /end FUNCTION_LIST /begin REF_CHARACTERISTIC /end REF_CHARACTERISTIC /end GROUP
/begin GROUP PwrLmtFuncCr.MRFMtrTrqCmd.MtrNm_f32 "MICROSAR RTE" /begin SUB_GROUP /end SUB_GROUP /begin FUNCTION_LIST /end FUNCTION_LIST /begin REF_CHARACTERISTIC /end REF_CHARACTERISTIC /end GROUP
/begin GROUP PwrLmtFuncCr.ModeRequirePorts "MICROSAR RTE" /begin SUB_GROUP PwrLmtFuncCr.SystemState.Mode /end SUB_GROUP /begin FUNCTION_LIST /end FUNCTION_LIST /begin REF_CHARACTERISTIC /end REF_CHARACTERISTIC /begin REF_MEASUREMENT /end REF_MEASUREMENT /end GROUP
/begin GROUP PwrLmtFuncCr.MotorVelMRF.MtrRadpS_f32 "MICROSAR RTE" /begin SUB_GROUP /end SUB_GROUP /begin FUNCTION_LIST /end FUNCTION_LIST /begin REF_CHARACTERISTIC /end REF_CHARACTERISTIC /end GROUP
/begin GROUP PwrLmtFuncCr.PosServEnable.Cnt_lgc "MICROSAR RTE" /begin SUB_GROUP /end SUB_GROUP /begin FUNCTION_LIST /end FUNCTION_LIST /begin REF_CHARACTERISTIC /end REF_CHARACTERISTIC /begin REF_MEASUREMENT Rte_PwrLmtFuncCr_PosServEnable_Cnt_lgc /end REF_MEASUREMENT /end GROUP
/begin GROUP PwrLmtFuncCr.ReceiverPorts "MICROSAR RTE"
 /begin SUB_GROUP PwrLmtFuncCr.CntDisMtrTrqCmdMRF.MtrNm_f32 PwrLmtFuncCr.EstKe.VpRadpS_f32 PwrLmtFuncCr.MotorVelMRF.MtrRadpS_f32 PwrLmtFuncCr.PosServEnable.Cnt_lgc PwrLmtFuncCr.Vecu.Volt_f32 /end SUB_GROUP
 /begin FUNCTION_LIST /end FUNCTION_LIST
 /begin REF_CHARACTERISTIC /end REF_CHARACTERISTIC
 /begin REF_MEASUREMENT /end REF_MEASUREMENT
/end GROUP
/begin GROUP PwrLmtFuncCr.SenderPorts "MICROSAR RTE"
 /begin SUB_GROUP PwrLmtFuncCr.FltTrqLmt.Uls_f32 PwrLmtFuncCr.MRFMtrTrqCmd.MtrNm_f32 PwrLmtFuncCr.ThresholdExceeded.Cnt_lgc /end SUB_GROUP
 /begin FUNCTION_LIST /end FUNCTION_LIST
 /begin REF_CHARACTERISTIC /end REF_CHARACTERISTIC
 /begin REF_MEASUREMENT /end REF_MEASUREMENT
/end GROUP
/begin GROUP PwrLmtFuncCr.SystemState.Mode "MICROSAR RTE" /begin SUB_GROUP /end SUB_GROUP /begin FUNCTION_LIST /end FUNCTION_LIST /begin REF_CHARACTERISTIC /end REF_CHARACTERISTIC /end GROUP
/begin GROUP PwrLmtFuncCr.ThresholdExceeded.Cnt_lgc "MICROSAR RTE" /begin SUB_GROUP /end SUB_GROUP /begin FUNCTION_LIST /end FUNCTION_LIST /begin REF_CHARACTERISTIC /end REF_CHARACTERISTIC /begin REF_MEASUREMENT Rte_PwrLmtFuncCr_ThresholdExceeded_Cnt_lgc /end REF_MEASUREMENT /end GROUP
/begin GROUP PwrLmtFuncCr.Vecu.Volt_f32 "MICROSAR RTE" /begin SUB_GROUP /end SUB_GROUP /begin FUNCTION_LIST /end FUNCTION_LIST /begin REF_CHARACTERISTIC /end REF_CHARACTERISTIC /end GROUP
/begin GROUP QuadDet "MICROSAR RTE" /begin SUB_GROUP QuadDet.ReceiverPorts QuadDet.SenderPorts /end SUB_GROUP /begin FUNCTION_LIST /end FUNCTION_LIST /begin REF_CHARACTERISTIC /end REF_CHARACTERISTIC /begin REF_MEASUREMENT /end REF_MEASUREMENT /end GROUP
/begin GROUP QuadDet.InstMtrDir.Cnt_s08 "MICROSAR RTE" /begin SUB_GROUP /end SUB_GROUP /begin FUNCTION_LIST /end FUNCTION_LIST /begin REF_CHARACTERISTIC /end REF_CHARACTERISTIC /begin REF_MEASUREMENT Rte_QuadDet_InstMtrDir_Cnt_s08 /end REF_MEASUREMENT /end GROUP
/begin GROUP QuadDet.MRFCumMtrPos.Deg_f32 "MICROSAR RTE" /begin SUB_GROUP /end SUB_GROUP /begin FUNCTION_LIST /end FUNCTION_LIST /begin REF_CHARACTERISTIC /end REF_CHARACTERISTIC /end GROUP
/begin GROUP QuadDet.MRFMtrTrqCmdScl.MtrNm_f32 "MICROSAR RTE" /begin SUB_GROUP /end SUB_GROUP /begin FUNCTION_LIST /end FUNCTION_LIST /begin REF_CHARACTERISTIC /end REF_CHARACTERISTIC /end GROUP
/begin GROUP QuadDet.MtrQuad.Cnt_u08 "MICROSAR RTE" /begin SUB_GROUP /end SUB_GROUP /begin FUNCTION_LIST /end FUNCTION_LIST /begin REF_CHARACTERISTIC /end REF_CHARACTERISTIC /end GROUP
/begin GROUP QuadDet.ReceiverPorts "MICROSAR RTE"
 /begin SUB_GROUP QuadDet.MRFCumMtrPos.Deg_f32 QuadDet.MRFMtrTrqCmdScl.MtrNm_f32 /end SUB_GROUP
 /begin FUNCTION_LIST /end FUNCTION_LIST
 /begin REF_CHARACTERISTIC /end REF_CHARACTERISTIC
 /begin REF_MEASUREMENT /end REF_MEASUREMENT
/end GROUP
/begin GROUP QuadDet.SenderPorts "MICROSAR RTE" /begin SUB_GROUP QuadDet.InstMtrDir.Cnt_s08 QuadDet.MtrQuad.Cnt_u08 /end SUB_GROUP /begin FUNCTION_LIST /end FUNCTION_LIST /begin REF_CHARACTERISTIC /end REF_CHARACTERISTIC /begin REF_MEASUREMENT /end REF_MEASUREMENT /end GROUP
/begin GROUP RTE "MICROSAR RTE" /begin SUB_GROUP SWCs /end SUB_GROUP /begin FUNCTION_LIST /end FUNCTION_LIST /begin REF_CHARACTERISTIC /end REF_CHARACTERISTIC /begin REF_MEASUREMENT /end REF_MEASUREMENT /end GROUP
/begin GROUP Return "MICROSAR RTE" /begin SUB_GROUP Return.ReceiverPorts Return.SenderPorts /end SUB_GROUP /begin FUNCTION_LIST /end FUNCTION_LIST /begin REF_CHARACTERISTIC /end REF_CHARACTERISTIC /begin REF_MEASUREMENT /end REF_MEASUREMENT /end GROUP
/begin GROUP Return.AssistMechTempEst.DegC_f32 "MICROSAR RTE" /begin SUB_GROUP /end SUB_GROUP /begin FUNCTION_LIST /end FUNCTION_LIST /begin REF_CHARACTERISTIC /end REF_CHARACTERISTIC /end GROUP
/begin GROUP Return.DefeatReturnSvc.Cnt_lgc "MICROSAR RTE" /begin SUB_GROUP /end SUB_GROUP /begin FUNCTION_LIST /end FUNCTION_LIST /begin REF_CHARACTERISTIC /end REF_CHARACTERISTIC /end GROUP
/begin GROUP Return.DiagStsHwPosDis.Cnt_lgc "MICROSAR RTE" /begin SUB_GROUP /end SUB_GROUP /begin FUNCTION_LIST /end FUNCTION_LIST /begin REF_CHARACTERISTIC /end REF_CHARACTERISTIC /end GROUP
/begin GROUP Return.HandwheelAuthority.Uls_f32 "MICROSAR RTE" /begin SUB_GROUP /end SUB_GROUP /begin FUNCTION_LIST /end FUNCTION_LIST /begin REF_CHARACTERISTIC /end REF_CHARACTERISTIC /end GROUP
/begin GROUP Return.HandwheelPosition.HwDeg_f32 "MICROSAR RTE" /begin SUB_GROUP /end SUB_GROUP /begin FUNCTION_LIST /end FUNCTION_LIST /begin REF_CHARACTERISTIC /end REF_CHARACTERISTIC /end GROUP
/begin GROUP Return.HandwheelVel.HwRadpS_f32 "MICROSAR RTE" /begin SUB_GROUP /end SUB_GROUP /begin FUNCTION_LIST /end FUNCTION_LIST /begin REF_CHARACTERISTIC /end REF_CHARACTERISTIC /end GROUP
/begin GROUP Return.HwTorque.HwNm_f32 "MICROSAR RTE" /begin SUB_GROUP /end SUB_GROUP /begin FUNCTION_LIST /end FUNCTION_LIST /begin REF_CHARACTERISTIC /end REF_CHARACTERISTIC /end GROUP
/begin GROUP Return.PAReturnSclFct.Uls_f32 "MICROSAR RTE" /begin REF_MEASUREMENT Rte_PosServo_PosSrvoReturnSclFct_Uls_f32 /end REF_MEASUREMENT /end GROUP
/begin GROUP SrlComDriver.TMFTestComplete.Cnt_lgc "MICROSAR RTE" /begin REF_MEASUREMENT Rte_TmprlMon_TMFTestComplete_Cnt_lgc /end REF_MEASUREMENT /end GROUP
/begin GROUP SrlComDriver.TxEnabled.Cnt_lgc "MICROSAR RTE" /begin REF_MEASUREMENT Rte_SrlComDriver_TxEnabled_Cnt_lgc /end REF_MEASUREMENT /end GROUP
/begin GROUP SrlComInput.APAAuthn.Cnt_lgc "MICROSAR RTE" /begin REF_MEASUREMENT Rte_SrlComInput_APAAuthn_Cnt_lgc /end REF_MEASUREMENT /end GROUP
/begin GROUP SrlComInput.APARequest.Cnt_lgc "MICROSAR RTE" /begin REF_MEASUREMENT Rte_SrlComInput_APARequest_Cnt_lgc /end REF_MEASUREMENT /end GROUP
/begin GROUP SrlComInput.AbsActv.Cnt_lgc "MICROSAR RTE" /begin REF_MEASUREMENT Rte_SrlComInput_AbsActv_Cnt_lgc /end REF_MEASUREMENT /end GROUP
/begin GROUP SrlComInput.ApaRelaxReq.Cnt_lgc "MICROSAR RTE" /begin REF_MEASUREMENT Rte_SrlComInput_ApaRelaxReq_Cnt_lgc /end REF_MEASUREMENT /end GROUP
/begin GROUP SrlComInput.ApaVehicleSpeedValid.Cnt_lgc "MICROSAR RTE" /begin REF_MEASUREMENT Rte_SrlComInput_ApaVehicleSpeedValid_Cnt_lgc /end REF_MEASUREMENT /end GROUP
/begin GROUP SrlComInput.CPKOK.Cnt_lgc "MICROSAR RTE" /begin REF_MEASUREMENT Rte_SrlComInput_CPKOK_Cnt_lgc /end REF_MEASUREMENT /end GROUP
/begin GROUP SrlComInput.ColAngleSetpoint.HwDeg_f32 "MICROSAR RTE" /begin REF_MEASUREMENT Rte_SrlComInput_ColAngleSetpoint_HwDeg_f32 /end REF_MEASUREMENT /end GROUP
/begin GROUP SrlComInput.EscAckFromSerlCom.Cnt_lgc "MICROSAR RTE" /begin REF_MEASUREMENT Rte_SrlComInput_EscAckFromSerlCom_Cnt_lgc /end REF_MEASUREMENT /end GROUP
/begin GROUP SrlComInput.EscActv.Cnt_lgc "MICROSAR RTE" /begin REF_MEASUREMENT Rte_SrlComInput_EscActv_Cnt_lgc /end REF_MEASUREMENT /end GROUP
/begin GROUP SrlComInput.EscDataVldFromSerlCom.Cnt_lgc "MICROSAR RTE" /begin REF_MEASUREMENT Rte_SrlComInput_EscDataVldFromSerlCom_Cnt_lgc /end REF_MEASUREMENT /end GROUP
/begin GROUP SrlComInput.EscEna.Cnt_lgc "MICROSAR RTE" /begin REF_MEASUREMENT Rte_SrlComInput_EscEna_Cnt_lgc /end REF_MEASUREMENT /end GROUP
/begin GROUP SrlComInput.EscFltPrsnt.Cnt_lgc "MICROSAR RTE" /begin REF_MEASUREMENT Rte_SrlComInput_EscFltPrsnt_Cnt_lgc /end REF_MEASUREMENT /end GROUP
/begin GROUP SrlComInput.EscOffsFromSerlCom.HwDeg_f32 "MICROSAR RTE" /begin REF_MEASUREMENT Rte_SrlComInput_EscOffsFromSerlCom_HwDeg_f32 /end REF_MEASUREMENT /end GROUP
/begin GROUP SrlComInput.EscPrecisionFromSerlCom.HwDeg_f32 "MICROSAR RTE" /begin REF_MEASUREMENT Rte_SrlComInput_EscPrecisionFromSerlCom_HwDeg_f32 /end REF_MEASUREMENT /end GROUP
/begin GROUP SrlComInput.Kilometrage.Cnt_u32 "MICROSAR RTE" /begin REF_MEASUREMENT Rte_SrlComInput_Kilometrage_Cnt_u32 /end REF_MEASUREMENT /end GROUP
/begin GROUP SrlComInput.LxaInpVld.Cnt_lgc "MICROSAR RTE" /begin REF_MEASUREMENT Rte_SrlComInput_LxaInpVld_Cnt_lgc /end REF_MEASUREMENT /end GROUP
/begin GROUP SrlComInput.LxaSeln.Cnt_lgc "MICROSAR RTE" /begin REF_MEASUREMENT Rte_SrlComInput_LxaSeln_Cnt_lgc /end REF_MEASUREMENT /end GROUP
/begin GROUP SrlComInput.LxaStateFilt.Cnt_enum "MICROSAR RTE" /begin REF_MEASUREMENT Rte_SrlComInput_LxaStateFilt_Cnt_enum /end REF_MEASUREMENT /end GROUP
/begin GROUP SrlComInput.LxaTqFacReq.Uls_f32 "MICROSAR RTE" /begin REF_MEASUREMENT Rte_SrlComInput_LxaTqFacReq_Uls_f32 /end REF_MEASUREMENT /end GROUP
/begin GROUP SrlComInput.MultiModeVld.Cnt_lgc "MICROSAR RTE" /begin REF_MEASUREMENT Rte_SrlComInput_MultiModeVld_Cnt_lgc /end REF_MEASUREMENT /end GROUP
/begin GROUP SrlComInput.PosSrvoHwAngle.HwDeg_f32 "MICROSAR RTE" /begin REF_MEASUREMENT Rte_SrlComInput_PosSrvoHwAngle_HwDeg_f32 /end REF_MEASUREMENT /end GROUP
/begin GROUP SrlComInput.PowerSupplies.Cnt_u08 "MICROSAR RTE" /begin REF_MEASUREMENT Rte_SrlComInput_PowerSupplies_Cnt_u08 /end REF_MEASUREMENT /end GROUP
/begin GROUP SrlComInput.ReqModeDAFinal.Cnt_enum "MICROSAR RTE" /begin REF_MEASUREMENT Rte_SrlComInput_ReqModeDAFinal_Cnt_enum /end REF_MEASUREMENT /end GROUP
/begin GROUP SrlComInput.ShuntPosition.Cnt_u08 "MICROSAR RTE" /begin REF_MEASUREMENT Rte_SrlComInput_ShuntPosition_Cnt_u08 /end REF_MEASUREMENT /end GROUP
/begin GROUP SrlComOutput.APAState.Cnt_enum "MICROSAR RTE" /begin REF_MEASUREMENT Rte_PSASH_ApaState_Cnt_enum /end REF_MEASUREMENT /end GROUP
/begin GROUP SrlComOutput.APAStateTransitionCause.Cnt_enum "MICROSAR RTE" /begin REF_MEASUREMENT Rte_PSASH_ApaStateTransitionCause_Cnt_enum /end REF_MEASUREMENT /end GROUP
/begin GROUP SrlComOutput.AbsltHwPosn.HwDeg_f32 "MICROSAR RTE" /begin REF_MEASUREMENT Rte_PsaAgArbn_AbsltHwPosn_HwDeg_f32 /end REF_MEASUREMENT /end GROUP
/begin GROUP SrlComOutput.AbsltHwPosnLvl1.Cnt_lgc "MICROSAR RTE" /begin REF_MEASUREMENT Rte_PsaAgArbn_AbsltHwPosnLvl1_Cnt_lgc /end REF_MEASUREMENT /end GROUP
/begin GROUP SrlComOutput.AbsltHwPosnLvl2.Cnt_lgc "MICROSAR RTE" /begin REF_MEASUREMENT Rte_PsaAgArbn_AbsltHwPosnLvl2_Cnt_lgc /end REF_MEASUREMENT /end GROUP
/begin GROUP SrlComOutput.AbsltHwPosnVld.Cnt_lgc "MICROSAR RTE" /begin REF_MEASUREMENT Rte_PsaAgArbn_AbsltHwPosnVld_Cnt_lgc /end REF_MEASUREMENT /end GROUP
/begin GROUP SrlComOutput.AgArbnStToSerlCom.Cnt_enum "MICROSAR RTE" /begin REF_MEASUREMENT Rte_PsaAgArbn_AgArbnStToSerlCom_Cnt_enum /end REF_MEASUREMENT /end GROUP
/begin GROUP SrlComOutput.DrvrIntvDetd.Cnt_lgc "MICROSAR RTE" /begin REF_MEASUREMENT Rte_PSASH_DrvrIntvDetd_Cnt_lgc /end REF_MEASUREMENT /end GROUP
/begin GROUP SrlComOutput.EPSStateForLxa.Cnt_enum "MICROSAR RTE" /begin REF_MEASUREMENT Rte_PSASH_EPSStateForLxa_Cnt_enum /end REF_MEASUREMENT /end GROUP
/begin GROUP SrlComOutput.ETATDADYN.Cnt_enum "MICROSAR RTE" /begin REF_MEASUREMENT Rte_PSADMQ_TunModSt_Cnt_enum /end REF_MEASUREMENT /end GROUP
/begin GROUP SrlComOutput.LxaTqLimnActv.Cnt_lgc "MICROSAR RTE" /begin REF_MEASUREMENT Rte_PSATA_LxaTqLimnActv_Cnt_lgc /end REF_MEASUREMENT /end GROUP
/begin GROUP SrlComOutput.OutputRampMult.Uls_f32 "MICROSAR RTE" /begin REF_MEASUREMENT Rte_StOpCtrl_OutputRampMult_Uls_f32 /end REF_MEASUREMENT /end GROUP
/begin GROUP SrlComOutput.RelHwPosnToSerlCom.HwDeg_f32 "MICROSAR RTE" /begin REF_MEASUREMENT Rte_PsaAgArbn_RelHwPosnToSerlCom_HwDeg_f32 /end REF_MEASUREMENT /end GROUP
/begin GROUP SrlComOutput.RelHwPosnVldToSerlCom.Cnt_lgc "MICROSAR RTE" /begin REF_MEASUREMENT Rte_PsaAgArbn_RelHwPosnVldToSerlCom_Cnt_lgc /end REF_MEASUREMENT /end GROUP
/begin GROUP SrlComOutput.TxEnabled.Cnt_lgc "MICROSAR RTE" /begin REF_MEASUREMENT Rte_SrlComDriver_TxEnabled_Cnt_lgc /end REF_MEASUREMENT /end GROUP
/begin GROUP StOpCtrl.LoaRateLimit.UlspS_f32 "MICROSAR RTE" /begin REF_MEASUREMENT Rte_LoaMgr_LoaRateLimit_UlspS_f32 /end REF_MEASUREMENT /end GROUP
/begin GROUP StOpCtrl.LoaScaleFctr.Uls_f32 "MICROSAR RTE" /begin REF_MEASUREMENT Rte_LoaMgr_LoaScaleFctr_Uls_f32 /end REF_MEASUREMENT /end GROUP
/begin GROUP StOpCtrl.OutputRampMult.Uls_f32 "MICROSAR RTE" /begin REF_MEASUREMENT Rte_StOpCtrl_OutputRampMult_Uls_f32 /end REF_MEASUREMENT /end GROUP
/begin GROUP StaMd.TMFTestComplete.Cnt_lgc "MICROSAR RTE" /begin REF_MEASUREMENT Rte_TmprlMon_TMFTestComplete_Cnt_lgc /end REF_MEASUREMENT /end GROUP
/begin GROUP StaMd11.TMFTestComplete.Cnt_lgc "MICROSAR RTE" /begin REF_MEASUREMENT Rte_TmprlMon_TMFTestComplete_Cnt_lgc /end REF_MEASUREMENT /end GROUP
/begin GROUP Sweep.InputHwTrq.HwNm_f32 "MICROSAR RTE" /begin REF_MEASUREMENT Rte_HwTqArbn_HwTqVal_HwNm_f32 /end REF_MEASUREMENT /end GROUP
/begin GROUP ThrmlDutyCycle.FilteredPkCurr.AmpSq_f32 "MICROSAR RTE" /begin REF_MEASUREMENT Rte_PeakCurrEst_FiltEstPkCurr_AmpSq_f32 /end REF_MEASUREMENT /end GROUP
/begin GROUP ThrmlDutyCycle.MtrPkCurr.AmpSq_f32 "MICROSAR RTE" /begin REF_MEASUREMENT Rte_PeakCurrEst_EstPkCurr_AmpSq_f32 /end REF_MEASUREMENT /end GROUP
/begin GROUP ThrmlDutyCycle.ThermalLimit.MtrNm_f32 "MICROSAR RTE" /begin REF_MEASUREMENT Rte_ThrmlDutyCycle_ThermalLimit_MtrNm_f32 /end REF_MEASUREMENT /end GROUP
/begin GROUP TmprlMon.TMFTestComplete.Cnt_lgc "MICROSAR RTE" /begin REF_MEASUREMENT Rte_TmprlMon_TMFTestComplete_Cnt_lgc /end REF_MEASUREMENT /end GROUP
/begin GROUP TmprlMon.TMFTestStart.Cnt_lgc "MICROSAR RTE" /begin REF_MEASUREMENT Rte_HwPwUp_TMFTestStart_Cnt_lgc /end REF_MEASUREMENT /end GROUP
/begin GROUP TqRsDg.MtrCurrIdptSig.Cnt_u08 "MICROSAR RTE" /begin REF_MEASUREMENT Rte_TqRsDg_MtrCurrIdptSig_Cnt_u08 /end REF_MEASUREMENT /end GROUP
/begin GROUP TqRsDg.OutputRampMult.Uls_f32 "MICROSAR RTE" /begin REF_MEASUREMENT Rte_StOpCtrl_OutputRampMult_Uls_f32 /end REF_MEASUREMENT /end GROUP
/begin GROUP TranlDampg.LoaSt.State_enum "MICROSAR RTE" /begin REF_MEASUREMENT Rte_LoaMgr_LOASt_State_enum /end REF_MEASUREMENT /end GROUP
/begin GROUP TrqLOA.TrqLOAAvail.Cnt_lgc "MICROSAR RTE" /begin REF_MEASUREMENT Rte_TrqLOA_TrqLOAAvail_Cnt_lgc /end REF_MEASUREMENT /end GROUP
/begin GROUP TuningSelAuth.TunReqGranted.Cnt_lgc "MICROSAR RTE" /begin REF_MEASUREMENT Rte_TuningSelAuth_TunReqGranted_Cnt_lgc /end REF_MEASUREMENT /end GROUP
/begin GROUP VehPwrMd.OutputRampMult.Uls_f32 "MICROSAR RTE" /begin REF_MEASUREMENT Rte_StOpCtrl_OutputRampMult_Uls_f32 /end REF_MEASUREMENT /end GROUP
/begin GROUP VehSpdLmt.AstVehSpdLimit.MtrNm_f32 "MICROSAR RTE" /begin REF_MEASUREMENT Rte_VehSpdLmt_AstVehSpdLimit_MtrNm_f32 /end REF_MEASUREMENT /end GROUP
/begin RECORD_LAYOUT RTE_RL_SBYTE FNC_VALUES 1 SBYTE ROW_DIR DIRECT /end RECORD_LAYOUT
/begin RECORD_LAYOUT RTE_RL_SWORD FNC_VALUES 1 SWORD ROW_DIR DIRECT /end RECORD_LAYOUT
/begin RECORD_LAYOUT RTE_RL_SLONG FNC_VALUES 1 SLONG ROW_DIR DIRECT /end RECORD_LAYOUT
/**********************************************************************************************************************
* COMPU_METHOD / COMPU_VTAB_RANGE
*********************************************************************************************************************/
/begin COMPU_METHOD RTE_CM_BOOLEAN "" TAB_VERB "%3.1" "" COMPU_TAB_REF RTE_CM_BOOLEAN /end COMPU_METHOD
/begin COMPU_VTAB_RANGE RTE_CM_BOOLEAN "" 2 0 0 "false" 1 255 "true" /end COMPU_VTAB_RANGE
/begin COMPU_METHOD RTE_CM_ENUM_SigQlfr_State_enum "" TAB_VERB "%.1" "" COMPU_TAB_REF RTE_CM_ENUM_SigQlfr_State_enum /end COMPU_METHOD
/begin COMPU_VTAB_RANGE RTE_CM_ENUM_SigQlfr_State_enum "" 3 0 0 "SIGQLFR_NORES" 1 1 "SIGQLFR_PASS" 2 2 "SIGQLFR_FAIL" /end COMPU_VTAB_RANGE
/begin COMPU_METHOD RTE_CM_ENUM_LOA_State_enum "" TAB_VERB "%.1" "" COMPU_TAB_REF RTE_CM_ENUM_LOA_State_enum /end COMPU_METHOD
/begin COMPU_VTAB_RANGE RTE_CM_ENUM_LOA_State_enum "" 6 0 0 "LOAST_NORM" 1 1 "LOAST_REDCD" 2 2 "LOAST_SWBASDMTGTN" 3 3 "LOAST_FADEOUT" 4 4 "LOAST_CTRLDSHTDWNREQD" 5 5 "LOAST_RPDSHTDWNREQD" /end COMPU_VTAB_RANGE
/begin COMPU_METHOD RTE_CM_ENUM_SteerMod_enum "" TAB_VERB "%.1" "" COMPU_TAB_REF RTE_CM_ENUM_SteerMod_enum /end COMPU_METHOD
/begin COMPU_VTAB_RANGE RTE_CM_ENUM_SteerMod_enum "" 3 0 0 "STEERMOD_BASEPS" 1 1 "STEERMOD_SEMIATNMS" 2 2 "STEERMOD_FULLYATNMS" /end COMPU_VTAB_RANGE
/begin COMPU_METHOD RTE_CM_ENUM_FETPHASETYPE_ENUM "" TAB_VERB "%.1" "" COMPU_TAB_REF RTE_CM_ENUM_FETPHASETYPE_ENUM /end COMPU_METHOD
/begin COMPU_VTAB_RANGE RTE_CM_ENUM_FETPHASETYPE_ENUM "" 4 0 0 "NOPHASE" 1 1 "PHASEA" 2 2 "PHASEB" 3 3 "PHASEC" /end COMPU_VTAB_RANGE
/begin COMPU_METHOD RTE_CM_ENUM_FETFAULTTYPE_ENUM "" TAB_VERB "%.1" "" COMPU_TAB_REF RTE_CM_ENUM_FETFAULTTYPE_ENUM /end COMPU_METHOD
/begin COMPU_VTAB_RANGE RTE_CM_ENUM_FETFAULTTYPE_ENUM "" 3 0 0 "NOFAULT" 1 1 "LOWER" 2 2 "UPPER" /end COMPU_VTAB_RANGE
/begin COMPU_METHOD RTE_CM_ENUM_PsaTunModSt_Cnt_enum "" TAB_VERB "%.1" "" COMPU_TAB_REF RTE_CM_ENUM_PsaTunModSt_Cnt_enum /end COMPU_METHOD
/begin COMPU_VTAB_RANGE RTE_CM_ENUM_PsaTunModSt_Cnt_enum "" 4 0 0 "PSATUNMODST_NORM" 1 1 "PSATUNMODST_SPORT" 2 2 "PSATUNMODST_TUN" 3 3 "PSATUNMODST_FAILD" /end COMPU_VTAB_RANGE
/begin COMPU_METHOD RTE_CM_ENUM_PsaApaSt_Cnt_enum "" TAB_VERB "%.1" "" COMPU_TAB_REF RTE_CM_ENUM_PsaApaSt_Cnt_enum /end COMPU_METHOD
/begin COMPU_VTAB_RANGE RTE_CM_ENUM_PsaApaSt_Cnt_enum "" 4 0 0 "PSAAPAST_UNAVL" 1 1 "PSAAPAST_AVL" 2 2 "PSAAPAST_CTRLPRGS" 3 3 "PSAAPAST_DFCT" /end COMPU_VTAB_RANGE
/begin COMPU_METHOD RTE_CM_ENUM_PsaApaTranCause_Cnt_enum "" TAB_VERB "%.1" "" COMPU_TAB_REF RTE_CM_ENUM_PsaApaTranCause_Cnt_enum /end COMPU_METHOD
/begin COMPU_VTAB_RANGE RTE_CM_ENUM_PsaApaTranCause_Cnt_enum "" 8 0 0 "PSAAPATRANCAUSE_NOINTRPT" 1 1 "PSAAPATRANCAUSE_DRVRINTV" 2 2 "PSAAPATRANCAUSE_VEHSPDHI" 3 3 "PSAAPATRANCAUSE_AGLERR" 4 4 "PSAAPATRANCAUSE_MTRSTALL" 5 5 "PSAAPATRANCAUSE_UNUSED" 6 6 "PSAAPATRANCAUSE_THERMLIM" 7 7 "PSAAPATRANCAUSE_OTHERERR" /end COMPU_VTAB_RANGE
/begin COMPU_METHOD RTE_CM_ENUM_PsaEpsStLxa_Cnt_enum "" TAB_VERB "%.1" "" COMPU_TAB_REF RTE_CM_ENUM_PsaEpsStLxa_Cnt_enum /end COMPU_METHOD
/begin COMPU_VTAB_RANGE RTE_CM_ENUM_PsaEpsStLxa_Cnt_enum "" 5 0 0 "PSAEPSSTLXA_UNAUTHD" 1 1 "PSAEPSSTLXA_AUTHD" 2 2 "PSAEPSSTLXA_AVL" 3 3 "PSAEPSSTLXA_ACTV" 4 4 "PSAEPSSTLXA_DFCT" /end COMPU_VTAB_RANGE
/begin COMPU_METHOD RTE_CM_ENUM_PsaLxaSt_Cnt_enum "" TAB_VERB "%.1" "" COMPU_TAB_REF RTE_CM_ENUM_PsaLxaSt_Cnt_enum /end COMPU_METHOD
/begin COMPU_VTAB_RANGE RTE_CM_ENUM_PsaLxaSt_Cnt_enum "" 7 0 0 "PSALXAST_UNAVL" 1 1 "PSALXAST_UNSELD" 2 2 "PSALXAST_SELD" 3 3 "PSALXAST_AUTHD" 4 4 "PSALXAST_ACTV" 5 5 "PSALXAST_DFCT" 6 6 "PSALXAST_COLLRISK" /end COMPU_VTAB_RANGE
/begin COMPU_METHOD RTE_CM_ENUM_PsaAgArbnSt_Enum "" TAB_VERB "%.1" "" COMPU_TAB_REF RTE_CM_ENUM_PsaAgArbnSt_Enum /end COMPU_METHOD
/begin COMPU_VTAB_RANGE RTE_CM_ENUM_PsaAgArbnSt_Enum "" 8 0 0 "PSAAGARBNST_STININ" 1 1 "PSAAGARBNST_STPND" 2 2 "PSAAGARBNST_STNOSYNCN" 3 3 "PSAAGARBNST_STESCSYNCN" 4 4 "PSAAGARBNST_STDIAGSYNCN" 5 5 "PSAAGARBNST_STALTVSYNCN" 6 6 "PSAAGARBNST_UNUSED" 7 7 "PSAAGARBNST_STFAIL" /end COMPU_VTAB_RANGE
