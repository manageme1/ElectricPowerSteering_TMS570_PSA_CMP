AUTOSAR XML (schema 3.0.1)
# Copyright (c) 2009 by Vector Informatik GmbH. All rights reserved.
# This software is copyright protected and proprietary to Vector Informatik GmbH.
# Vector Informatik GmbH grants to you only those rights as set out in the license conditions.
package /MICROSAR
  module config Board_Rec: definition=Board
    InterruptFunctionality
      4 x InterruptFunctionSet:
        SuspendAllInterrupts: BoardGlobalSuspend=SuspendAllInterrupts(), BoardGlobalRestore=ResumeAllInterrupts(), BoardIncludeFile=Os.h
        SuspendOSInterrupts: BoardGlobalSuspend=SuspendOSInterrupts(), BoardGlobalRestore=ResumeOSInterrupts(), BoardIncludeFile=Os.h
        DisableAllInterrupts: BoardGlobalSuspend=DisableAllInterrupts(), BoardGlobalRestore=EnableAllInterrupts(), BoardIncludeFile=Os.h
        NoCriticalSectionHandling: BoardGlobalSuspend=(unset), BoardGlobalRestore=(unset), BoardIncludeFile=(unset)
  module config Board_Pre: definition=Board
    BoardGeneral: BoardEnableSnvPrefixes=false, BoardSizeOfPduIdType=Two_Byte
