AUTOSAR XML (schema 3.0.1)
package /MICROSAR/TMS570LS3x
  bsw implementation Os_Impl: code-generator=cMICROSAR, programming-language=C, sw-major-version=5, sw-minor-version=7, sw-patch-version=0, vendor-id=30, ar-major-version=3, ar-minor-version=1, ar-patch-version=0, preconfigured-configuration=Os_Pre, recommended-configuration=Os_Rec, vendor-specific-module-def=Os
  module definition Os [0..1]: refined-module-def=Os, variants pre-compile  # Configuration of the Os (Operating System) module.
    container OsAlarm [0..32767]  # An OsAlarm may be used to asynchronously inform or activate a specific task. It is possible to start alarms automatically at system start-up depending on the application mode.
      reference OsAlarmAccessingApplication [0..*]: set at pre-compile, destination=OsApplication  # Reference to applications which have an access to this object.
      reference OsAlarmCounterRef: set at pre-compile, destination=OsCounter  # Reference to the assigned counter for that alarm
      choice container OsAlarmAction  # This container defines which type of notification is used when the alarm expires.
        container OsAlarmActivateTask [0..1]  # This container specifies the parameters to activate a task.
          reference OsAlarmActivateTaskRef: set at pre-compile, destination=OsTask  # Reference to the task that will be activated by that alarm action
        container OsAlarmCallback [0..1]  # This container specifies the parameters to call a callback OS alarm action.
          function name OsAlarmCallbackName: set at pre-compile  # Name of the function that is called when this alarm callback is triggered.
        container OsAlarmIncrementCounter [0..1]  # This container specifies the parameters to increment a counter.
          reference OsAlarmIncrementCounterRef: set at pre-compile, destination=OsCounter  # Reference to the counter that will be incremented by that alarm action
        container OsAlarmSetEvent [0..1]  # This container specifies the parameters to set an event
          reference OsAlarmSetEventRef: set at pre-compile, destination=OsEvent  # Reference to the event that will be set by that alarm action
          reference OsAlarmSetEventTaskRef: set at pre-compile, destination=OsTask  # Reference to the task that will be activated by that event
      container OsAlarmAutostart [0..1]  # If present this container defines if an alarm is started automatically at system start-up depending on the application mode.
        integer OsAlarmAlarmTime: set at pre-compile  # The relative or absolute tick value when the alarm expires for the first time. Note that for an alarm which is RELATIVE the value must be at bigger than 0.
        enumeration OsAlarmAutostartType: {ABSOLUTE, RELATIVE}, set at pre-compile  # This specifies the type of autostart for the alarm..
        integer OsAlarmCycleTime: set at pre-compile  # Cycle time of a cyclic alarm in ticks. If the value is 0 than the alarm is not cyclic.
        boolean OsAlarmStaticAlarm: set at pre-compile, origin=Vector Informatik, default-value=false  # If the alarm times do not change during runtime the ALARMTIME and CYCLETIME can be set statically. This results in less RAM consumption. This settingis relevant for autostart alarms only.
        enumeration OsAlarmAlarmUnit: {MSEC, SEC, Ticks, USEC}, set at pre-compile, origin=Vector Informatik, default-value=Ticks  # unit for AlarmTime and CycleTime
        reference OsAlarmAppModeRef [1..*]: set at pre-compile, destination=OsAppMode  # Reference to the application modes for which the AUTOSTART shall be performed
      container OsAlarmStaticAlarm [0..1]  # If the alarm times do not change during runtime the AlarmTime and CycleTime can be set statically. This results in less RAM consumption. This setting is relevant for non autostart alarms only.
        integer OsAlarmAlarmTime: 0..4294967295, set at pre-compile, origin=Vector Informatik  # AlarmTime in units specified by the attribute AlarmUnit.
        integer OsAlarmCycleTime: 0..4294967295, set at pre-compile, origin=Vector Informatik  # CycleTime in units specified by the attribute AlarmUnit.
        enumeration OsAlarmAlarmUnit: {MSEC, SEC, Ticks, USEC}, set at pre-compile, origin=Vector Informatik, default-value=MSEC  # unit for AlarmTime and CycleTime
    container OsAppMode [1..*]  # OsAppMode is the object used to define OSEK OS properties for an OSEK OS application mode. No standard attributes are defined for AppMode. In a CPU, at least one AppMode object has to be defined. [source: OSEK OIL Spec. 2.5] An OsAppMode called OSDEFAULTAPPMODE must always be there for OSEK compatilbility.
      integer OsAppModeId: set at pre-compile, symbolic-name-value=true  # Internal ID of an AppMode. Necessary, so that an AppMode is addressable by other modules.
    container OsApplication [0..32]  # An AUTOSAR OS must be capable of supporting a collection of OS objects (tasks, interrupts, alarms, hooks etc.) that form a cohesive functional unit. This collection of objects is termed an OS-Application. All objects which belong to the same OS-Application have access to each other. Access means to allow to use these objects within API services. Access by other applications can be granted separately.
      boolean OsTrusted: set at pre-compile, default-value=false  # Parameter to specify if an OS-Application is trusted or not. true: OS-Application is trusted false: OS-Application is not trusted (default)
      boolean OsAppGenerateStub: set at pre-compile, origin=Vector Informatik, default-value=false  # If set to TRUE, stub functions are generated for all trusted functions of this application.
      integer OsApplicationProtectionRegionSizeNoInitData: 0..4294967295, set at pre-compile, origin=Vector Informatik, default-value=0  # Size of memory protection region for application specific, uninitialized data. All data must fit into this region. Unused in SC1/SC2.
      integer OsApplicationProtectionRegionSizeInitData: 0..4294967295, set at pre-compile, origin=Vector Informatik, default-value=0  # Size of memory protection region for application specific, initialized data. All data must fit into this region. Unused in SC1/SC2.
      integer OsApplicationMPUArea4Size: 0..4294967295, set at pre-compile, origin=Vector Informatik, default-value=0  # Size of memory protection area 4. If set to 0, the area is unused.
      integer OsApplicationMPUArea4Access: 0..4294967295, set at pre-compile, origin=Vector Informatik, default-value=0  # Setting of MPU Region Access Control Register for protection area 4.
      integer OsApplicationMPUArea6Size: 0..4294967295, set at pre-compile, origin=Vector Informatik, default-value=0  # Size of memory protection area 6. If set to 0, the area is unused.
      integer OsApplicationMPUArea6Access: 0..4294967295, set at pre-compile, origin=Vector Informatik, default-value=0  # Setting of MPU Region Access Control Register for protection area 6.
      integer OsApplicationMPUArea8Size: 0..4294967295, set at pre-compile, origin=Vector Informatik, default-value=0  # Size of memory protection area 8. If set to 0, the area is unused.
      integer OsApplicationMPUArea8Access: 0..4294967295, set at pre-compile, origin=Vector Informatik, default-value=0  # Setting of MPU Region Access Control Register for protection area 8.
      integer OsApplicationMPUArea9Size: 0..4294967295, set at pre-compile, origin=Vector Informatik, default-value=0  # Size of memory protection area 9 (with read/write access for this application). If set to 0, the area is unused.
      integer OsApplicationMPUArea9Access: 0..4294967295, set at pre-compile, origin=Vector Informatik, default-value=0  # Setting of MPU Region Access Control Register for protection area 9.
      integer OsApplicationMPUArea10Size: 0..4294967295, set at pre-compile, origin=Vector Informatik, default-value=0  # Size of memory protection area 10 (with read/write access for this application). If set to 0, the area is unused.
      integer OsApplicationMPUArea10Access: 0..4294967295, set at pre-compile, origin=Vector Informatik, default-value=0  # Setting of MPU Region Access Control Register for protection area 10.
      integer OsApplicationMPUArea11Size: 0..4294967295, set at pre-compile, origin=Vector Informatik, default-value=0  # Size of memory protection area 11 (with read/write access for this application). If set to 0, the area is unused.
      integer OsApplicationMPUArea11Access: 0..4294967295, set at pre-compile, origin=Vector Informatik, default-value=0  # Setting of MPU Region Access Control Register for protection area 11.
      string OsApplicationNonTrusted_Function [0..*]: set at pre-compile, origin=Vector Informatik  # List of non-trusted functions provided by this application (only for non trusted applications).
      string OsApplicationMPUArea4Start: set at pre-compile, origin=Vector Informatik, default-value=0  # Start address of memory protection area 4
      string OsApplicationMPUArea6Start: set at pre-compile, origin=Vector Informatik, default-value=0  # Start address of memory protection area 6
      string OsApplicationMPUArea{8..11}Start: set at pre-compile, origin=Vector Informatik, default-value=0  # Start address of memory protection area {8..11}
      reference OsAppAlarmRef [0..*]: set at pre-compile, destination=OsAlarm  # Specifies the OsAlarms that belong to the OsApplication.
      reference OsAppCounterRef [0..*]: set at pre-compile, destination=OsCounter  # References the OsCounters that belong to the OsApplication.
      reference OsAppIsrRef [0..*]: set at pre-compile, destination=OsIsr  # references which OsIsrs belong to the OsApplication
      reference OsAppResourceRef [0..*]: set at pre-compile, destination=OsResource  # References the OsResources that belong to the OsApplication.
      reference OsAppScheduleTableRef [0..*]: set at pre-compile, destination=OsScheduleTable  # References the OsScheduleTables that belong to the OsApplication.
      reference OsAppTaskRef [0..*]: set at pre-compile, destination=OsTask  # references which OsTasks belong to the OsApplication
      reference OsRestartTask [0..1]: set at pre-compile, destination=OsTask  # Optionally one task of an OS-Application may be defined as Restart Task. Multiplicity = 1: Restart Task is activated by the Operating System if the protection hook requests it. Multiplicity = 0: No task is automatically started after a protection error happened.
      reference OsApplicationMESSAGE [0..*]: set at pre-compile, origin=Vector Informatik, destination=OsMessage  # References to all messages belonging to this application.
      container OsApplicationHooks  # Container to structure the OS-Application-specific hooks
        boolean OsAppErrorHook: set at pre-compile  # Select the OS-Application error hook. true: Hook is called false: Hook is not called
        boolean OsAppShutdownHook: set at pre-compile  # Select the OS-Application specific shutdown hook for the OS-Application. true: Hook is called false: Hook is not called
        boolean OsAppStartupHook: set at pre-compile  # Select the OS-Application specific startup hook for the OS-Application. true: Hook is called false: Hook is not called
      container OsApplicationTrustedFunction [0..*]  # Container to structure the configration parameters of trusted functions
        function name OsTrustedFunctionName: set at pre-compile  # Trusted function (as part of a trusted OS-Application) available to other OS-Applications. This also supersedes the OSEK OIL attribute TRUSTED in APPLICATION because the optionality of this parameter is describing that already.
        string OsApplicationParams: set at pre-compile, origin=Vector Informatik  # Parameter (arguments) of trusted function. Empty string means void. Used for stub generation only.
        string OsApplicationReturnType: set at pre-compile, origin=Vector Informatik  # Return value data type of trusted function. Empty string means void. Used for stub generation only.
    container OsCounter [0..256]  # Configuration information for the counters that belong to the OsApplication.
      integer OsCounterMaxAllowedValue: set at pre-compile  # Maximum possible allowed value of the system counter in ticks.
      integer OsCounterMinCycle: set at pre-compile  # The MINCYCLE attribute specifies the minimum allowed number of counter ticks for a cyclic alarm linked to the counter.
      integer OsCounterTicksPerBase: set at pre-compile  # The TICKSPERBASE attribute specifies the number of ticks required to reach a counterspecific unit. The interpretation is implementation-specific.
      enumeration OsCounterType: {HARDWARE, SOFTWARE}, default-value=SOFTWARE  # This parameter contains the natural type or unit of the counter.
      float OsSecondsPerTick [0..1]: set at pre-compile  # Time of one hardware tick in seconds.
      reference OsCounterAccessingApplication [0..*]: set at pre-compile, destination=OsApplication  # Reference to applications which have an access to this object.
      container OsDriver [0..1]  # This Container contains the information who will drive the counter. This configuration is only valid if the counter has OsCounterType set to HARDWARE. If the container does not exist (multiplicity=0) the timer is managed by the OS internally (OSINTERNAL). If the container exists the OS can use the GPT interface to manage the timer. The user have to supply the GPT channel. If the counter is driven by some other (external to the OS) source (like a TPU for example) this must be described as a vendor specific extension.
        reference OsGptChannelRef [0..1]: set at pre-compile, destination=GptChannelConfiguration  # Reference to the GPT channel.
      container OsTimeConstant [0..*]  # Allows the user to define constants which can be e.g. used to compare time values with timer tick values. A time value will be converted to a timer tick value during generation and can later on accessed via the OsConstName. The conversation is done by rounding time values to the nearest fitting tick value.
        string OsConstName: set at pre-compile  # The name which is accessed by the application to get the above OsTimeValue.
        float OsTimeValue: set at pre-compile  # This parameter contains the value of the constant in seconds.
    container OsEvent [0..*]  # Representation of OS events in the configuration context. Adopted from the OSEK OIL specification.
      integer OsEventMask [0..1]: 1..2147483648, set at pre-compile  # If event mask would be set to AUTO in OIL, this parameter should be omitted here.
    container OsIsr [0..*]  # The OsIsr container represents an OSEK interrupt service routine.
      enumeration OsIsrCategory: {CATEGORY_1, CATEGORY_2}, set at pre-compile  # This attribute specifies the category of this ISR.
      boolean OsIsrEnableNesting: set at pre-compile, origin=Vector Informatik, default-value=false  # If selected, osCAN enables interrupts before entering the ISR, so ISRs with higher priority can interrupt. If set to FALSE, osCAN does not enable interrupts at the start of the ISR, so no nesting will occur.
      integer OsIsrAnalysisPriority: 0..9223372036854775807, set at pre-compile, origin=Vector Informatik, default-value=0  # The AnalysisPriority corresponds to the Task attribute PRIORITY. The AnalysisPriority is an extension of the priority values from tasks to ISRs, so all ISR priorities must have higher values as all task priorities to get correct analysis results. (Some OS Implementations use an attribute similar to 'priority' for the hardware interrupt level. Therefore to the timing analysis an own attribute was introduced). This attribute is needed for DMA timing analysis performed by the osCAN TimingAnalyzer.
      integer OsIsrComputationTime: 0..9223372036854775807, set at pre-compile, origin=Vector Informatik, default-value=0  # The worst-case computation time. This attribute is needed for DMA timing analysis performed by the osCAN TimingAnalyzer.
      integer OsIsrPeriod: 0..9223372036854775807, set at pre-compile, origin=Vector Informatik, default-value=0  # The minimum activation period or the minimum interarrival time of the ISR. This attribute is needed for DMA timing analysis performed by the osCAN TimingAnalyzer.
      integer OsIsrDeadline: 0..9223372036854775807, set at pre-compile, origin=Vector Informatik, default-value=0  # The deadline of the ISR. This attribute is needed for DMA timing analysis performed by the osCAN TimingAnalyzer.
      integer OsIsrProtectionRegionSizeNoInitData: 0..4294967295, set at pre-compile, origin=Vector Informatik, default-value=0  # Size of memory protection region for ISR specific, uninitialized data. All data must fit into this region. Unused in SC1/SC2.
      integer OsIsrProtectionRegionSizeInitData: 0..4294967295, set at pre-compile, origin=Vector Informatik, default-value=0  # Size of memory protection region for ISR specific, initialized data. All data must fit into this region. Unused in SC1/SC2.
      integer OsIsrNonTrustFctStackSize: 0..4294967295, set at pre-compile, origin=Vector Informatik, default-value=0  # Size of stack for non-trusted function calls.
      enumeration OsIsrInterruptTarget: {FIQ, IRQ}, set at pre-compile, origin=Vector Informatik, default-value=IRQ  # Interrupt target (IRQ or FIQ)
      enumeration OsIsrInterruptSource: {INTR0, INTR1, INTR10, INTR11, INTR12, INTR13, INTR14, INTR15, INTR16, INTR17, INTR18, INTR19, INTR2, INTR20, INTR21, INTR22, INTR23, INTR24, INTR25, INTR26, INTR27, INTR28, INTR29, INTR3, INTR30, INTR31, INTR32, INTR33, INTR34, INTR35, INTR36, INTR37, INTR38, INTR39, INTR4, INTR40, INTR41, INTR42, INTR43, INTR44, INTR45, INTR46, INTR47, INTR48, INTR49, INTR5, INTR50, INTR51, INTR52, INTR53, INTR54, INTR55, INTR56, INTR57, INTR58, INTR59, INTR6, INTR60, INTR61, INTR62, INTR63, INTR64, INTR65, INTR66, INTR67, INTR68, INTR69, INTR7, INTR70, INTR71, INTR72, INTR73, INTR74, INTR75, INTR76, INTR77, INTR78, INTR79, INTR8, INTR80, INTR81, INTR82, INTR83, INTR84, INTR85, INTR86, INTR87, INTR88, INTR89, INTR9, INTR90, INTR91, INTR92, INTR93, INTR94, INTR95}, set at pre-compile, origin=Vector Informatik  # Interrupt source. The interrupt vector table is generated by the operating system automatically. All interrupts used in a software system have to be entered in the OIL-configurator.
      reference OsIsrResourceRef [0..*]: set at pre-compile, destination=OsResource  # This reference defines the resources accessed by this ISR.
      reference OsIsrAccessingApplication [0..*]: set at pre-compile, origin=Vector Informatik, destination=OsApplication  # Reference to applications which have an access to this object.
      reference OsIsrMESSAGE [0..*]: set at pre-compile, origin=Vector Informatik, destination=OsMessage  # Defines a MESSAGE to be accessed by the ISR
      container OsIsrUseResourceOccupation [0..*]  # This attribute is needed for DMA timing analysis performed by the osCAN TimingAnalyzer.
        integer OsIsrOccupationTime: set at pre-compile, origin=Vector Informatik  # Maximum duration of Resource usage in the ISR
        reference OsIsrResource: set at pre-compile, origin=Vector Informatik, destination=OsResource  # Reference to a Resource
      container OsIsrTimingProtection [0..1]  # This container contains all parameters which are related to timing protection If the container exists, the timing protection is used for this interrupt. If the container does not exist, the interrupt is not supervised regarding timing violations.
        float OsIsrAllInterruptLockBudget: set at pre-compile  # This parameter contains the maximum time for which the ISR is allowed to lock all interrupts (via SuspendAllInterrupts() or DisableAllInterrupts()) (in seconds).
        float OsIsrExecutionBudget: set at pre-compile  # The parameter contains the maximum allowed execution time of the interrupt (in seconds).
        float OsIsrOsInterruptLockBudget: set at pre-compile  # This parameter contains the maximum time for which the ISR is allowed to lock all Category 2 interrupts (via SuspendOSInterrupts()) (in seconds).
        float OsIsrTimeFrame: set at pre-compile  # This parameter contains the minimum inter-arrival time between successive interrupts (in seconds).
        boolean OsIsrOnlyMeasure: set at pre-compile, origin=Vector Informatik, default-value=false  # If selected, the execution time and the locking times are measured, but no timing protection faults are detected. This might be helpful to find suitable maximum values.
        container OsIsrResourceLock [0..*]  # This parameter contains a list of times the interrupt uses resources.
          float OsIsrResourceLockBudget: set at pre-compile  # This parameter contains the maximum time the interrupt is allowed to hold the given resource (in seconds).
          reference OsIsrResourceLockResourceRef: set at pre-compile, destination=OsResource  # Reference to the resource the locking time is depending on
      choice container OsIsrInterruptPriority  # Interrupt priority. VIM priority for this interrupt. If AUTO is selected, the default hardware priority of the selected source is used.
        container AUTO [0..1]  # A value will be choosen automatically during OS generation.
        container NON_AUTO [0..1]  # Interrupt priority. VIM priority for this interrupt. If AUTO is selected, the default hardware priority of the selected source is used.
          integer OsIsrInterruptPriority: 0..95, set at pre-compile, origin=Vector Informatik  # Interrupt priority. VIM priority for this interrupt. If AUTO is selected, the default hardware priority of the selected source is used.
      choice container OsIsrUseSpecialFunctionName  # If set to FALSE, the attribute <name> is used as function name for ISR handler (default). If set to TRUE, a different function name can be assigned (necessary for multiple interrupt sources with shared interrupt handler function).
        container TRUE [0..1]  # If set to FALSE, the attribute <name> is used as function name for ISR handler (default). If set to TRUE, a different function name can be assigned (necessary for multiple interrupt sources with shared interrupt handler function).
          string OsIsrFunctionName: set at pre-compile, origin=Vector Informatik  # Name of interrupt handler function
        container FALSE [0..1]  # If set to FALSE, the attribute <name> is used as function name for ISR handler (default). If set to TRUE, a different function name can be assigned (necessary for multiple interrupt sources with shared interrupt handler function).
    container OsOS  # OS is the object used to define OSEK OS properties for an OSEK application. Per CPU exactly one OS object has to be defined.
      enumeration OsScalabilityClass [0..1]: {SC1, SC2, SC3, SC4}, set at pre-compile  # A scalability class for each System Object "OS" has to be selected. In order to customize the operating system to the needs of the user and to take full advantage of the processor features the operating system can be scaled according to the scalability classes. If the scalability class is omitted this translates to the OIL AUTO mechanism.
      boolean OsStackMonitoring: set at pre-compile  # Select stack monitoring of Tasks/Category 2 ISRs true: Stacks are monitored false: Stacks are not monitored
      enumeration OsOSStackUsageMeasurement: {TRUE, FALSE, AUTO}, origin=Vector Informatik, default-value=AUTO  # If selected, the API function osGetStackUsage is provided to measure stack usage. Shall only be used together with stack check/monitoring. If AUTO is selected, the value of stack check is used.
      enumeration OsStatus: {EXTENDED, STANDARD}, default-value=EXTENDED  # The Status attribute specifies whether a system with standard or extended status has to be used. Automatic assigment is not supported for this attribute.
      boolean OsUseGetServiceId: set at pre-compile  # If selected, the usage of the access macros to the service ID information in the error hook is enabled.
      boolean OsUseParameterAccess: set at pre-compile  # If selected, the usage of the access macros to the context related information in the error hook is enabled.
      boolean OsUseResScheduler: set at pre-compile, default-value=true  # The OsUseResScheduler attribute defines whether the resource RES_SCHEDULER is used within the application.
      boolean OsOSUseGeneratedFastAlarm: set at pre-compile, origin=Vector Informatik, default-value=false  # Controls the OS-internal handling of alarms on the counter SystemTimer. If UseGeneratedFastAlarm is selected, code is generated for each alarm. If UseGeneratedFastAlarm is set to FALSE, alarms are handled with sorted data structures. Enabling generated alarms leads to a better performance if only few alarms are used. Please note, that this attribute has to be set to TRUE if additional (user defined) counters are configured.
      boolean OsOSThumbMode: set at pre-compile, origin=Vector Informatik  # Support for 16/32 bit mixed ARM/THUMB mode. Note: If set to FALSE, use no 16 bit THUMB code!
      boolean OsOSFPUSupport: set at pre-compile, origin=Vector Informatik, default-value=true  # Support of FPU code. Must be set to TRUE if tasks or ISRs use the FPU.
      boolean OsOSORTIDebugSupport: set at pre-compile, origin=Vector Informatik, default-value=false  # This implementation supports ORTI debug information (ORTI-file) if this attribute is selected.
      boolean OsOSTypeHeaderInclude: set at pre-compile, origin=Vector Informatik, default-value=true  # If selected, the Autosar header files are included into header files of the operating system. The autosar header files provide types like uint8 ... sint32. The operating system never uses this types, so it is save to deselect this attribute.
      float OsOSCpuFrequency: set at pre-compile, origin=Vector Informatik  # CpuFrequency in MHz. Example: 32.000
      integer OsOSAbortStackSize: 0..65535, set at pre-compile, origin=Vector Informatik, default-value=200  # Abort stack size in bytes.
      integer OsOSAPIStackSize: 0..65535, set at pre-compile, origin=Vector Informatik, default-value=512  # API stack size in bytes.
      integer OsOSTimerClockDivider: 2..4294967295, set at pre-compile, origin=Vector Informatik  # Rate of RTICLK ticks to Counter increments. The prescaler value equals one plus the desired CPUC register value. If the used HW Counter is not used for further purposes, 2 should be used for optimal accuracy.
      integer OsOSTickTime: 1..4294967295, set at pre-compile, origin=Vector Informatik, default-value=1000  # Duration of ticks of the SystemTimer in us. The OS configures the cycletime of the timer interrupt accordingly.
      integer OsOSSupervisorStackSize: 0..65535, set at pre-compile, origin=Vector Informatik  # Supervisor stack size in bytes. This stack is used for running the dispatcher and in SC3/SC4 for parts of the API functions. If the application uses software interrupts (SWI), the SWI handler is also running on this stack.
      integer OsOSIRQMaxNesting: 0..255, set at pre-compile, origin=Vector Informatik  # Maximum nesting depth for IRQ interrupts. Note: System timer interrupt is enabling nested interrupts.Therefore IRQMaxNesting must be set at least to 2 if any other IRQ interrupt is used by the application
      integer OsOSIRQStackOffset: 0..4294967295, set at pre-compile, origin=Vector Informatik, default-value=0  # IRQ stack offset. Size of IRQ stack is extended by this value (bytes). Use this attribute to add stack for category 1 interrupts.
      integer OsOSUserConfigurationVersion: 0..65535, set at pre-compile, origin=Vector Informatik, default-value=0  # Version number for this configuration assigned by user.
      enumeration OsOSSystemTimer: {COMP0_on_Counter0, COMP0_on_Counter1, COMP1_on_Counter0, COMP1_on_Counter1, COMP2_on_Counter0, COMP2_on_Counter1, COMP3_on_Counter0, COMP3_on_Counter1, UserDefined}, set at pre-compile, origin=Vector Informatik  # Interrupt source used for System Timer. The initialization of the selected timer is done automatically by the operating system except for UserDefined.
      enumeration OsOSErrorInfoLevel: {Modulnames, STANDARD}, set at pre-compile, origin=Vector Informatik, default-value=STANDARD  # If set to STANDARD, the operating system will report standard OSEK error codes. If set to Modulenames, additional information about the error location will be reported. Setting to Modulenames increases ROM size.
      enumeration OsOSOSInternalChecks: {Additional}, set at pre-compile, origin=Vector Informatik, default-value=Additional  # If set to STANDARD, the operating system will perform standard OSEK error checking. If set to Additional, some additional checks will be performed. Setting to Additional will increase the execution time of API functions.
      enumeration OsOSCompiler: {TI}, set at pre-compile, origin=Vector Informatik, default-value=TI  # Compiler Compiler used to build application. GHS : Green Hills TI : Texas Instruments
      enumeration OsOSORTIDebugLevel: {ORTI_20, ORTI_21_Additional, ORTI_21_Standard, ORTI_22_Additional, ORTI_22_Standard}, set at pre-compile, origin=Vector Informatik, default-value=ORTI_22_Standard  # ORTI Debug Level ORTI_20: Support of ORTI 2.0 ORTI_21_STANDARD: Support of ORTI 2.1, no overhead ORTI_21_Additional: Support of ORTI 2.1, additional features, requires someadditional runtime and memory ORTI_22_STANDARD: Support of ORTI 2.2, no overhead ORTI_22_Additional: Support of ORTI 2.2, additional features, requires someadditional runtime and memory
      container OsHooks  # Container to structure all hooks belonging to the OS
        boolean OsErrorHook: set at pre-compile  # If selected, the ErrorHook routine is called, if an API function returns with an error code unequal to E_OK. It is also called if OS internal errors are detected. The function ErrorHook has to be provided by the application.
        boolean OsPostTaskHook: set at pre-compile  # If selected, the PostTaskHook routine will be called any time the operating system interrupts or terminates a task. The function PostTaskHook has to be provided by the application.
        boolean OsPreTaskHook: set at pre-compile  # If selected, the PreTaskHook routine will be called any time the operating system starts or resumes a task. The function PreTaskHook has to be provided by the application.
        boolean OsProtectionHook [0..1]: set at pre-compile  # Switch to enable/disable the call to the (user supplied) protection hook. true: Protection hook is called on protection error false: Protection hook is not called
        boolean OsShutdownHook: set at pre-compile  # If selected, the ShutdownHook routine will be called, if the API-function ShutdownOS is either called by the application or by the operating system. The function ShutdownHook has to be provided by the application.
        boolean OsStartupHook: set at pre-compile  # If selected, the StartupHook routine will be called by the operating system in the startup phase (after calling StartOS and before starting the first task). The function StartupHook has to be provided by the application.
      choice container OsOSSCHEDULE  # This attribute should usually be set to AUTO. The exact scheduling policy is calculated from other attribute values. It is possible to preselect the SCHEDULE attribute, if there are restrictions to use a special scheduling policy for a project. A warning message is created if there are differences between the preselected and the calculated scheduling policy and the preselected value is overwritten to the calculated value. NON selects a completely non-preemptive behaviour, FULL selects a completely full-preemptive behaviour and MIXED allows a mixture of full- and non-preemptive tasks in the same system.
        container AUTO [0..1]  # A value will be choosen automatically during OS generation.
        container NON_AUTO [0..1]  # This attribute should usually be set to AUTO. The exact scheduling policy is calculated from other attribute values. It is possible to preselect the SCHEDULE attribute, if there are restrictions to use a special scheduling policy for a project. A warning message is created if there are differences between the preselected and the calculated scheduling policy and the preselected value is overwritten to the calculated value. NON selects a completely non-preemptive behaviour, FULL selects a completely full-preemptive behaviour and MIXED allows a mixture of full- and non-preemptive tasks in the same system.
          enumeration OsOSSCHEDULE: {FULL, MIXED, NON}, set at pre-compile, origin=Vector Informatik  # This attribute should usually be set to AUTO. The exact scheduling policy is calculated from other attribute values. It is possible to preselect the SCHEDULE attribute, if there are restrictions to use a special scheduling policy for a project. A warning message is created if there are differences between the preselected and the calculated scheduling policy and the preselected value is overwritten to the calculated value. NON selects a completely non-preemptive behaviour, FULL selects a completely full-preemptive behaviour and MIXED allows a mixture of full- and non-preemptive tasks in the same system.
      choice container OsOSCC  # This attribute should usually be set to AUTO. The exact conformance class can be calculated from other attribute values. It is possible to preselect the CC attribute, if there are restrictions to use a specific conformance class for a project. An error message is created if there are differences between the preselected and the calculated conformance class.
        container AUTO [0..1]  # A value will be choosen automatically during OS generation.
        container NON_AUTO [0..1]  # This attribute should usually be set to AUTO. The exact conformance class can be calculated from other attribute values. It is possible to preselect the CC attribute, if there are restrictions to use a specific conformance class for a project. An error message is created if there are differences between the preselected and the calculated conformance class.
          enumeration OsOSCC: {BCC1, BCC2, ECC1, ECC2}, set at pre-compile, origin=Vector Informatik  # This attribute should usually be set to AUTO. The exact conformance class can be calculated from other attribute values. It is possible to preselect the CC attribute, if there are restrictions to use a specific conformance class for a project. An error message is created if there are differences between the preselected and the calculated conformance class.
      choice container OsOSProtectionHookReaction  # Only PRO_SHUTDOWN is supported by this implementation.
        container Selected [0..1]  # Only PRO_SHUTDOWN is supported by this implementation.
          boolean OsOSSHUTDOWN: set at pre-compile, origin=Vector Informatik, default-value=true  # ProtectionHook may return the value PRO_SHUTDOWN.
      choice container OsOSSystemTimerIntPrio  # Interrupt priority of system timer. AUTO selects the default hardware priority of the used comparator (no VIM remapping).
        container AUTO [0..1]  # A value will be choosen automatically during OS generation.
        container NON_AUTO [0..1]  # Interrupt priority of system timer. AUTO selects the default hardware priority of the used comparator (no VIM remapping).
          integer OsOSSystemTimerIntPrio: 0..95, set at pre-compile, origin=Vector Informatik  # Interrupt priority of system timer. AUTO selects the default hardware priority of the used comparator (no VIM remapping).
      choice container OsOSMemoryProtection  # Provides access to subattributes that need to be filled only if memory protection is enabled.
        container TRUE [0..1]  # Provides access to subattributes that need to be filled only if memory protection is enabled.
          integer OsOSMPUCodeRegionBase: 0..4294967295, set at pre-compile, origin=Vector Informatik, default-value=0  # Base address of memory protection region for code. Note: The base address must be aligned to the size of the region!
          integer OsOSMPUCodeRegionSize: 0..4294967295, set at pre-compile, origin=Vector Informatik, default-value=0  # Size of memory protection region for code. All code must fit into the region.
          integer OsOSIRQHandlerStackSize: 0..4294967295, set at pre-compile, origin=Vector Informatik  # Size of stack for each ISR nesting level.
          integer OsOSOSDataSize: 0..4294967295, set at pre-compile, origin=Vector Informatik  # Size of data section for OS.
          integer OsOSGlobalSharedMemRegionSize: 0..4294967295, set at pre-compile, origin=Vector Informatik, default-value=0  # Size of global shared memory area. If GlobalSharedMemRegionSize == 0, the area is disabled.
        container FALSE [0..1]  # Provides access to subattributes that need to be filled only if memory protection is enabled.
      choice container OsOSRESETHandler  # RESETHandler Handler for reset (AUTO = _c_int00)
        container AUTO [0..1]  # A value will be choosen automatically during OS generation.
        container NON_AUTO [0..1]  # RESETHandler Handler for reset (AUTO = _c_int00)
          string OsOSRESETHandler: set at pre-compile, origin=Vector Informatik  # RESETHandler Handler for reset (AUTO = _c_int00)
      choice container OsOSUDEFHandler  # UDEFHandler Handler for data abort exception
        container AUTO [0..1]  # A value will be choosen automatically during OS generation.
        container NON_AUTO [0..1]  # UDEFHandler Handler for data abort exception
          string OsOSUDEFHandler: set at pre-compile, origin=Vector Informatik  # UDEFHandler Handler for data abort exception
      choice container OsOSFIQHandler  # FIQHandler Handler for FIQ exception
        container AUTO [0..1]  # A value will be choosen automatically during OS generation.
        container NON_AUTO [0..1]  # FIQHandler Handler for FIQ exception
          string OsOSFIQHandler: set at pre-compile, origin=Vector Informatik  # FIQHandler Handler for FIQ exception
      choice container OsOSPeripheralRegion [0..*]  # List of Peripheral regions which are assigned to be accessible for the corresponding application.
        container Region [0..1]  # List of Peripheral regions which are assigned to be accessible for the corresponding application.
          integer OsOSStartAddress: 0..4294967295, set at pre-compile, origin=Vector Informatik  # Specifies the start address of the peripheral region which shall be configured (StartAddress <= memory to be accessed).
          integer OsOSEndAddress: 0..4294967295, set at pre-compile, origin=Vector Informatik  # Specifies the end address of the peripheral region which shall be configured (memory to be accessed <= EndAddress).
          string OsOSIdentifier: set at pre-compile, origin=Vector Informatik  # Unique C Identifier which must be used in an application which accesses the peripheral region.
          reference OsOSACCESSING_APPLICATION [0..*]: set at pre-compile, origin=Vector Informatik, destination=OsApplication  # The applications with access right to this peripheral region are defined here.
      choice container OsOSTimingMeasurement  # Allows global configuration of timing protection and timing measurement. If this attribute is deselected (set to FALSE), no timing measurement for tasks and ISRs is performed, timing protection is provided as selected by the subattribute TimingProtection of the task/ISR. In case the subattribute OnlyMeasure of TimingProtection is set for a task or ISR, that setting is ignored with a warning. To measure the timing of tasks and ISRs, this attribute must be selected (set to TRUE). In this case, subattributes provide further options.
        container TRUE [0..1]  # Allows global configuration of timing protection and timing measurement. If this attribute is deselected (set to FALSE), no timing measurement for tasks and ISRs is performed, timing protection is provided as selected by the subattribute TimingProtection of the task/ISR. In case the subattribute OnlyMeasure of TimingProtection is set for a task or ISR, that setting is ignored with a warning. To measure the timing of tasks and ISRs, this attribute must be selected (set to TRUE). In this case, subattributes provide further options.
          enumeration OsOSGlobalConfig: {AsSelected, OnlyMeasureAll, ProtectAndMeasureAll}, set at pre-compile, origin=Vector Informatik, default-value=AsSelected  # Provides the global configuration of timing measurement. Possible values: ProtectAndMeasureAll: Timing protection is provided for all tasks and ISRs. In case the timing protection subattribute OnlyMeasure is selected for a task or ISR, that setting is ignored with a warning. Timing measurement is provided for all tasks and ISRs independently from their configuration. AsSelected: Timing protection is provided as selected with the attribute TimingProtection of each task and ISR. The subattribte OnlyMeasure is respected and disables timing protection if selected for a task or ISR. Timing measurement is provided for tasks and ISRs with OnlyMeasure selected. OnlyMeasureAll: Timing Measurement is provided for all tasks and ISRs. Timing protection however is disabled for all tasks and ISRs. For each task and ISR that has a timing protection configured and not set the subattribute OnlyMeasure, a warning is generated to remind the user that this setting is not meant for production code.
        container FALSE [0..1]  # Allows global configuration of timing protection and timing measurement. If this attribute is deselected (set to FALSE), no timing measurement for tasks and ISRs is performed, timing protection is provided as selected by the subattribute TimingProtection of the task/ISR. In case the subattribute OnlyMeasure of TimingProtection is set for a task or ISR, that setting is ignored with a warning. To measure the timing of tasks and ISRs, this attribute must be selected (set to TRUE). In this case, subattributes provide further options.
      choice container OsOSAPIOptimization
        container Manual [0..1]
          boolean OsOSActivateTask: set at pre-compile, origin=Vector Informatik, default-value=true
          boolean OsOSTerminateTask: set at pre-compile, origin=Vector Informatik, default-value=true
          boolean OsOSChainTask: set at pre-compile, origin=Vector Informatik, default-value=true
          boolean OsOSSchedule: set at pre-compile, origin=Vector Informatik, default-value=true
          boolean OsOSGetTaskID: set at pre-compile, origin=Vector Informatik, default-value=true
          boolean OsOSGetTaskState: set at pre-compile, origin=Vector Informatik, default-value=true
          boolean OsOSDisableAllInterrupts: set at pre-compile, origin=Vector Informatik, default-value=true
          boolean OsOSEnableAllInterrupts: set at pre-compile, origin=Vector Informatik, default-value=true
          boolean OsOSSuspendOSInterrupts: set at pre-compile, origin=Vector Informatik, default-value=true
          boolean OsOSResumeOSInterrupts: set at pre-compile, origin=Vector Informatik, default-value=true
          boolean OsOSSuspendAllInterrupts: set at pre-compile, origin=Vector Informatik, default-value=true
          boolean OsOSResumeAllInterrupts: set at pre-compile, origin=Vector Informatik, default-value=true
          boolean OsOSGetResource: set at pre-compile, origin=Vector Informatik, default-value=true
          boolean OsOSReleaseResource: set at pre-compile, origin=Vector Informatik, default-value=true
          boolean OsOSSetEvent: set at pre-compile, origin=Vector Informatik, default-value=true
          boolean OsOSClearEvent: set at pre-compile, origin=Vector Informatik, default-value=true
          boolean OsOSGetEvent: set at pre-compile, origin=Vector Informatik, default-value=true
          boolean OsOSWaitEvent: set at pre-compile, origin=Vector Informatik, default-value=true
          boolean OsOSGetAlarmBase: set at pre-compile, origin=Vector Informatik, default-value=true
          boolean OsOSGetAlarm: set at pre-compile, origin=Vector Informatik, default-value=true
          boolean OsOSSetRelAlarm: set at pre-compile, origin=Vector Informatik, default-value=true
          boolean OsOSSetAbsAlarm: set at pre-compile, origin=Vector Informatik, default-value=true
          boolean OsOSCancelAlarm: set at pre-compile, origin=Vector Informatik, default-value=true
          boolean OsOSGetActiveApplicationMode: set at pre-compile, origin=Vector Informatik, default-value=true
          boolean OsOSIncrementCounter: set at pre-compile, origin=Vector Informatik, default-value=true
          boolean OsOSStartCOM: set at pre-compile, origin=Vector Informatik, default-value=true
          boolean OsOSStopCOM: set at pre-compile, origin=Vector Informatik, default-value=true
          boolean OsOSSendMessage: set at pre-compile, origin=Vector Informatik, default-value=true
          boolean OsOSReceiveMessage: set at pre-compile, origin=Vector Informatik, default-value=true
          boolean OsOSGetMessageStatus: set at pre-compile, origin=Vector Informatik, default-value=true
          boolean OsOSInitMessage: set at pre-compile, origin=Vector Informatik, default-value=true
          boolean OsOSGetCOMApplicationMode: set at pre-compile, origin=Vector Informatik, default-value=true
          boolean OsOSStartScheduleTableAbs: set at pre-compile, origin=Vector Informatik, default-value=true
          boolean OsOSStartScheduleTableRel: set at pre-compile, origin=Vector Informatik, default-value=true
          boolean OsOSStopScheduleTable: set at pre-compile, origin=Vector Informatik, default-value=true
          boolean OsOSNextScheduleTable: set at pre-compile, origin=Vector Informatik, default-value=true
          boolean OsOSGetScheduleTableStatus: set at pre-compile, origin=Vector Informatik, default-value=true
          boolean OsOSStartScheduleTableSynchron: set at pre-compile, origin=Vector Informatik, default-value=true  # This function is only available in SC2 or SC4
          boolean OsOSSyncScheduleTable: set at pre-compile, origin=Vector Informatik, default-value=true  # This function is only available in SC2 or SC4
          boolean OsOSSetScheduleTableAsync: set at pre-compile, origin=Vector Informatik, default-value=true  # This function is only available in SC2 or SC4
          boolean OsOSGetApplicationID: set at pre-compile, origin=Vector Informatik, default-value=true
          boolean OsOSGetISRID: set at pre-compile, origin=Vector Informatik, default-value=true
          boolean OsOSCallTrustedFunction: set at pre-compile, origin=Vector Informatik, default-value=true
          boolean OsOSCallNonTrustedFunction: set at pre-compile, origin=Vector Informatik, default-value=true
          boolean OsOSCheckISRMemoryAccess: set at pre-compile, origin=Vector Informatik, default-value=true
          boolean OsOSCheckTaskMemoryAccess: set at pre-compile, origin=Vector Informatik, default-value=true
          boolean OsOSCheckObjectAccess: set at pre-compile, origin=Vector Informatik, default-value=true
          boolean OsOSCheckObjectOwnership: set at pre-compile, origin=Vector Informatik, default-value=true
          boolean OsOSTerminateApplication: set at pre-compile, origin=Vector Informatik, default-value=true
          boolean OsOSGetTaskMaxExecutionTime: set at pre-compile, origin=Vector Informatik, default-value=true
          boolean OsOSGetISRMaxExecutionTime: set at pre-compile, origin=Vector Informatik, default-value=true
          boolean OsOSGetTaskMaxBlockingTime: set at pre-compile, origin=Vector Informatik, default-value=true
          boolean OsOSGetISRMaxBlockingTime: set at pre-compile, origin=Vector Informatik, default-value=true
          boolean OsOSGetTaskMinInterArrivalTime: set at pre-compile, origin=Vector Informatik, default-value=true
          boolean OsOSGetISRMinInterArrivalTime: set at pre-compile, origin=Vector Informatik, default-value=true
        container Automatic [0..1]
    container OsResource [0..8192]  # An OsResource object is used to co-ordinate the concurrent access by tasks and ISRs to a shared resource, e.g. the scheduler, any program sequence, memory or any hardware area.
      enumeration OsResourceProperty: {INTERNAL, LINKED, STANDARD}, set at pre-compile, default-value=STANDARD  # This specifies the type of the resource.
      reference OsResourceAccessingApplication [0..*]: set at pre-compile, destination=OsApplication  # Reference to applications which have an access to this object.
      reference OsResourceLinkedResourceRef [0..1]: set at pre-compile, destination=OsResource  # The link to the resource. Must be valid if OsResourceProperty is LINKED. If OsResourceProperty is not LINKED the value is ignored.
    container OsScheduleTable [0..65535]  # An OsScheduleTable addresses the synchronization issue by providing an encapsulation of a statically defined set of alarms that cannot be modified at runtime.
      boolean OsScheduleTableRepeating: set at pre-compile  # true: first expiry point on the schedule table shall be processed at final expiry point delay ticks after the final expiry point is processed. false: the schedule table processing stops when the final expiry point is processed.
      integer OsScheduleTableDuration: set at pre-compile, origin=Vector Informatik  # Defines the length of the schedule table in ticks.
      reference OsSchTblAccessingApplication [0..*]: set at pre-compile, destination=OsApplication  # Reference to applications which have an access to this object.
      reference OsScheduleTableCounterRef: set at pre-compile, destination=OsCounter  # This parameter contains a reference to the counter which drives the schedule table.
      container OsScheduleTableAutostart [0..1]  # This parameter specifies if and how the schedule table is started on startup of the Operating System. The options to start a schedule table correspond to the API calls to start schedule tables during runtime.
        integer OsScheduleTableAbsValue: set at pre-compile  # Absolute autostart tick value when the schedule table starts. Only used if the OsScheduleTableAutostartType is ABSOLUTE.
        enumeration OsScheduleTableAutostartType: {ABSOLUTE, RELATIVE, SYNCHRON}, set at pre-compile  # This specifies the type of the autostart for the schedule table.
        integer OsScheduleTableRelOffset: set at pre-compile  # Relative offset in ticks when the schedule table starts. Only used if the OsScheduleTableAutostartType is RELATIVE.
        reference OsScheduleTableAppModeRef [1..*]: set at pre-compile, destination=OsAppMode  # Reference in which application modes the schedule table should be started during startup
      container OsScheduleTableExpiryPoint [1..*]  # The point on a Schedule Table at which the OS activates tasks and/or sets events
        integer OsScheduleTblExpPointOffset: set at pre-compile  # The offset from zero (in ticks) at which the expiry point is to be processed.
        container OsScheduleTableEventSetting [0..*]  # Event that is triggered by that schedule table.
          reference OsScheduleTableSetEventRef: set at pre-compile, destination=OsEvent  # Reference to event that will be set by action
          reference OsScheduleTableSetEventTaskRef: set at pre-compile, destination=OsTask
          choice container OsScheduleTableCyclic  # Defines if the action shall be periodic
            container TRUE [0..1]  # Defines if the action shall be periodic
              integer OsScheduleTableCycleTime: 0..18446744073709551615, set at pre-compile, origin=Vector Informatik  # Time between subsequent occurrences of this expiry point in ticks
            container FALSE [0..1]  # Defines if the action shall be periodic
        container OsScheduleTableTaskActivation [0..*]  # Task that is triggered by that schedule table.
          reference OsScheduleTableActivateTaskRef: set at pre-compile, destination=OsTask  # Reference to task that will be activated by action
          choice container OsScheduleTableCyclic  # Defines if the action shall be periodic
            container TRUE [0..1]  # Defines if the action shall be periodic
              integer OsScheduleTableCycleTime: 0..18446744073709551615, set at pre-compile, origin=Vector Informatik  # Time between subsequent occurrences of this expiry point in ticks
            container FALSE [0..1]  # Defines if the action shall be periodic
        container OsScheduleTblAdjustableExpPoint [0..1]  # Adjustable expiry point
          integer OsScheduleTableMaxAdvance: set at pre-compile  # The maximum positive adjustment that can be made to the expiry point offset (in ticks).
          integer OsScheduleTableMaxRetard: set at pre-compile  # The maximum negative adjustment that can be made to the expiry point offset (in ticks).
      container OsScheduleTableSync [0..1]  # This parameter specifies the synchronization parameters of the schedule table.
        integer OsScheduleTblExplicitPrecision [0..1]: set at pre-compile  # This configuration is only valid if the explicit synchronisation is used.
        enumeration OsScheduleTblSyncStrategy: {EXPLICIT, IMPLICIT, NONE}, set at pre-compile, default-value=NONE  # AUTOSAR OS provides support for synchronisation in two ways: explicit and implicit.
    container OsTask [0..65535]  # This container represents an OSEK task.
      integer OsTaskActivation: 1..4294967296, set at pre-compile, default-value=1  # This attribute defines the maximum number of queued activation requests for the task. A value equal to "1" means that at any time only a single activation is permitted for this task. Note that the value must be a natural number starting at 1.
      integer OsTaskPriority: set at pre-compile  # The priority of a task is defined by the value of this attribute. This value has to be understood as a relative value, i.e. the values show only the relative ordering of the tasks. OSEK OS defines the lowest priority as zero (0); larger values correspond to higher priorities.
      enumeration OsTaskSchedule: {FULL, NON}, set at pre-compile  # The OsTaskSchedule attribute defines the preemptability of the task. If this attribute is set to NON, no internal resources may be assigned to this task.
      enumeration OsTaskTYPE: {BASIC, EXTENDED, AUTO}, set at pre-compile, origin=Vector Informatik, default-value=AUTO  # This attribute should usually be set to AUTO. The exact task type can be calculated from other attribute values. It is possible to preselect the TYPE attribute, if there are restrictions to use a special task type. An error message is created if there are differences between the preselected and the calculated task type.
      boolean OsTaskNotUsingSchedule: set at pre-compile, origin=Vector Informatik, default-value=false  # In certain cases stacks my be shared between different non-preemptive basic-tasks. This depends on the usage of the API-function Schedule. If the application programmer does not use the API-function Schedule stacks may be shared. In this case the attribute NotUsingSchedule may enable the stack sharing. This attribute is only available if the implementation supports stacks.
      integer OsTaskComputationTime: 0..9223372036854775807, set at pre-compile, origin=Vector Informatik, default-value=0  # The worst-case computation time. This attribute is needed for DMA timing analysis performed by the osCAN TimingAnalyzer.
      integer OsTaskPeriod: 0..9223372036854775807, set at pre-compile, origin=Vector Informatik, default-value=0  # The minimum activation period of the task. This attribute is needed for DMA timing analysis performed by the osCAN TimingAnalyzer.
      integer OsTaskDeadline: 0..9223372036854775807, set at pre-compile, origin=Vector Informatik, default-value=0  # The deadline of the task. This attribute is needed for DMA timing analysis performed by the osCAN TimingAnalyzer.
      integer OsTaskStackSize: 0..65535, set at pre-compile, origin=Vector Informatik, default-value=200  # Stack size of the task in bytes
      integer OsTaskProtectionRegionSizeNoInitData: 0..4294967295, set at pre-compile, origin=Vector Informatik, default-value=0  # Size of memory protection region for task specific, uninitialized data. All data must fit into this region. Unused in SC1/SC2.
      integer OsTaskProtectionRegionSizeInitData: 0..4294967295, set at pre-compile, origin=Vector Informatik, default-value=0  # Size of memory protection region for task specific, initialized data. All data must fit into this region. Unused in SC1/SC2.
      integer OsTaskNonTrustFctStackSize: 0..4294967295, set at pre-compile, origin=Vector Informatik, default-value=0  # Size of stack for non-trusted function calls.
      reference OsTaskAccessingApplication [0..*]: set at pre-compile, destination=OsApplication  # Reference to applications which have an access to this object.
      reference OsTaskEventRef [0..*]: set at pre-compile, destination=OsEvent  # This reference defines the list of events the extended task may react on.
      reference OsTaskResourceRef [0..*]: set at pre-compile, destination=OsResource  # This reference defines a list of resources accessed by this task.
      reference OsTaskMESSAGE [0..*]: set at pre-compile, origin=Vector Informatik, destination=OsMessage  # Defines a MESSAGE to be accessed by the task
      container OsTaskUseResourceOccupation [0..*]  # This attribute is needed for DMA timing analysis performed by the osCAN TimingAnalyzer.
        integer OsTaskOccupationTime: set at pre-compile, origin=Vector Informatik  # Maximum duration of Resource usage in the task
        reference OsTaskResource: set at pre-compile, origin=Vector Informatik, destination=OsResource  # Reference to a Resource
      container OsTaskAutostart [0..1]  # This container determines whether the task is activated during the system start-up procedure or not for some specific application modes. If the task shall be activated during the system start-up, this container is present and holds the references to the application modes in which the task is auto-started.
        reference OsTaskAppModeRef [1..*]: set at pre-compile, destination=OsAppMode  # Reference to application modes in which that task is activated on startup of the OS
      container OsTaskTimingProtection [0..1]  # This parameter contains all parameters regarding timing protection of the task.
        float OsTaskAllInterruptLockBudget: set at pre-compile  # This parameter contains the maximum time for which the task is allowed to lock all interrupts (via SuspendAllInterrupts() or DisableAllInterrupts()) (in seconds).
        float OsTaskExecutionBudget: set at pre-compile  # This parameter contains the maximum allowed execution time of the task (in seconds).
        float OsTaskOsInterruptLockBudget: set at pre-compile  # This parameter contains the maximum time for which the task is allowed to lock all Category 2 interrupts (via SuspendOSInterrupts()) (in seconds).
        float OsTaskTimeFrame: set at pre-compile  # The minimum inter-arrival time between activations and/or releases of a task (in seconds).
        boolean OsTaskOnlyMeasure: set at pre-compile, origin=Vector Informatik, default-value=false  # If selected, the execution time and the locking times are measured, but no timing protection faults are detected. This might be helpful to find suitable maximum values.
        container OsTaskResourceLock [0..*]  # This parameter contains the worst case time between getting and releasing a given resource (in seconds).
          float OsTaskResourceLockBudget: set at pre-compile  # This parameter contains the maximum time the task is allowed to lock the resource (in seconds)
          reference OsTaskResourceLockResourceRef: set at pre-compile, destination=OsResource  # Reference to the resource used by the task
    container OsImplementationInformation
      string OsVectorOilVersion: set at pre-compile, origin=Vector Informatik, default-value=3.2
      string OsVectorImplementationName: set at pre-compile, origin=Vector Informatik
      integer OsBswmdStyleVersion: 0..4294967296, set at pre-compile, origin=Vector Informatik, default-value=2
    container OsCom
      boolean OsComErrorHook: set at pre-compile, origin=Vector Informatik, default-value=false
      boolean OsComUseGetServiceId: set at pre-compile, origin=Vector Informatik, default-value=false
      boolean OsComUseParameterAccess: set at pre-compile, origin=Vector Informatik, default-value=false
      boolean OsComStartComExtension: set at pre-compile, origin=Vector Informatik, default-value=false
      boolean OsComUseCOM: set at pre-compile, origin=Vector Informatik, default-value=true
      enumeration OsComStatus: {COMSTANDARD, COMEXTENDED}, set at pre-compile, origin=Vector Informatik, default-value=COMSTANDARD
      string OsComAppMode [0..*]: set at pre-compile, origin=Vector Informatik
    container OsMessage [0..*]
      reference OsMsgAccessingApplication [0..*]: set at pre-compile, origin=Vector Informatik, destination=OsApplication  # Reference to applications which have an access to this object.
      choice container OsMessageProperty
        container OsMsgReceiveQueuedInternal [0..1]
          integer OsMsgQueueSize: 1.., set at pre-compile, origin=Vector Informatik
          reference OsMsgSendingMessage: set at pre-compile, origin=Vector Informatik, destination=OsMessage
        container OsMsgReceiveUnqueuedInternal [0..1]
          integer OsMsgInitialValue: 0..9223372036854775807, set at pre-compile, origin=Vector Informatik, default-value=0
          reference OsMsgSendingMessage: set at pre-compile, origin=Vector Informatik, destination=OsMessage
        container OsMsgSendStaticInternal [0..1]
          string OsMsgCDataType: set at pre-compile, origin=Vector Informatik
      choice container OsMsgNotification
        container OsMsgNone [0..1]
        container OsMsgActivateTask [0..1]
          reference OsMsgTaskRef: set at pre-compile, origin=Vector Informatik, destination=OsTask
        container OsMsgComCallback [0..1]
          function name OsMsgCallbackRoutineName: set at pre-compile, origin=Vector Informatik
          reference OsMsgMessageRef [0..*]: set at pre-compile, origin=Vector Informatik, destination=OsMessage
        container OsMsgFlag [0..1]
          string OsMsgFlagName: set at pre-compile, origin=Vector Informatik
        container OsMsgSetEvent [0..1]
          reference OsMsgEventRef: set at pre-compile, origin=Vector Informatik, destination=OsEvent
          reference OsMsgTaskRef: set at pre-compile, origin=Vector Informatik, destination=OsTask
    container VectorCommonData
      string BswmdVersion: set at published-information, origin=Vector Informatik, default-value=5.07.00
  module config Os_Rec: definition=Os
    OsOS
      OsOSSCHEDULE
        AUTO
      OsOSCC
        AUTO
      OsOSProtectionHookReaction
        Selected
      OsOSSystemTimerIntPrio
        AUTO
      OsOSMemoryProtection
        TRUE
      OsOSRESETHandler
        AUTO
      OsOSUDEFHandler
        AUTO
      OsOSFIQHandler
        AUTO
      OsOSTimingMeasurement
        TRUE
      OsOSAPIOptimization
        Automatic
  module config Os_Pre: definition=Os
    OsImplementationInformation: OsVectorOilVersion=3.2, OsVectorImplementationName=TMS570LS3x.i32, OsBswmdStyleVersion=2
    OSDEFAULTAPPMODE (OsAppMode)
    SystemTimer (OsCounter): OsCounterMaxAllowedValue=2147483647, OsCounterTicksPerBase=1, OsCounterMinCycle=1, OsSecondsPerTick=1234567890, OsCounterType=SOFTWARE
    RES_SCHEDULER (OsResource): OsResourceProperty=STANDARD
