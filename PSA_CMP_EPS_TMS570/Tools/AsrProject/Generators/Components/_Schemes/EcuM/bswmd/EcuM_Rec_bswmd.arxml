AUTOSAR XML (schema 3.0.1)
package /MICROSAR
  module config EcuM_Rec: definition=EcuM
  module config EcuM_Rec_Class1: definition=EcuM
    EcuMConfiguration
      EcuMWdgM
      EcuMDriverRestartList
      EcuMDriverInitListTwo
      EcuMDriverInitListOne
      EcuMDriverInitListThree
