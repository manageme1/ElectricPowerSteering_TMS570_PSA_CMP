AUTOSAR XML (schema 3.0.1)
package /MICROSAR
  module config EcuM_Pre: definition=EcuM
  module config EcuM_Pre_Class1: definition=EcuM
    EcuMConfiguration
      5 x EcuMWakeupSource, all with EcuMValidationTimeout=0:
        ECUM_WKSOURCE_POWER: EcuMWakeupSourceId=1
        ECUM_WKSOURCE_RESET: EcuMWakeupSourceId=2
        ECUM_WKSOURCE_INTERNAL_RESET: EcuMWakeupSourceId=4
        ECUM_WKSOURCE_INTERNAL_WDG: EcuMWakeupSourceId=8
        ECUM_WKSOURCE_EXTERNAL_WDG: EcuMWakeupSourceId=16
