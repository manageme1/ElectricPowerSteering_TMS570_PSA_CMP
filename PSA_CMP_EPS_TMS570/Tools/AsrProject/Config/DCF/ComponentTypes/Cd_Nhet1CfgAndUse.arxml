AUTOSAR XML (schema 314)
package /ComponentType
  complex device driver component type Cd_Nhet1CfgAndUse
    6 x provide port:
      HwTq1Qlfr: unqueued-sender-com-spec{data-element=State_enum, can-invalidate=false, init-value=D_SIGQLFRNORES_CNT_ENUM}, provided-interface=SigQlfr_State_enum
      HwTq1RollgCntr: unqueued-sender-com-spec{data-element=Cnt_u08, can-invalidate=false, init-value=D_ZERO_CNT_U8}, provided-interface=Count_Cnt_u08
      HwTq1Val: unqueued-sender-com-spec{data-element=HwNm_f32, can-invalidate=false, init-value=D_ZERO_ULS_F32}, provided-interface=HwTrq_HwNm_f32
      HwTq2Qlfr: unqueued-sender-com-spec{data-element=State_enum, can-invalidate=false, init-value=D_SIGQLFRNORES_CNT_ENUM}, provided-interface=SigQlfr_State_enum
      HwTq2RollgCntr: unqueued-sender-com-spec{data-element=Cnt_u08, can-invalidate=false, init-value=D_ZERO_CNT_U8}, provided-interface=Count_Cnt_u08
      HwTq2Val: unqueued-sender-com-spec{data-element=HwNm_f32, can-invalidate=false, init-value=D_ZERO_ULS_F32}, provided-interface=HwTrq_HwNm_f32
    require port HwTq1Polarity: unqueued-receiver-com-spec{data-element=Cnt_s08, init-value=D_ZERO_CNT_S8}, required-interface=Count_Cnt_s08
    require port HwTq2Polarity: unqueued-receiver-com-spec{data-element=Cnt_s08, init-value=D_ZERO_CNT_S8}, required-interface=Count_Cnt_s08
    require port NxtrDiagMgr: required-com-specs=[GetNTCActive, GetNTCFailed, GetNTCStatus, SetNTCStatus], required-interface=NxtrDiagMgr
  internal behavior Cd_Nhet1CfgAndUse_InternalBehavior: component=Cd_Nhet1CfgAndUse
    timing event TMT_Nhet1CfgAndUse_Per1: start-on-event=Nhet1CfgAndUse_Per1, period=0.002
    timing event TMT_Nhet1CfgAndUse_Per2: start-on-event=Nhet1CfgAndUse_Per2, period=0.002
    port-api-options:
      enable-take-address=false, indirect-api=false, port=HwTq1Polarity
      enable-take-address=false, indirect-api=false, port=HwTq1Qlfr
      enable-take-address=false, indirect-api=false, port=HwTq1RollgCntr
      enable-take-address=false, indirect-api=false, port=HwTq1Val
      enable-take-address=false, indirect-api=false, port=HwTq2Polarity
      enable-take-address=false, indirect-api=false, port=HwTq2Qlfr
      enable-take-address=false, indirect-api=false, port=HwTq2RollgCntr
      enable-take-address=false, indirect-api=false, port=HwTq2Val
      enable-take-address=false, indirect-api=false, port=NxtrDiagMgr
    runnable Nhet1CfgAndUse_Per1
    runnable Nhet1CfgAndUse_Per2
      data read access READ_HwTq1Polarity_Cnt_s08: data-element=HwTq1Polarity.Cnt_s08
      data read access READ_HwTq2Polarity_Cnt_s08: data-element=HwTq2Polarity.Cnt_s08
      6 x data write access:
        WRITE_HwTq1Qlfr_State_enum: data-element=HwTq1Qlfr.State_enum
        WRITE_HwTq1RollgCntr_Cnt_u08: data-element=HwTq1RollgCntr.Cnt_u08
        WRITE_HwTq1Val_HwNm_f32: data-element=HwTq1Val.HwNm_f32
        WRITE_HwTq2Qlfr_State_enum: data-element=HwTq2Qlfr.State_enum
        WRITE_HwTq2RollgCntr_Cnt_u08: data-element=HwTq2RollgCntr.Cnt_u08
        WRITE_HwTq2Val_HwNm_f32: data-element=HwTq2Val.HwNm_f32
      sync call SC_NxtrDiagMgr_SetNTCStatus: operation=NxtrDiagMgr.SetNTCStatus, timeout=0
  swc implementation Cd_Nhet1CfgAndUse_Implementation: behavior=Cd_Nhet1CfgAndUse_InternalBehavior
    code-descriptors:
      code Code: type=SRC
