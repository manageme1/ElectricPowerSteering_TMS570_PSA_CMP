AUTOSAR XML (schema 314)
package /ComponentType
  complex device driver component type Cd_SrlComDriver
    68 x provide port:
      AccelLat: unqueued-sender-com-spec{data-element=Cnt_s16, can-invalidate=false, init-value=D_ZERO_CNT_S16}, provided-interface=Count_Cnt_s16
      AnneeEcoule: unqueued-sender-com-spec{data-element=Cnt_u08, can-invalidate=false, init-value=D_ZERO_CNT_U8}, provided-interface=Count_Cnt_u08
      BusOff: unqueued-sender-com-spec{data-element=Cnt_lgc, can-invalidate=false, init-value=D_FALSE_CNT_LGC}, provided-interface=BoolStatusFlag_Cnt_lgc
      ColumnAngleSetpoint: unqueued-sender-com-spec{data-element=Cnt_u16, can-invalidate=false, init-value=D_ZERO_CNT_U16}, provided-interface=Count_Cnt_u16
      CompteurTemporelVehicule: unqueued-sender-com-spec{data-element=Cnt_u32, can-invalidate=false, init-value=D_ZERO_CNT_U32}, provided-interface=Count_Cnt_u32
      ComputerRazGCT: unqueued-sender-com-spec{data-element=Cnt_u08, can-invalidate=false, init-value=D_ZERO_CNT_U8}, provided-interface=Count_Cnt_u08
      ConfigVhl: unqueued-sender-com-spec{data-element=Cnt_u08, can-invalidate=false, init-value=D_ZERO_CNT_U8}, provided-interface=Count_Cnt_u08
      DiagIntegraElec: unqueued-sender-com-spec{data-element=Cnt_u08, can-invalidate=false, init-value=D_ZERO_CNT_U8}, provided-interface=Count_Cnt_u08
      DiagMuxOn: unqueued-sender-com-spec{data-element=Cnt_u08, can-invalidate=false, init-value=D_ZERO_CNT_U8}, provided-interface=Count_Cnt_u08
      DmdDelestDA: unqueued-sender-com-spec{data-element=Cnt_u08, can-invalidate=false, init-value=D_ZERO_CNT_U8}, provided-interface=Count_Cnt_u08
      EffacDefaultDiag: unqueued-sender-com-spec{data-element=Cnt_u08, can-invalidate=false, init-value=D_ZERO_CNT_U8}, provided-interface=Count_Cnt_u08
      ESPDeconnecte: unqueued-sender-com-spec{data-element=Cnt_u08, can-invalidate=false, init-value=D_ONE_CNT_U8}, provided-interface=Count_Cnt_u08
      EtatMT: unqueued-sender-com-spec{data-element=Cnt_u08, can-invalidate=false, init-value=D_ZERO_CNT_U8}, provided-interface=Count_Cnt_u08
      EtatPrincipSev: unqueued-sender-com-spec{data-element=Cnt_u08, can-invalidate=false, init-value=D_ZERO_CNT_U8}, provided-interface=Count_Cnt_u08
      EtatReseauElec: unqueued-sender-com-spec{data-element=Cnt_u08, can-invalidate=false, init-value=D_ZERO_CNT_U8}, provided-interface=Count_Cnt_u08
      ISDAT4V2BSI552MsgDLCError: unqueued-sender-com-spec{data-element=Cnt_u08, can-invalidate=false, init-value=D_ZERO_CNT_U8}, provided-interface=Count_Cnt_u08
      ISDAT4V2BSI552MsgRxTime: unqueued-sender-com-spec{data-element=MSec_u32, can-invalidate=false, init-value=D_ZERO_CNT_U32}, provided-interface=Time_MSec_u32
      ISDATABR50DMsgDLCError: unqueued-sender-com-spec{data-element=Cnt_u08, can-invalidate=false, init-value=D_ZERO_CNT_U8}, provided-interface=Count_Cnt_u08
      ISDATABR50DMsgRxTime: unqueued-sender-com-spec{data-element=MSec_u32, can-invalidate=false, init-value=D_ZERO_CNT_U32}, provided-interface=Time_MSec_u32
      ISDATBSI3F2MsgDLCError: unqueued-sender-com-spec{data-element=Cnt_u08, can-invalidate=false, init-value=D_ZERO_CNT_U8}, provided-interface=Count_Cnt_u08
      ISDATBSI3F2MsgRxTime: unqueued-sender-com-spec{data-element=MSec_u32, can-invalidate=false, init-value=D_ZERO_CNT_U32}, provided-interface=Time_MSec_u32
      ISDATBSI412MsgDLCError: unqueued-sender-com-spec{data-element=Cnt_u08, can-invalidate=false, init-value=D_ZERO_CNT_U8}, provided-interface=Count_Cnt_u08
      ISDATBSI412MsgRxTime: unqueued-sender-com-spec{data-element=MSec_u32, can-invalidate=false, init-value=D_ZERO_CNT_U32}, provided-interface=Time_MSec_u32
      ISDATBSI432MsgDLCError: unqueued-sender-com-spec{data-element=Cnt_u08, can-invalidate=false, init-value=D_ZERO_CNT_U8}, provided-interface=Count_Cnt_u08
      ISDATBSI432MsgRxTime: unqueued-sender-com-spec{data-element=MSec_u32, can-invalidate=false, init-value=D_ZERO_CNT_U32}, provided-interface=Time_MSec_u32
      ISDATBSI572MsgDLCError: unqueued-sender-com-spec{data-element=Cnt_u08, can-invalidate=false, init-value=D_ZERO_CNT_U8}, provided-interface=Count_Cnt_u08
      ISDATBSI572MsgRxTime: unqueued-sender-com-spec{data-element=MSec_u32, can-invalidate=false, init-value=D_ZERO_CNT_U32}, provided-interface=Time_MSec_u32
      ISDATDIRAMsgTxInProgress: unqueued-sender-com-spec{data-element=Cnt_lgc, can-invalidate=false, init-value=D_FALSE_CNT_LGC}, provided-interface=BoolStatusFlag_Cnt_lgc
      ISDATDIRAMsgTxTime: unqueued-sender-com-spec{data-element=MSec_u32, can-invalidate=false, init-value=D_ZERO_CNT_U32}, provided-interface=Time_MSec_u32
      ISDYN2CMMMsgDLCError: unqueued-sender-com-spec{data-element=Cnt_u08, can-invalidate=false, init-value=D_ZERO_CNT_U8}, provided-interface=Count_Cnt_u08
      ISDYN2CMMMsgRxTime: unqueued-sender-com-spec{data-element=MSec_u32, can-invalidate=false, init-value=D_ZERO_CNT_U32}, provided-interface=Time_MSec_u32
      ISDYN2FRE3CDMsgDLCError: unqueued-sender-com-spec{data-element=Cnt_u08, can-invalidate=false, init-value=D_ZERO_CNT_U8}, provided-interface=Count_Cnt_u08
      ISDYN2FRE3CDMsgRxTime: unqueued-sender-com-spec{data-element=MSec_u32, can-invalidate=false, init-value=D_ZERO_CNT_U32}, provided-interface=Time_MSec_u32
      ISDYNAASMsg: unqueued-sender-com-spec{data-element=Cnt_u08, can-invalidate=false, init-value=T_CANMSGINIT_CNT_U08}, provided-interface=CanMsg_Cnt_u08
      ISDYNAASMsgDLCError: unqueued-sender-com-spec{data-element=Cnt_u08, can-invalidate=false, init-value=D_ZERO_CNT_U8}, provided-interface=Count_Cnt_u08
      ISDYNAASMsgRxTime: unqueued-sender-com-spec{data-element=MSec_u32, can-invalidate=false, init-value=D_ZERO_CNT_U32}, provided-interface=Time_MSec_u32
      ISDYNABRMsg: unqueued-sender-com-spec{data-element=Cnt_u08, can-invalidate=false, init-value=T_CANMSGINIT_CNT_U08}, provided-interface=CanMsg_Cnt_u08
      ISDYNABRMsgDLCError: unqueued-sender-com-spec{data-element=Cnt_u08, can-invalidate=false, init-value=D_ZERO_CNT_U8}, provided-interface=Count_Cnt_u08
      ISDYNABRMsgRxTime: unqueued-sender-com-spec{data-element=MSec_u32, can-invalidate=false, init-value=D_ZERO_CNT_U32}, provided-interface=Time_MSec_u32
      ISDYNCDS34DMsgDLCError: unqueued-sender-com-spec{data-element=Cnt_u08, can-invalidate=false, init-value=D_ZERO_CNT_U8}, provided-interface=Count_Cnt_u08
      ISDYNCDS34DMsgRxTime: unqueued-sender-com-spec{data-element=MSec_u32, can-invalidate=false, init-value=D_ZERO_CNT_U32}, provided-interface=Time_MSec_u32
      ISDYNCMM208MsgDLCError: unqueued-sender-com-spec{data-element=Cnt_u08, can-invalidate=false, init-value=D_ZERO_CNT_U8}, provided-interface=Count_Cnt_u08
      ISDYNCMM208MsgRxTime: unqueued-sender-com-spec{data-element=MSec_u32, can-invalidate=false, init-value=D_ZERO_CNT_U32}, provided-interface=Time_MSec_u32
      ISDYNCMM388MsgDLCError: unqueued-sender-com-spec{data-element=Cnt_u08, can-invalidate=false, init-value=D_ZERO_CNT_U8}, provided-interface=Count_Cnt_u08
      ISDYNCMM388MsgRxTime: unqueued-sender-com-spec{data-element=MSec_u32, can-invalidate=false, init-value=D_ZERO_CNT_U32}, provided-interface=Time_MSec_u32
      ISDYNVOLMsg: unqueued-sender-com-spec{data-element=Cnt_u08, can-invalidate=false, init-value=T_CANMSGINIT_CNT_U08}, provided-interface=CanMsg_Cnt_u08
      ISDYNVOLMsgDLCError: unqueued-sender-com-spec{data-element=Cnt_u08, can-invalidate=false, init-value=D_ZERO_CNT_U8}, provided-interface=Count_Cnt_u08
      ISDYNVOLMsgRxTime: unqueued-sender-com-spec{data-element=MSec_u32, can-invalidate=false, init-value=D_ZERO_CNT_U32}, provided-interface=Time_MSec_u32
      ISINTEELECTRONBSIMsgRxTime: unqueued-sender-com-spec{data-element=MSec_u32, can-invalidate=false, init-value=D_ZERO_CNT_U32}, provided-interface=Time_MSec_u32
      JourEcoule: unqueued-sender-com-spec{data-element=Cnt_u16, can-invalidate=false, init-value=D_ZERO_CNT_U16}, provided-interface=Count_Cnt_u16
      Kilometrage: unqueued-sender-com-spec{data-element=Cnt_u32, can-invalidate=false, init-value=D_ZERO_CNT_U32}, provided-interface=Count_Cnt_u32
      LKAState: unqueued-sender-com-spec{data-element=Cnt_u08, can-invalidate=false, init-value=D_ZERO_CNT_U8}, provided-interface=Count_Cnt_u08
      LKATrqFactReq: unqueued-sender-com-spec{data-element=Cnt_u08, can-invalidate=false, init-value=D_ZERO_CNT_U8}, provided-interface=Count_Cnt_u08
      LXAActivation: unqueued-sender-com-spec{data-element=Cnt_u08, can-invalidate=false, init-value=D_ZERO_CNT_U8}, provided-interface=Count_Cnt_u08
      ModeDiag: unqueued-sender-com-spec{data-element=Cnt_u08, can-invalidate=false, init-value=D_ZERO_CNT_U8}, provided-interface=Count_Cnt_u08
      PowerSupplies: unqueued-sender-com-spec{data-element=Cnt_u08, can-invalidate=false, init-value=D_ZERO_CNT_U8}, provided-interface=Count_Cnt_u08
      PROTOHS1DYNUCF5CDMsg: unqueued-sender-com-spec{data-element=Cnt_u08, can-invalidate=false, init-value=T_CANMSGINIT_CNT_U08}, provided-interface=CanMsg_Cnt_u08
      PROTOHS1DYNUCF5CDMsgDLCError: unqueued-sender-com-spec{data-element=Cnt_u08, can-invalidate=false, init-value=D_ZERO_CNT_U8}, provided-interface=Count_Cnt_u08
      PROTOHS1DYNUCF5CDMsgRxTime: unqueued-sender-com-spec{data-element=MSec_u32, can-invalidate=false, init-value=D_ZERO_CNT_U32}, provided-interface=Time_MSec_u32
      RegulABR: unqueued-sender-com-spec{data-element=Cnt_u08, can-invalidate=false, init-value=D_ZERO_CNT_U8}, provided-interface=Count_Cnt_u08
      RegulESP: unqueued-sender-com-spec{data-element=Cnt_u08, can-invalidate=false, init-value=D_ZERO_CNT_U8}, provided-interface=Count_Cnt_u08
      ReqLampeDefEsp: unqueued-sender-com-spec{data-element=Cnt_u08, can-invalidate=false, init-value=D_ZERO_CNT_U8}, provided-interface=Count_Cnt_u08
      ReqModeDA: unqueued-sender-com-spec{data-element=Cnt_u08, can-invalidate=false, init-value=D_ZERO_CNT_U8}, provided-interface=Count_Cnt_u08
      SecondeEcoulee: unqueued-sender-com-spec{data-element=Cnt_u32, can-invalidate=false, init-value=D_ZERO_CNT_U32}, provided-interface=Count_Cnt_u32
      ShuntPosition: unqueued-sender-com-spec{data-element=Cnt_u08, can-invalidate=false, init-value=D_ZERO_CNT_U8}, provided-interface=Count_Cnt_u08
      SrlComDriver_SCom: provided-interface=SrlComDriver_SCom
        provided-com-specs:
          operation=ElecIntStart, queue-length=1
          operation=ElecIntStop, queue-length=1
          operation=GetBusOffCounter, queue-length=1
          operation=SendMsgOnChange, queue-length=1
      TxEnabled: unqueued-sender-com-spec{data-element=Cnt_lgc, can-invalidate=false, init-value=D_FALSE_CNT_LGC}, provided-interface=BoolStatusFlag_Cnt_lgc
      VitesseVehicleBV: unqueued-sender-com-spec{data-element=Cnt_u16, can-invalidate=false, init-value=D_ZERO_CNT_U16}, provided-interface=Count_Cnt_u16
    21 x require port:
      AvgFricLrnData: required-com-specs=[EraseBlock, GetErrorStatus, InvalidateNvBlock, ReadBlock, SetRamBlockStatus, WriteBlock], required-interface=NvM_AC3_SRBS_Srv
      CAVHCSelected: unqueued-receiver-com-spec{data-element=Cnt_lgc, init-value=D_FALSE_CNT_LGC}, required-interface=BoolStatusFlag_Cnt_lgc
      CityParkSelected: unqueued-receiver-com-spec{data-element=Cnt_lgc, init-value=D_FALSE_CNT_LGC}, required-interface=Enable_Cnt_lgc
      DemIf: required-com-specs=[DemShutdown, RestartDem, SetEventStatus, SetOperationCycleState, VehSpdControl], required-interface=DemIf
      ElectronicIntegration: unqueued-receiver-com-spec{data-element=Cnt_lgc, init-value=D_FALSE_CNT_LGC}, required-interface=BoolStatusFlag_Cnt_lgc
      ESCOffsCfgSeld: unqueued-receiver-com-spec{data-element=Cnt_lgc, init-value=D_FALSE_CNT_LGC}, required-interface=BoolStatusFlag_Cnt_lgc
      IS_DAT_DIRA: client-com-spec=Get, required-interface=IS_DAT_DIRA
      IS_DYN_DAE: client-com-spec=Get, required-interface=IS_DYN_DAE
      IS_DYN_VOL: client-com-spec=Get, required-interface=IS_DYN_VOL
      IS_SUPV_DIRA: client-com-spec=Get, required-interface=IS_SUPV_DIRA
      LearnedEOT: required-com-specs=[EraseBlock, GetErrorStatus, InvalidateNvBlock, ReadBlock, SetRamBlockStatus, WriteBlock], required-interface=NvM_AC3_SRBS_Srv
      LXASelected: unqueued-receiver-com-spec{data-element=Cnt_lgc, init-value=D_FALSE_CNT_LGC}, required-interface=Enable_Cnt_lgc
      MotPosReset: required-com-specs=[EraseBlock, GetErrorStatus, InvalidateNvBlock, ReadBlock, SetRamBlockStatus, WriteBlock], required-interface=NvM_AC3_SRBS_Srv
      MultimodeSelected: unqueued-receiver-com-spec{data-element=Cnt_lgc, init-value=D_FALSE_CNT_LGC}, required-interface=Enable_Cnt_lgc
      NxtrDiagMgr: required-com-specs=[GetNTCActive, GetNTCFailed, GetNTCStatus, SetNTCStatus], required-interface=NxtrDiagMgr
      PsaAgArbnLrndOffsBlk: required-com-specs=[EraseBlock, GetErrorStatus, InvalidateNvBlock, ReadBlock, SetRamBlockStatus, WriteBlock], required-interface=NvM_AC3_SRBS_Srv
      STTdSelected: unqueued-receiver-com-spec{data-element=Cnt_lgc, init-value=D_FALSE_CNT_LGC}, required-interface=Enable_Cnt_lgc
      SystemState: required-interface=SystemState
      SystemTime: required-interface=SystemTime
        required-com-specs:
          DtrmnElapsedTime_mS_u16
          DtrmnElapsedTime_mS_u32
          DtrmnElapsedTime_uS_u16
          DtrmnElapsedTime_uS_u32
          GetSystemTime_mS_u32
          GetSystemTime_uS_u32
      TMFTestComplete: unqueued-receiver-com-spec{data-element=Cnt_lgc, init-value=D_FALSE_CNT_LGC}, required-interface=BoolStatusFlag_Cnt_lgc
      VVHType: unqueued-receiver-com-spec{data-element=Cnt_u08, init-value=D_ZERO_CNT_U8}, required-interface=Count_Cnt_u08
  internal behavior Cd_SrlComDriver_InternalBehavior: component=Cd_SrlComDriver
    timing event SrlComDriver_Init1_InitEvent: start-on-event=SrlComDriver_Init1, period=0
    timing event TMT_SrlComDriver_Per1: start-on-event=SrlComDriver_Per1, period=0.005
    4 x operation invoked event:
      OIT_SrlComDriver_SCom_ElecIntStart_SrlComDriver_SCom_ElecIntStart: start-on-event=SrlComDriver_SCom_ElecIntStart, operation=SrlComDriver_SCom.ElecIntStart
      OIT_SrlComDriver_SCom_ElecIntStop_SrlComDriver_SCom_ElecIntStop: start-on-event=SrlComDriver_SCom_ElecIntStop, operation=SrlComDriver_SCom.ElecIntStop
      OIT_SrlComDriver_SCom_GetBusOffCounter_SrlComDriver_SCom_GetBusOffCounter: start-on-event=SrlComDriver_SCom_GetBusOffCounter, operation=SrlComDriver_SCom.GetBusOffCounter
      OIT_SrlComDriver_SCom_SendMsgOnChange_SrlComDriver_SCom_SendMsgOnChange: start-on-event=SrlComDriver_SCom_SendMsgOnChange, operation=SrlComDriver_SCom.SendMsgOnChange
    mode switch event MST_SrlComDriver_Trns1_0: start-on-event=SrlComDriver_Trns1, activation=EXIT, mode=SystemState.Mode.OFF
    mode switch event MST_SrlComDriver_Trns2_0: start-on-event=SrlComDriver_Trns2, activation=ENTRY, mode=SystemState.Mode.OFF
    exclusive area BusOff
    port-api-options:
      enable-take-address=false, indirect-api=false, port=AccelLat
      enable-take-address=false, indirect-api=false, port=AnneeEcoule
      enable-take-address=false, indirect-api=false, port=AvgFricLrnData
      enable-take-address=false, indirect-api=false, port=BusOff
      enable-take-address=false, indirect-api=false, port=CAVHCSelected
      enable-take-address=false, indirect-api=false, port=CityParkSelected
      enable-take-address=false, indirect-api=false, port=ColumnAngleSetpoint
      enable-take-address=false, indirect-api=false, port=CompteurTemporelVehicule
      enable-take-address=false, indirect-api=false, port=ComputerRazGCT
      enable-take-address=false, indirect-api=false, port=ConfigVhl
      enable-take-address=false, indirect-api=false, port=DemIf
      enable-take-address=false, indirect-api=false, port=DiagIntegraElec
      enable-take-address=false, indirect-api=false, port=DiagMuxOn
      enable-take-address=false, indirect-api=false, port=DmdDelestDA
      enable-take-address=false, indirect-api=false, port=EffacDefaultDiag
      enable-take-address=false, indirect-api=false, port=ElectronicIntegration
      enable-take-address=false, indirect-api=false, port=ESCOffsCfgSeld
      enable-take-address=false, indirect-api=false, port=ESPDeconnecte
      enable-take-address=false, indirect-api=false, port=EtatMT
      enable-take-address=false, indirect-api=false, port=EtatPrincipSev
      enable-take-address=false, indirect-api=false, port=EtatReseauElec
      enable-take-address=false, indirect-api=false, port=IS_DAT_DIRA
      enable-take-address=false, indirect-api=false, port=IS_DYN_DAE
      enable-take-address=false, indirect-api=false, port=IS_DYN_VOL
      enable-take-address=false, indirect-api=false, port=IS_SUPV_DIRA
      enable-take-address=false, indirect-api=false, port=ISDAT4V2BSI552MsgDLCError
      enable-take-address=false, indirect-api=false, port=ISDAT4V2BSI552MsgRxTime
      enable-take-address=false, indirect-api=false, port=ISDATABR50DMsgDLCError
      enable-take-address=false, indirect-api=false, port=ISDATABR50DMsgRxTime
      enable-take-address=false, indirect-api=false, port=ISDATBSI3F2MsgDLCError
      enable-take-address=false, indirect-api=false, port=ISDATBSI3F2MsgRxTime
      enable-take-address=false, indirect-api=false, port=ISDATBSI412MsgDLCError
      enable-take-address=false, indirect-api=false, port=ISDATBSI412MsgRxTime
      enable-take-address=false, indirect-api=false, port=ISDATBSI432MsgDLCError
      enable-take-address=false, indirect-api=false, port=ISDATBSI432MsgRxTime
      enable-take-address=false, indirect-api=false, port=ISDATBSI572MsgDLCError
      enable-take-address=false, indirect-api=false, port=ISDATBSI572MsgRxTime
      enable-take-address=false, indirect-api=false, port=ISDATDIRAMsgTxInProgress
      enable-take-address=false, indirect-api=false, port=ISDATDIRAMsgTxTime
      enable-take-address=false, indirect-api=false, port=ISDYN2CMMMsgDLCError
      enable-take-address=false, indirect-api=false, port=ISDYN2CMMMsgRxTime
      enable-take-address=false, indirect-api=false, port=ISDYN2FRE3CDMsgDLCError
      enable-take-address=false, indirect-api=false, port=ISDYN2FRE3CDMsgRxTime
      enable-take-address=false, indirect-api=false, port=ISDYNAASMsg
      enable-take-address=false, indirect-api=false, port=ISDYNAASMsgDLCError
      enable-take-address=false, indirect-api=false, port=ISDYNAASMsgRxTime
      enable-take-address=false, indirect-api=false, port=ISDYNABRMsg
      enable-take-address=false, indirect-api=false, port=ISDYNABRMsgDLCError
      enable-take-address=false, indirect-api=false, port=ISDYNABRMsgRxTime
      enable-take-address=false, indirect-api=false, port=ISDYNCDS34DMsgDLCError
      enable-take-address=false, indirect-api=false, port=ISDYNCDS34DMsgRxTime
      enable-take-address=false, indirect-api=false, port=ISDYNCMM208MsgDLCError
      enable-take-address=false, indirect-api=false, port=ISDYNCMM208MsgRxTime
      enable-take-address=false, indirect-api=false, port=ISDYNCMM388MsgDLCError
      enable-take-address=false, indirect-api=false, port=ISDYNCMM388MsgRxTime
      enable-take-address=false, indirect-api=false, port=ISDYNVOLMsg
      enable-take-address=false, indirect-api=false, port=ISDYNVOLMsgDLCError
      enable-take-address=false, indirect-api=false, port=ISDYNVOLMsgRxTime
      enable-take-address=false, indirect-api=false, port=ISINTEELECTRONBSIMsgRxTime
      enable-take-address=false, indirect-api=false, port=JourEcoule
      enable-take-address=false, indirect-api=false, port=Kilometrage
      enable-take-address=false, indirect-api=false, port=LearnedEOT
      enable-take-address=false, indirect-api=false, port=LKAState
      enable-take-address=false, indirect-api=false, port=LKATrqFactReq
      enable-take-address=false, indirect-api=false, port=LXAActivation
      enable-take-address=false, indirect-api=false, port=LXASelected
      enable-take-address=false, indirect-api=false, port=ModeDiag
      enable-take-address=false, indirect-api=false, port=MotPosReset
      enable-take-address=false, indirect-api=false, port=MultimodeSelected
      enable-take-address=false, indirect-api=false, port=NxtrDiagMgr
      enable-take-address=false, indirect-api=false, port=PowerSupplies
      enable-take-address=false, indirect-api=false, port=PROTOHS1DYNUCF5CDMsg
      enable-take-address=false, indirect-api=false, port=PROTOHS1DYNUCF5CDMsgDLCError
      enable-take-address=false, indirect-api=false, port=PROTOHS1DYNUCF5CDMsgRxTime
      enable-take-address=false, indirect-api=false, port=PsaAgArbnLrndOffsBlk
      enable-take-address=false, indirect-api=false, port=RegulABR
      enable-take-address=false, indirect-api=false, port=RegulESP
      enable-take-address=false, indirect-api=false, port=ReqLampeDefEsp
      enable-take-address=false, indirect-api=false, port=ReqModeDA
      enable-take-address=false, indirect-api=false, port=SecondeEcoulee
      enable-take-address=false, indirect-api=false, port=ShuntPosition
      enable-take-address=false, indirect-api=false, port=SrlComDriver_SCom
      enable-take-address=false, indirect-api=false, port=STTdSelected
      enable-take-address=false, indirect-api=false, port=SystemState
      enable-take-address=false, indirect-api=false, port=SystemTime
      enable-take-address=false, indirect-api=false, port=TMFTestComplete
      enable-take-address=false, indirect-api=false, port=TxEnabled
      enable-take-address=false, indirect-api=false, port=VitesseVehicleBV
      enable-take-address=false, indirect-api=false, port=VVHType
    8 x runnable:
      SrlComDriver_Init1
        6 x data read access:
          READ_CAVHCSelected_Cnt_lgc: data-element=CAVHCSelected.Cnt_lgc
          READ_CityParkSelected_Cnt_lgc: data-element=CityParkSelected.Cnt_lgc
          READ_ESCOffsCfgSeld_Cnt_lgc: data-element=ESCOffsCfgSeld.Cnt_lgc
          READ_LXASelected_Cnt_lgc: data-element=LXASelected.Cnt_lgc
          READ_MultimodeSelected_Cnt_lgc: data-element=MultimodeSelected.Cnt_lgc
          READ_STTdSelected_Cnt_lgc: data-element=STTdSelected.Cnt_lgc
        sync call SC_SystemTime_GetSystemTime_mS_u32: operation=SystemTime.GetSystemTime_mS_u32, timeout=0
      SrlComDriver_Per1: can-enter-exclusive-area=BusOff
        data read access READ_ElectronicIntegration_Cnt_lgc: data-element=ElectronicIntegration.Cnt_lgc
        data read access READ_TMFTestComplete_Cnt_lgc: data-element=TMFTestComplete.Cnt_lgc
        data receive point REC_VVHType_Cnt_u08: data-element=VVHType.Cnt_u08
        65 x data send point:
          SEND_AccelLat_Cnt_s16: data-element=AccelLat.Cnt_s16
          SEND_AnneeEcoule_Cnt_u08: data-element=AnneeEcoule.Cnt_u08
          SEND_ColumnAngleSetpoint_Cnt_u16: data-element=ColumnAngleSetpoint.Cnt_u16
          SEND_CompteurTemporelVehicule_Cnt_u32: data-element=CompteurTemporelVehicule.Cnt_u32
          SEND_ComputerRazGCT_Cnt_u08: data-element=ComputerRazGCT.Cnt_u08
          SEND_ConfigVhl_Cnt_u08: data-element=ConfigVhl.Cnt_u08
          SEND_DiagIntegraElec_Cnt_u08: data-element=DiagIntegraElec.Cnt_u08
          SEND_DiagMuxOn_Cnt_u08: data-element=DiagMuxOn.Cnt_u08
          SEND_DmdDelestDA_Cnt_u08: data-element=DmdDelestDA.Cnt_u08
          SEND_EffacDefaultDiag_Cnt_u08: data-element=EffacDefaultDiag.Cnt_u08
          SEND_ESPDeconnecte_Cnt_u08: data-element=ESPDeconnecte.Cnt_u08
          SEND_EtatMT_Cnt_u08: data-element=EtatMT.Cnt_u08
          SEND_EtatPrincipSev_Cnt_u08: data-element=EtatPrincipSev.Cnt_u08
          SEND_EtatReseauElec_Cnt_u08: data-element=EtatReseauElec.Cnt_u08
          SEND_ISDAT4V2BSI552MsgDLCError_Cnt_u08: data-element=ISDAT4V2BSI552MsgDLCError.Cnt_u08
          SEND_ISDAT4V2BSI552MsgRxTime_MSec_u32: data-element=ISDAT4V2BSI552MsgRxTime.MSec_u32
          SEND_ISDATABR50DMsgDLCError_Cnt_u08: data-element=ISDATABR50DMsgDLCError.Cnt_u08
          SEND_ISDATABR50DMsgRxTime_MSec_u32: data-element=ISDATABR50DMsgRxTime.MSec_u32
          SEND_ISDATBSI3F2MsgDLCError_Cnt_u08: data-element=ISDATBSI3F2MsgDLCError.Cnt_u08
          SEND_ISDATBSI3F2MsgRxTime_MSec_u32: data-element=ISDATBSI3F2MsgRxTime.MSec_u32
          SEND_ISDATBSI412MsgDLCError_Cnt_u08: data-element=ISDATBSI412MsgDLCError.Cnt_u08
          SEND_ISDATBSI412MsgRxTime_MSec_u32: data-element=ISDATBSI412MsgRxTime.MSec_u32
          SEND_ISDATBSI432MsgDLCError_Cnt_u08: data-element=ISDATBSI432MsgDLCError.Cnt_u08
          SEND_ISDATBSI432MsgRxTime_MSec_u32: data-element=ISDATBSI432MsgRxTime.MSec_u32
          SEND_ISDATBSI572MsgDLCError_Cnt_u08: data-element=ISDATBSI572MsgDLCError.Cnt_u08
          SEND_ISDATBSI572MsgRxTime_MSec_u32: data-element=ISDATBSI572MsgRxTime.MSec_u32
          SEND_ISDATDIRAMsgTxInProgress_Cnt_lgc: data-element=ISDATDIRAMsgTxInProgress.Cnt_lgc
          SEND_ISDATDIRAMsgTxTime_MSec_u32: data-element=ISDATDIRAMsgTxTime.MSec_u32
          SEND_ISDYN2CMMMsgDLCError_Cnt_u08: data-element=ISDYN2CMMMsgDLCError.Cnt_u08
          SEND_ISDYN2CMMMsgRxTime_MSec_u32: data-element=ISDYN2CMMMsgRxTime.MSec_u32
          SEND_ISDYN2FRE3CDMsgDLCError_Cnt_u08: data-element=ISDYN2FRE3CDMsgDLCError.Cnt_u08
          SEND_ISDYN2FRE3CDMsgRxTime_MSec_u32: data-element=ISDYN2FRE3CDMsgRxTime.MSec_u32
          SEND_ISDYNAASMsg_Cnt_u08: data-element=ISDYNAASMsg.Cnt_u08
          SEND_ISDYNAASMsgDLCError_Cnt_u08: data-element=ISDYNAASMsgDLCError.Cnt_u08
          SEND_ISDYNAASMsgRxTime_MSec_u32: data-element=ISDYNAASMsgRxTime.MSec_u32
          SEND_ISDYNABRMsg_Cnt_u08: data-element=ISDYNABRMsg.Cnt_u08
          SEND_ISDYNABRMsgDLCError_Cnt_u08: data-element=ISDYNABRMsgDLCError.Cnt_u08
          SEND_ISDYNABRMsgRxTime_MSec_u32: data-element=ISDYNABRMsgRxTime.MSec_u32
          SEND_ISDYNCDS34DMsgDLCError_Cnt_u08: data-element=ISDYNCDS34DMsgDLCError.Cnt_u08
          SEND_ISDYNCDS34DMsgRxTime_MSec_u32: data-element=ISDYNCDS34DMsgRxTime.MSec_u32
          SEND_ISDYNCMM208MsgDLCError_Cnt_u08: data-element=ISDYNCMM208MsgDLCError.Cnt_u08
          SEND_ISDYNCMM208MsgRxTime_MSec_u32: data-element=ISDYNCMM208MsgRxTime.MSec_u32
          SEND_ISDYNCMM388MsgDLCError_Cnt_u08: data-element=ISDYNCMM388MsgDLCError.Cnt_u08
          SEND_ISDYNCMM388MsgRxTime_MSec_u32: data-element=ISDYNCMM388MsgRxTime.MSec_u32
          SEND_ISDYNVOLMsg_Cnt_u08: data-element=ISDYNVOLMsg.Cnt_u08
          SEND_ISDYNVOLMsgDLCError_Cnt_u08: data-element=ISDYNVOLMsgDLCError.Cnt_u08
          SEND_ISDYNVOLMsgRxTime_MSec_u32: data-element=ISDYNVOLMsgRxTime.MSec_u32
          SEND_ISINTEELECTRONBSIMsgRxTime_MSec_u32: data-element=ISINTEELECTRONBSIMsgRxTime.MSec_u32
          SEND_JourEcoule_Cnt_u16: data-element=JourEcoule.Cnt_u16
          SEND_Kilometrage_Cnt_u32: data-element=Kilometrage.Cnt_u32
          SEND_LKAState_Cnt_u08: data-element=LKAState.Cnt_u08
          SEND_LKATrqFactReq_Cnt_u08: data-element=LKATrqFactReq.Cnt_u08
          SEND_LXAActivation_Cnt_u08: data-element=LXAActivation.Cnt_u08
          SEND_ModeDiag_Cnt_u08: data-element=ModeDiag.Cnt_u08
          SEND_PowerSupplies_Cnt_u08: data-element=PowerSupplies.Cnt_u08
          SEND_PROTOHS1DYNUCF5CDMsg_Cnt_u08: data-element=PROTOHS1DYNUCF5CDMsg.Cnt_u08
          SEND_PROTOHS1DYNUCF5CDMsgDLCError_Cnt_u08: data-element=PROTOHS1DYNUCF5CDMsgDLCError.Cnt_u08
          SEND_PROTOHS1DYNUCF5CDMsgRxTime_MSec_u32: data-element=PROTOHS1DYNUCF5CDMsgRxTime.MSec_u32
          SEND_RegulABR_Cnt_u08: data-element=RegulABR.Cnt_u08
          SEND_RegulESP_Cnt_u08: data-element=RegulESP.Cnt_u08
          SEND_ReqLampeDefEsp_Cnt_u08: data-element=ReqLampeDefEsp.Cnt_u08
          SEND_ReqModeDA_Cnt_u08: data-element=ReqModeDA.Cnt_u08
          SEND_SecondeEcoulee_Cnt_u32: data-element=SecondeEcoulee.Cnt_u32
          SEND_ShuntPosition_Cnt_u08: data-element=ShuntPosition.Cnt_u08
          SEND_VitesseVehicleBV_Cnt_u16: data-element=VitesseVehicleBV.Cnt_u16
        data write access WRITE_BusOff_Cnt_lgc: data-element=BusOff.Cnt_lgc
        data write access WRITE_TxEnabled_Cnt_lgc: data-element=TxEnabled.Cnt_lgc
        12 x sync call, all with timeout=0:
          SC_AvgFricLrnData_GetErrorStatus: operation=AvgFricLrnData.GetErrorStatus
          SC_DemIf_VehSpdControl: operation=DemIf.VehSpdControl
          SC_IS_DAT_DIRA_Get: operation=IS_DAT_DIRA.Get
          SC_IS_DYN_DAE_Get: operation=IS_DYN_DAE.Get
          SC_IS_DYN_VOL_Get: operation=IS_DYN_VOL.Get
          SC_IS_SUPV_DIRA_Get: operation=IS_SUPV_DIRA.Get
          SC_LearnedEOT_GetErrorStatus: operation=LearnedEOT.GetErrorStatus
          SC_MotPosReset_GetErrorStatus: operation=MotPosReset.GetErrorStatus
          SC_NxtrDiagMgr_SetNTCStatus: operation=NxtrDiagMgr.SetNTCStatus
          SC_PsaAgArbnLrndOffsBlk_GetErrorStatus: operation=PsaAgArbnLrndOffsBlk.GetErrorStatus
          SC_SystemTime_DtrmnElapsedTime_mS_u16: operation=SystemTime.DtrmnElapsedTime_mS_u16
          SC_SystemTime_GetSystemTime_mS_u32: operation=SystemTime.GetSystemTime_mS_u32
      SrlComDriver_SCom_ElecIntStart
      SrlComDriver_SCom_ElecIntStop
      SrlComDriver_SCom_GetBusOffCounter: can-enter-exclusive-area=BusOff
      SrlComDriver_SCom_SendMsgOnChange
        sync call SC_IS_SUPV_DIRA_Get: operation=IS_SUPV_DIRA.Get, timeout=0
      SrlComDriver_Trns1
      SrlComDriver_Trns2
  swc implementation Cd_SrlComDriver_Implementation: behavior=Cd_SrlComDriver_InternalBehavior
    code-descriptors:
      code Code: type=SRC
