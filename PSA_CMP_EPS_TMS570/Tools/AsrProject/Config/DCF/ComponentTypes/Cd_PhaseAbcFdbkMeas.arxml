AUTOSAR XML (schema 314)
package /ComponentType
  complex device driver component type Cd_PhaseAbcFdbkMeas
    4 x provide port:
      Get_PhaseFdbk: server-com-spec{operation=PhaseFdbk, queue-length=1}, provided-interface=Get_PhaseFdbk
      MeasuredOnTimeA: unqueued-sender-com-spec{data-element=Cnt_u32, can-invalidate=false, init-value=D_ZERO_CNT_U32}, provided-interface=Count_Cnt_u32
      MeasuredOnTimeB: unqueued-sender-com-spec{data-element=Cnt_u32, can-invalidate=false, init-value=D_ZERO_CNT_U32}, provided-interface=Count_Cnt_u32
      MeasuredOnTimeC: unqueued-sender-com-spec{data-element=Cnt_u32, can-invalidate=false, init-value=D_ZERO_CNT_U32}, provided-interface=Count_Cnt_u32
  internal behavior Cd_PhaseAbcFdbkMeas_InternalBehavior: component=Cd_PhaseAbcFdbkMeas
    timing event Cd_PhaseAbcFdbkMeas_Init2_InitEvent: start-on-event=Cd_PhaseAbcFdbkMeas_Init2, period=0
    timing event TMT_Cd_PhaseAbcFdbkMeas_Per1: start-on-event=Cd_PhaseAbcFdbkMeas_Per1, period=0.002
    operation invoked event OIT_Get_PhaseAbcFdbkMeas_PhaseFdbk_Get_PhaseFdbk_PhaseFdbk: start-on-event=Get_PhaseAbcFdbkMeas_PhaseFdbk, operation=Get_PhaseFdbk.PhaseFdbk
    port-api-options:
      enable-take-address=false, indirect-api=false, port=Get_PhaseFdbk
      enable-take-address=false, indirect-api=false, port=MeasuredOnTimeA
      enable-take-address=false, indirect-api=false, port=MeasuredOnTimeB
      enable-take-address=false, indirect-api=false, port=MeasuredOnTimeC
    runnable Cd_PhaseAbcFdbkMeas_Init2
    runnable Cd_PhaseAbcFdbkMeas_Per1
      data write access WRITE_MeasuredOnTimeA_Cnt_u32: data-element=MeasuredOnTimeA.Cnt_u32
      data write access WRITE_MeasuredOnTimeB_Cnt_u32: data-element=MeasuredOnTimeB.Cnt_u32
      data write access WRITE_MeasuredOnTimeC_Cnt_u32: data-element=MeasuredOnTimeC.Cnt_u32
    runnable Get_PhaseAbcFdbkMeas_PhaseFdbk
  swc implementation Cd_PhaseAbcFdbkMeas_Implementation: behavior=Cd_PhaseAbcFdbkMeas_InternalBehavior
    code-descriptors:
      code Code: type=SRC
