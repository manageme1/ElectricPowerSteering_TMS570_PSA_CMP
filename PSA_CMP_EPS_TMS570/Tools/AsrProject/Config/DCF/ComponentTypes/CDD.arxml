AUTOSAR XML (schema 314)
package /ComponentType
  internal behavior CDD_InternalBehavior: component=CDD, port-api-option{enable-take-address=false, indirect-api=false, port=CDDPorts}
    timing event TMT_Cdd_DummyFunction: start-on-event=Cdd_DummyFunction, period=0.01
    operation invoked event OIT_CDDPorts_ApplyMtrElecMechPol_CDDPorts_ApplyMtrElecMechPol: start-on-event=CDDPorts_ApplyMtrElecMechPol, operation=CDDPorts.ApplyMtrElecMechPol
    operation invoked event OIT_CDDPorts_ClearPhsReasSum_CDDPorts_ClearPhsReasSum: start-on-event=CDDPorts_ClearPhsReasSum, operation=CDDPorts.ClearPhsReasSum
    runnable Cdd_DummyFunction
    runnable CDDPorts_ApplyMtrElecMechPol: can-be-invoked-concurrently=true
    runnable CDDPorts_ClearPhsReasSum
  service component type CDD: category=ServiceComponent
    provide port CDDPorts: provided-com-specs=[{operation=ApplyMtrElecMechPol, queue-length=1}, {operation=ClearPhsReasSum, queue-length=1}], provided-interface=CDDPorts
  swc implementation CDD_Implementation: behavior=CDD_InternalBehavior
    code-descriptors:
      code Code: type=SRC
