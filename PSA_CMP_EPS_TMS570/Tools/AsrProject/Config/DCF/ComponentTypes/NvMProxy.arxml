AUTOSAR XML (schema 314)
package /ComponentType
  internal behavior NvMProxy_InternalBehavior: component=NvMProxy
    22 x operation invoked event, all with start-on-event=GetErrorStatus:
      OIT_GetErrorStatus_PS_NvMP_NvmBlock_AvgFricLrnData_GetErrorStatus: operation=PS_NvMP_NvmBlock_AvgFricLrnData.GetErrorStatus
      OIT_GetErrorStatus_PS_NvMP_NvmBlock_CloseCheckData_GetErrorStatus: operation=PS_NvMP_NvmBlock_CloseCheckData.GetErrorStatus
      OIT_GetErrorStatus_PS_NvMP_NvmBlock_CogTrqCal_GetErrorStatus: operation=PS_NvMP_NvmBlock_CogTrqCal.GetErrorStatus
      OIT_GetErrorStatus_PS_NvMP_NvmBlock_CogTrqRplComp_GetErrorStatus: operation=PS_NvMP_NvmBlock_CogTrqRplComp.GetErrorStatus
      OIT_GetErrorStatus_PS_NvMP_NvmBlock_CurrTempOffset_GetErrorStatus: operation=PS_NvMP_NvmBlock_CurrTempOffset.GetErrorStatus
      OIT_GetErrorStatus_PS_NvMP_NvmBlock_DigMSBEOLData_GetErrorStatus: operation=PS_NvMP_NvmBlock_DigMSBEOLData.GetErrorStatus
      OIT_GetErrorStatus_PS_NvMP_NvmBlock_ElecIntData_GetErrorStatus: operation=PS_NvMP_NvmBlock_ElecIntData.GetErrorStatus
      OIT_GetErrorStatus_PS_NvMP_NvmBlock_EOLNomMtrParam_GetErrorStatus: operation=PS_NvMP_NvmBlock_EOLNomMtrParam.GetErrorStatus
      OIT_GetErrorStatus_PS_NvMP_NvmBlock_EOLVehCntrOffset_GetErrorStatus: operation=PS_NvMP_NvmBlock_EOLVehCntrOffset.GetErrorStatus
      OIT_GetErrorStatus_PS_NvMP_NvmBlock_FltStVal_GetErrorStatus: operation=PS_NvMP_NvmBlock_FltStVal.GetErrorStatus
      OIT_GetErrorStatus_PS_NvMP_NvmBlock_HwTqArbnEOLCh1OffsetTrimData_GetErrorStatus: operation=PS_NvMP_NvmBlock_HwTqArbnEOLCh1OffsetTrimData.GetErrorStatus
      OIT_GetErrorStatus_PS_NvMP_NvmBlock_HwTqCorrlnCh1CMCLPFSvData_GetErrorStatus: operation=PS_NvMP_NvmBlock_HwTqCorrlnCh1CMCLPFSvData.GetErrorStatus
      OIT_GetErrorStatus_PS_NvMP_NvmBlock_LearnedEOT_GetErrorStatus: operation=PS_NvMP_NvmBlock_LearnedEOT.GetErrorStatus
      OIT_GetErrorStatus_PS_NvMP_NvmBlock_MotPosReset_GetErrorStatus: operation=PS_NvMP_NvmBlock_MotPosReset.GetErrorStatus
      OIT_GetErrorStatus_PS_NvMP_NvmBlock_OvervoltageData_GetErrorStatus: operation=PS_NvMP_NvmBlock_OvervoltageData.GetErrorStatus
      OIT_GetErrorStatus_PS_NvMP_NvmBlock_Polarity_GetErrorStatus: operation=PS_NvMP_NvmBlock_Polarity.GetErrorStatus
      OIT_GetErrorStatus_PS_NvMP_NvmBlock_PsaAgArbnPsaAgArbnLrndOffsData_GetErrorStatus: operation=PS_NvMP_NvmBlock_PsaAgArbnPsaAgArbnLrndOffsData.GetErrorStatus
      OIT_GetErrorStatus_PS_NvMP_NvmBlock_ShCurrCal_GetErrorStatus: operation=PS_NvMP_NvmBlock_ShCurrCal.GetErrorStatus
      OIT_GetErrorStatus_PS_NvMP_NvmBlock_ShutdownTimeData_GetErrorStatus: operation=PS_NvMP_NvmBlock_ShutdownTimeData.GetErrorStatus
      OIT_GetErrorStatus_PS_NvMP_NvmBlock_TorqueCmdSF_GetErrorStatus: operation=PS_NvMP_NvmBlock_TorqueCmdSF.GetErrorStatus
      OIT_GetErrorStatus_PS_NvMP_NvmBlock_TypeHRamBuffer_GetErrorStatus: operation=PS_NvMP_NvmBlock_TypeHRamBuffer.GetErrorStatus
      OIT_GetErrorStatus_PS_NvMP_NvmBlock_VVHTYPEData_GetErrorStatus: operation=PS_NvMP_NvmBlock_VVHTYPEData.GetErrorStatus
    timing event TMT_NvMProxy_MainFunction: start-on-event=NvMProxy_MainFunction, period=0.01
    45 x operation invoked event:
      OIT_SetRamBlockStatus_PS_NvMP_NvmBlock_AvgFricLrnData_SetRamBlockStatus: start-on-event=SetRamBlockStatus, operation=PS_NvMP_NvmBlock_AvgFricLrnData.SetRamBlockStatus
      OIT_SetRamBlockStatus_PS_NvMP_NvmBlock_CloseCheckData_SetRamBlockStatus: start-on-event=SetRamBlockStatus, operation=PS_NvMP_NvmBlock_CloseCheckData.SetRamBlockStatus
      OIT_SetRamBlockStatus_PS_NvMP_NvmBlock_CogTrqCal_SetRamBlockStatus: start-on-event=SetRamBlockStatus, operation=PS_NvMP_NvmBlock_CogTrqCal.SetRamBlockStatus
      OIT_SetRamBlockStatus_PS_NvMP_NvmBlock_CogTrqRplComp_SetRamBlockStatus: start-on-event=SetRamBlockStatus, operation=PS_NvMP_NvmBlock_CogTrqRplComp.SetRamBlockStatus
      OIT_SetRamBlockStatus_PS_NvMP_NvmBlock_CurrTempOffset_SetRamBlockStatus: start-on-event=SetRamBlockStatus, operation=PS_NvMP_NvmBlock_CurrTempOffset.SetRamBlockStatus
      OIT_SetRamBlockStatus_PS_NvMP_NvmBlock_DigMSBEOLData_SetRamBlockStatus: start-on-event=SetRamBlockStatus, operation=PS_NvMP_NvmBlock_DigMSBEOLData.SetRamBlockStatus
      OIT_SetRamBlockStatus_PS_NvMP_NvmBlock_ElecIntData_SetRamBlockStatus: start-on-event=SetRamBlockStatus, operation=PS_NvMP_NvmBlock_ElecIntData.SetRamBlockStatus
      OIT_SetRamBlockStatus_PS_NvMP_NvmBlock_EOLNomMtrParam_SetRamBlockStatus: start-on-event=SetRamBlockStatus, operation=PS_NvMP_NvmBlock_EOLNomMtrParam.SetRamBlockStatus
      OIT_SetRamBlockStatus_PS_NvMP_NvmBlock_EOLVehCntrOffset_SetRamBlockStatus: start-on-event=SetRamBlockStatus, operation=PS_NvMP_NvmBlock_EOLVehCntrOffset.SetRamBlockStatus
      OIT_SetRamBlockStatus_PS_NvMP_NvmBlock_FltStVal_SetRamBlockStatus: start-on-event=SetRamBlockStatus, operation=PS_NvMP_NvmBlock_FltStVal.SetRamBlockStatus
      OIT_SetRamBlockStatus_PS_NvMP_NvmBlock_HwTqArbnEOLCh1OffsetTrimData_SetRamBlockStatus: start-on-event=SetRamBlockStatus, operation=PS_NvMP_NvmBlock_HwTqArbnEOLCh1OffsetTrimData.SetRamBlockStatus
      OIT_SetRamBlockStatus_PS_NvMP_NvmBlock_HwTqCorrlnCh1CMCLPFSvData_SetRamBlockStatus: start-on-event=SetRamBlockStatus, operation=PS_NvMP_NvmBlock_HwTqCorrlnCh1CMCLPFSvData.SetRamBlockStatus
      OIT_SetRamBlockStatus_PS_NvMP_NvmBlock_LearnedEOT_SetRamBlockStatus: start-on-event=SetRamBlockStatus, operation=PS_NvMP_NvmBlock_LearnedEOT.SetRamBlockStatus
      OIT_SetRamBlockStatus_PS_NvMP_NvmBlock_MotPosReset_SetRamBlockStatus: start-on-event=SetRamBlockStatus, operation=PS_NvMP_NvmBlock_MotPosReset.SetRamBlockStatus
      OIT_SetRamBlockStatus_PS_NvMP_NvmBlock_OvervoltageData_SetRamBlockStatus: start-on-event=SetRamBlockStatus, operation=PS_NvMP_NvmBlock_OvervoltageData.SetRamBlockStatus
      OIT_SetRamBlockStatus_PS_NvMP_NvmBlock_Polarity_SetRamBlockStatus: start-on-event=SetRamBlockStatus, operation=PS_NvMP_NvmBlock_Polarity.SetRamBlockStatus
      OIT_SetRamBlockStatus_PS_NvMP_NvmBlock_PsaAgArbnPsaAgArbnLrndOffsData_SetRamBlockStatus: start-on-event=SetRamBlockStatus, operation=PS_NvMP_NvmBlock_PsaAgArbnPsaAgArbnLrndOffsData.SetRamBlockStatus
      OIT_SetRamBlockStatus_PS_NvMP_NvmBlock_PullCmpLTComp_SetRamBlockStatus: start-on-event=SetRamBlockStatus, operation=PS_NvMP_NvmBlock_PullCmpLTComp.SetRamBlockStatus
      OIT_SetRamBlockStatus_PS_NvMP_NvmBlock_ShCurrCal_SetRamBlockStatus: start-on-event=SetRamBlockStatus, operation=PS_NvMP_NvmBlock_ShCurrCal.SetRamBlockStatus
      OIT_SetRamBlockStatus_PS_NvMP_NvmBlock_ShutdownTimeData_SetRamBlockStatus: start-on-event=SetRamBlockStatus, operation=PS_NvMP_NvmBlock_ShutdownTimeData.SetRamBlockStatus
      OIT_SetRamBlockStatus_PS_NvMP_NvmBlock_TorqueCmdSF_SetRamBlockStatus: start-on-event=SetRamBlockStatus, operation=PS_NvMP_NvmBlock_TorqueCmdSF.SetRamBlockStatus
      OIT_SetRamBlockStatus_PS_NvMP_NvmBlock_TypeHRamBuffer_SetRamBlockStatus: start-on-event=SetRamBlockStatus, operation=PS_NvMP_NvmBlock_TypeHRamBuffer.SetRamBlockStatus
      OIT_SetRamBlockStatus_PS_NvMP_NvmBlock_VVHTYPEData_SetRamBlockStatus: start-on-event=SetRamBlockStatus, operation=PS_NvMP_NvmBlock_VVHTYPEData.SetRamBlockStatus
      OIT_WriteBlock_PS_NvMP_NvmBlock_AvgFricLrnData_WriteBlock: start-on-event=WriteBlock, operation=PS_NvMP_NvmBlock_AvgFricLrnData.WriteBlock
      OIT_WriteBlock_PS_NvMP_NvmBlock_CloseCheckData_WriteBlock: start-on-event=WriteBlock, operation=PS_NvMP_NvmBlock_CloseCheckData.WriteBlock
      OIT_WriteBlock_PS_NvMP_NvmBlock_CogTrqCal_WriteBlock: start-on-event=WriteBlock, operation=PS_NvMP_NvmBlock_CogTrqCal.WriteBlock
      OIT_WriteBlock_PS_NvMP_NvmBlock_CogTrqRplComp_WriteBlock: start-on-event=WriteBlock, operation=PS_NvMP_NvmBlock_CogTrqRplComp.WriteBlock
      OIT_WriteBlock_PS_NvMP_NvmBlock_CurrTempOffset_WriteBlock: start-on-event=WriteBlock, operation=PS_NvMP_NvmBlock_CurrTempOffset.WriteBlock
      OIT_WriteBlock_PS_NvMP_NvmBlock_DigMSBEOLData_WriteBlock: start-on-event=WriteBlock, operation=PS_NvMP_NvmBlock_DigMSBEOLData.WriteBlock
      OIT_WriteBlock_PS_NvMP_NvmBlock_ElecIntData_WriteBlock: start-on-event=WriteBlock, operation=PS_NvMP_NvmBlock_ElecIntData.WriteBlock
      OIT_WriteBlock_PS_NvMP_NvmBlock_EOLNomMtrParam_WriteBlock: start-on-event=WriteBlock, operation=PS_NvMP_NvmBlock_EOLNomMtrParam.WriteBlock
      OIT_WriteBlock_PS_NvMP_NvmBlock_EOLVehCntrOffset_WriteBlock: start-on-event=WriteBlock, operation=PS_NvMP_NvmBlock_EOLVehCntrOffset.WriteBlock
      OIT_WriteBlock_PS_NvMP_NvmBlock_FltStVal_WriteBlock: start-on-event=WriteBlock, operation=PS_NvMP_NvmBlock_FltStVal.WriteBlock
      OIT_WriteBlock_PS_NvMP_NvmBlock_HwTqArbnEOLCh1OffsetTrimData_WriteBlock: start-on-event=WriteBlock, operation=PS_NvMP_NvmBlock_HwTqArbnEOLCh1OffsetTrimData.WriteBlock
      OIT_WriteBlock_PS_NvMP_NvmBlock_HwTqCorrlnCh1CMCLPFSvData_WriteBlock: start-on-event=WriteBlock, operation=PS_NvMP_NvmBlock_HwTqCorrlnCh1CMCLPFSvData.WriteBlock
      OIT_WriteBlock_PS_NvMP_NvmBlock_LearnedEOT_WriteBlock: start-on-event=WriteBlock, operation=PS_NvMP_NvmBlock_LearnedEOT.WriteBlock
      OIT_WriteBlock_PS_NvMP_NvmBlock_MotPosReset_WriteBlock: start-on-event=WriteBlock, operation=PS_NvMP_NvmBlock_MotPosReset.WriteBlock
      OIT_WriteBlock_PS_NvMP_NvmBlock_OvervoltageData_WriteBlock: start-on-event=WriteBlock, operation=PS_NvMP_NvmBlock_OvervoltageData.WriteBlock
      OIT_WriteBlock_PS_NvMP_NvmBlock_Polarity_WriteBlock: start-on-event=WriteBlock, operation=PS_NvMP_NvmBlock_Polarity.WriteBlock
      OIT_WriteBlock_PS_NvMP_NvmBlock_PsaAgArbnPsaAgArbnLrndOffsData_WriteBlock: start-on-event=WriteBlock, operation=PS_NvMP_NvmBlock_PsaAgArbnPsaAgArbnLrndOffsData.WriteBlock
      OIT_WriteBlock_PS_NvMP_NvmBlock_ShCurrCal_WriteBlock: start-on-event=WriteBlock, operation=PS_NvMP_NvmBlock_ShCurrCal.WriteBlock
      OIT_WriteBlock_PS_NvMP_NvmBlock_ShutdownTimeData_WriteBlock: start-on-event=WriteBlock, operation=PS_NvMP_NvmBlock_ShutdownTimeData.WriteBlock
      OIT_WriteBlock_PS_NvMP_NvmBlock_TorqueCmdSF_WriteBlock: start-on-event=WriteBlock, operation=PS_NvMP_NvmBlock_TorqueCmdSF.WriteBlock
      OIT_WriteBlock_PS_NvMP_NvmBlock_TypeHRamBuffer_WriteBlock: start-on-event=WriteBlock, operation=PS_NvMP_NvmBlock_TypeHRamBuffer.WriteBlock
      OIT_WriteBlock_PS_NvMP_NvmBlock_VVHTYPEData_WriteBlock: start-on-event=WriteBlock, operation=PS_NvMP_NvmBlock_VVHTYPEData.WriteBlock
    port-api-option enable-take-address=false, indirect-api=false, port=PS_NvMP_NvmBlock_AvgFricLrnData:
      port-arg-values:
        integer literal NvM_ServiceBlockId_13: type=UInt8, value=13
    port-api-option enable-take-address=false, indirect-api=false, port=PS_NvMP_NvmBlock_CloseCheckData:
      port-arg-values:
        integer literal NvM_ServiceBlockId_4: type=UInt8, value=4
    port-api-option enable-take-address=false, indirect-api=false, port=PS_NvMP_NvmBlock_CogTrqCal:
      port-arg-values:
        integer literal NvM_ServiceBlockId_6: type=UInt8, value=6
    port-api-option enable-take-address=false, indirect-api=false, port=PS_NvMP_NvmBlock_CogTrqRplComp:
      port-arg-values:
        integer literal NvM_ServiceBlockId_10: type=UInt8, value=10
    port-api-option enable-take-address=false, indirect-api=false, port=PS_NvMP_NvmBlock_CurrTempOffset:
      port-arg-values:
        integer literal NvM_ServiceBlockId_11: type=UInt8, value=11
    port-api-option enable-take-address=false, indirect-api=false, port=PS_NvMP_NvmBlock_DigMSBEOLData:
      port-arg-values:
        integer literal NvM_ServiceBlockId_8: type=UInt8, value=8
    port-api-option enable-take-address=false, indirect-api=false, port=PS_NvMP_NvmBlock_ElecIntData:
      port-arg-values:
        integer literal NvM_ServiceBlockId_18: type=UInt8, value=18
    port-api-option enable-take-address=false, indirect-api=false, port=PS_NvMP_NvmBlock_EOLNomMtrParam:
      port-arg-values:
        integer literal NvM_ServiceBlockId_7: type=UInt8, value=7
    port-api-option enable-take-address=false, indirect-api=false, port=PS_NvMP_NvmBlock_EOLVehCntrOffset:
      port-arg-values:
        integer literal NvM_ServiceBlockId_9: type=UInt8, value=9
    port-api-option enable-take-address=false, indirect-api=false, port=PS_NvMP_NvmBlock_FltStVal:
      port-arg-values:
        integer literal NvM_ServiceBlockId_15: type=UInt8, value=15
    port-api-option enable-take-address=false, indirect-api=false, port=PS_NvMP_NvmBlock_HwTqArbnEOLCh1OffsetTrimData:
      port-arg-values:
        integer literal NvM_ServiceBlockId_21: type=UInt8, value=21
    port-api-option enable-take-address=false, indirect-api=false, port=PS_NvMP_NvmBlock_HwTqCorrlnCh1CMCLPFSvData:
      port-arg-values:
        integer literal NvM_ServiceBlockId_20: type=UInt8, value=20
    port-api-option enable-take-address=false, indirect-api=false, port=PS_NvMP_NvmBlock_LearnedEOT:
      port-arg-values:
        integer literal NvM_ServiceBlockId_12: type=UInt8, value=12
    port-api-option enable-take-address=false, indirect-api=false, port=PS_NvMP_NvmBlock_MotPosReset:
      port-arg-values:
        integer literal NvM_ServiceBlockId_16: type=UInt8, value=16
    port-api-option enable-take-address=false, indirect-api=false, port=PS_NvMP_NvmBlock_OvervoltageData:
      port-arg-values:
        integer literal NvM_ServiceBlockId_14: type=UInt8, value=14
    port-api-option enable-take-address=false, indirect-api=false, port=PS_NvMP_NvmBlock_Polarity:
      port-arg-values:
        integer literal NvM_ServiceBlockId_3: type=UInt8, value=3
    port-api-option enable-take-address=false, indirect-api=false, port=PS_NvMP_NvmBlock_PsaAgArbnPsaAgArbnLrndOffsData:
      port-arg-values:
        integer literal NvM_ServiceBlockId_22: type=UInt8, value=22
    port-api-option enable-take-address=false, indirect-api=false, port=PS_NvMP_NvmBlock_PullCmpLTComp:
      port-arg-values:
        integer literal NvM_ServiceBlockId_23: type=UInt8, value=23
    port-api-option enable-take-address=false, indirect-api=false, port=PS_NvMP_NvmBlock_ShCurrCal:
      port-arg-values:
        integer literal NvM_ServiceBlockId_1: type=UInt8, value=1
    port-api-option enable-take-address=false, indirect-api=false, port=PS_NvMP_NvmBlock_ShutdownTimeData:
      port-arg-values:
        integer literal NvM_ServiceBlockId_19: type=UInt8, value=19
    port-api-option enable-take-address=false, indirect-api=false, port=PS_NvMP_NvmBlock_TorqueCmdSF:
      port-arg-values:
        integer literal NvM_ServiceBlockId_2: type=UInt8, value=2
    port-api-option enable-take-address=false, indirect-api=false, port=PS_NvMP_NvmBlock_TypeHRamBuffer:
      port-arg-values:
        integer literal NvM_ServiceBlockId_5: type=UInt8, value=5
    port-api-option enable-take-address=false, indirect-api=false, port=PS_NvMP_NvmBlock_VVHTYPEData:
      port-arg-values:
        integer literal NvM_ServiceBlockId_17: type=UInt8, value=17
    4 x runnable:
      GetErrorStatus: can-be-invoked-concurrently=true, symbol=NvMProxy_GetErrorStatus
      NvMProxy_MainFunction: minimum-start-interval=0.01
      SetRamBlockStatus: can-be-invoked-concurrently=true, symbol=NvMProxy_SetRamBlockStatus
      WriteBlock: can-be-invoked-concurrently=true, symbol=NvMProxy_WriteBlock
  service component type NvMProxy: category=ServiceComponent  # Software Component description for NvM ASILD proxy based on generated file from Ecuc Package: ActiveEcuC
    23 x provide port, all with provided-interface=NvM_AC3_SRBS_Srv:
      PS_NvMP_NvmBlock_AvgFricLrnData  # P-Port Prototype of NvM_AC3_SRBS_Srv for NVRAM Block Rte_NvmBlockProxy_AvgFricLrnData
        provided-com-specs:
          operation=EraseBlock, queue-length=1
          operation=GetErrorStatus, queue-length=1
          operation=InvalidateNvBlock, queue-length=1
          operation=ReadBlock, queue-length=1
          operation=SetRamBlockStatus, queue-length=1
          operation=WriteBlock, queue-length=1
      PS_NvMP_NvmBlock_CloseCheckData  # P-Port Prototype of NvM_AC3_SRBS_Srv for NVRAM Block Rte_NvmBlockProxy_CloseCheckData
        provided-com-specs:
          operation=EraseBlock, queue-length=1
          operation=GetErrorStatus, queue-length=1
          operation=InvalidateNvBlock, queue-length=1
          operation=ReadBlock, queue-length=1
          operation=SetRamBlockStatus, queue-length=1
          operation=WriteBlock, queue-length=1
      PS_NvMP_NvmBlock_CogTrqCal  # P-Port Prototype of NvM_AC3_SRBS_Srv for NVRAM Block Rte_NvmBlockProxy_CogTrqCal
        provided-com-specs:
          operation=EraseBlock, queue-length=1
          operation=GetErrorStatus, queue-length=1
          operation=InvalidateNvBlock, queue-length=1
          operation=ReadBlock, queue-length=1
          operation=SetRamBlockStatus, queue-length=1
          operation=WriteBlock, queue-length=1
      PS_NvMP_NvmBlock_CogTrqRplComp  # P-Port Prototype of NvM_AC3_SRBS_Srv for NVRAM Block Rte_NvmBlockProxy_CogTrqRplComp
        provided-com-specs:
          operation=EraseBlock, queue-length=1
          operation=GetErrorStatus, queue-length=1
          operation=InvalidateNvBlock, queue-length=1
          operation=ReadBlock, queue-length=1
          operation=SetRamBlockStatus, queue-length=1
          operation=WriteBlock, queue-length=1
      PS_NvMP_NvmBlock_CurrTempOffset  # P-Port Prototype of NvM_AC3_SRBS_Srv for NVRAM Block Rte_NvmBlockProxy_CurrTempOffset
        provided-com-specs:
          operation=EraseBlock, queue-length=1
          operation=GetErrorStatus, queue-length=1
          operation=InvalidateNvBlock, queue-length=1
          operation=ReadBlock, queue-length=1
          operation=SetRamBlockStatus, queue-length=1
          operation=WriteBlock, queue-length=1
      PS_NvMP_NvmBlock_DigMSBEOLData  # P-Port Prototype of NvM_AC3_SRBS_Srv for NVRAM Block Rte_NvmBlockProxy_DigMSBEOLData
        provided-com-specs:
          operation=EraseBlock, queue-length=1
          operation=GetErrorStatus, queue-length=1
          operation=InvalidateNvBlock, queue-length=1
          operation=ReadBlock, queue-length=1
          operation=SetRamBlockStatus, queue-length=1
          operation=WriteBlock, queue-length=1
      PS_NvMP_NvmBlock_ElecIntData  # P-Port Prototype of NvM_AC3_SRBS_Srv for NVRAM Block Rte_NvmBlockProxy_ElecIntData
        provided-com-specs:
          operation=EraseBlock, queue-length=1
          operation=GetErrorStatus, queue-length=1
          operation=InvalidateNvBlock, queue-length=1
          operation=ReadBlock, queue-length=1
          operation=SetRamBlockStatus, queue-length=1
          operation=WriteBlock, queue-length=1
      PS_NvMP_NvmBlock_EOLNomMtrParam  # P-Port Prototype of NvM_AC3_SRBS_Srv for NVRAM Block Rte_NvmBlockProxy_EOLNomMtrParam
        provided-com-specs:
          operation=EraseBlock, queue-length=1
          operation=GetErrorStatus, queue-length=1
          operation=InvalidateNvBlock, queue-length=1
          operation=ReadBlock, queue-length=1
          operation=SetRamBlockStatus, queue-length=1
          operation=WriteBlock, queue-length=1
      PS_NvMP_NvmBlock_EOLVehCntrOffset  # P-Port Prototype of NvM_AC3_SRBS_Srv for NVRAM Block Rte_NvmBlockProxy_EOLVehCntrOffset
        provided-com-specs:
          operation=EraseBlock, queue-length=1
          operation=GetErrorStatus, queue-length=1
          operation=InvalidateNvBlock, queue-length=1
          operation=ReadBlock, queue-length=1
          operation=SetRamBlockStatus, queue-length=1
          operation=WriteBlock, queue-length=1
      PS_NvMP_NvmBlock_FltStVal  # P-Port Prototype of NvM_AC3_SRBS_Srv for NVRAM Block Rte_NvmBlockProxy_FltStVal
        provided-com-specs:
          operation=EraseBlock, queue-length=1
          operation=GetErrorStatus, queue-length=1
          operation=InvalidateNvBlock, queue-length=1
          operation=ReadBlock, queue-length=1
          operation=SetRamBlockStatus, queue-length=1
          operation=WriteBlock, queue-length=1
      PS_NvMP_NvmBlock_HwTqArbnEOLCh1OffsetTrimData  # P-Port Prototype of NvM_AC3_SRBS_Srv for NVRAM Block Rte_NvmBlockProxy_HwTqArbnEOLCh1OffsetTrimData
        provided-com-specs:
          operation=EraseBlock, queue-length=1
          operation=GetErrorStatus, queue-length=1
          operation=InvalidateNvBlock, queue-length=1
          operation=ReadBlock, queue-length=1
          operation=SetRamBlockStatus, queue-length=1
          operation=WriteBlock, queue-length=1
      PS_NvMP_NvmBlock_HwTqCorrlnCh1CMCLPFSvData  # P-Port Prototype of NvM_AC3_SRBS_Srv for NVRAM Block Rte_NvmBlockProxy_HwTqCorrlnCh1CMCLPFSvData
        provided-com-specs:
          operation=EraseBlock, queue-length=1
          operation=GetErrorStatus, queue-length=1
          operation=InvalidateNvBlock, queue-length=1
          operation=ReadBlock, queue-length=1
          operation=SetRamBlockStatus, queue-length=1
          operation=WriteBlock, queue-length=1
      PS_NvMP_NvmBlock_LearnedEOT  # P-Port Prototype of NvM_AC3_SRBS_Srv for NVRAM Block Rte_NvmBlockProxy_LearnedEOT
        provided-com-specs:
          operation=EraseBlock, queue-length=1
          operation=GetErrorStatus, queue-length=1
          operation=InvalidateNvBlock, queue-length=1
          operation=ReadBlock, queue-length=1
          operation=SetRamBlockStatus, queue-length=1
          operation=WriteBlock, queue-length=1
      PS_NvMP_NvmBlock_MotPosReset  # P-Port Prototype of NvM_AC3_SRBS_Srv for NVRAM Block Rte_NvmBlockProxy_MotPosReset
        provided-com-specs:
          operation=EraseBlock, queue-length=1
          operation=GetErrorStatus, queue-length=1
          operation=InvalidateNvBlock, queue-length=1
          operation=ReadBlock, queue-length=1
          operation=SetRamBlockStatus, queue-length=1
          operation=WriteBlock, queue-length=1
      PS_NvMP_NvmBlock_OvervoltageData  # P-Port Prototype of NvM_AC3_SRBS_Srv for NVRAM Block Rte_NvmBlockProxy_OvervoltageData
        provided-com-specs:
          operation=EraseBlock, queue-length=1
          operation=GetErrorStatus, queue-length=1
          operation=InvalidateNvBlock, queue-length=1
          operation=ReadBlock, queue-length=1
          operation=SetRamBlockStatus, queue-length=1
          operation=WriteBlock, queue-length=1
      PS_NvMP_NvmBlock_Polarity  # P-Port Prototype of NvM_AC3_SRBS_Srv for NVRAM Block Rte_NvmBlockProxy_Polarity
        provided-com-specs:
          operation=EraseBlock, queue-length=1
          operation=GetErrorStatus, queue-length=1
          operation=InvalidateNvBlock, queue-length=1
          operation=ReadBlock, queue-length=1
          operation=SetRamBlockStatus, queue-length=1
          operation=WriteBlock, queue-length=1
      PS_NvMP_NvmBlock_PsaAgArbnPsaAgArbnLrndOffsData  # P-Port Prototype of NvM_AC3_SRBS_Srv for NVRAM Block Rte_NvmBlockProxy_PsaAgArbnPsaAgArbnLrndOffsData
        provided-com-specs:
          operation=EraseBlock, queue-length=1
          operation=GetErrorStatus, queue-length=1
          operation=InvalidateNvBlock, queue-length=1
          operation=ReadBlock, queue-length=1
          operation=SetRamBlockStatus, queue-length=1
          operation=WriteBlock, queue-length=1
      PS_NvMP_NvmBlock_PullCmpLTComp
        provided-com-specs:
          operation=EraseBlock, queue-length=1
          operation=GetErrorStatus, queue-length=1
          operation=InvalidateNvBlock, queue-length=1
          operation=ReadBlock, queue-length=1
          operation=SetRamBlockStatus, queue-length=1
          operation=WriteBlock, queue-length=1
      PS_NvMP_NvmBlock_ShCurrCal  # P-Port Prototype of NvM_AC3_SRBS_Srv for NVRAM Block Rte_NvmBlockProxy_ShCurrCal
        provided-com-specs:
          operation=EraseBlock, queue-length=1
          operation=GetErrorStatus, queue-length=1
          operation=InvalidateNvBlock, queue-length=1
          operation=ReadBlock, queue-length=1
          operation=SetRamBlockStatus, queue-length=1
          operation=WriteBlock, queue-length=1
      PS_NvMP_NvmBlock_ShutdownTimeData  # P-Port Prototype of NvM_AC3_SRBS_Srv for NVRAM Block Rte_NvmBlockProxy_ShutdownTimeData
        provided-com-specs:
          operation=EraseBlock, queue-length=1
          operation=GetErrorStatus, queue-length=1
          operation=InvalidateNvBlock, queue-length=1
          operation=ReadBlock, queue-length=1
          operation=SetRamBlockStatus, queue-length=1
          operation=WriteBlock, queue-length=1
      PS_NvMP_NvmBlock_TorqueCmdSF  # P-Port Prototype of NvM_AC3_SRBS_Srv for NVRAM Block Rte_NvmBlockProxy_TorqueCmdSF
        provided-com-specs:
          operation=EraseBlock, queue-length=1
          operation=GetErrorStatus, queue-length=1
          operation=InvalidateNvBlock, queue-length=1
          operation=ReadBlock, queue-length=1
          operation=SetRamBlockStatus, queue-length=1
          operation=WriteBlock, queue-length=1
      PS_NvMP_NvmBlock_TypeHRamBuffer  # P-Port Prototype of NvM_AC3_SRBS_Srv for NVRAM Block Rte_NvmBlockProxy_TypeHRamBuffer
        provided-com-specs:
          operation=EraseBlock, queue-length=1
          operation=GetErrorStatus, queue-length=1
          operation=InvalidateNvBlock, queue-length=1
          operation=ReadBlock, queue-length=1
          operation=SetRamBlockStatus, queue-length=1
          operation=WriteBlock, queue-length=1
      PS_NvMP_NvmBlock_VVHTYPEData  # P-Port Prototype of NvM_AC3_SRBS_Srv for NVRAM Block Rte_NvmBlockProxy_VVHTYPEData
        provided-com-specs:
          operation=EraseBlock, queue-length=1
          operation=GetErrorStatus, queue-length=1
          operation=InvalidateNvBlock, queue-length=1
          operation=ReadBlock, queue-length=1
          operation=SetRamBlockStatus, queue-length=1
          operation=WriteBlock, queue-length=1
  swc implementation NvMProxy_Implementation: behavior=NvMProxy_InternalBehavior
    code-descriptors:
      code Code: type=SRC
