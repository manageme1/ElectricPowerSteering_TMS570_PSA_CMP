AUTOSAR XML (schema 314)
package /ComponentType
  internal behavior Sa_CDDInterface11_InternalBehavior: component=Sa_CDDInterface11, port-api-option{enable-take-address=false, indirect-api=false, port=DesiredTunSet}
    timing event CDDInterface11_Init1_InitEvent: start-on-event=CDDInterface11_Init1, period=0
    timing event TMT_CDDInterface11_Per1: start-on-event=CDDInterface11_Per1, period=0.01
    runnable CDDInterface11_Init1
      data write access WRITE_DesiredTunSet_Cnt_u16: data-element=DesiredTunSet.Cnt_u16
    runnable CDDInterface11_Per1
      data write access WRITE_DesiredTunSet_Cnt_u16: data-element=DesiredTunSet.Cnt_u16
  sensor actuator software component type Sa_CDDInterface11
    provide port DesiredTunSet: unqueued-sender-com-spec{data-element=Cnt_u16, can-invalidate=false, init-value=D_ZERO_CNT_U16}, provided-interface=Count_Cnt_u16
  swc implementation Sa_CDDInterface11_Implementation: behavior=Sa_CDDInterface11_InternalBehavior
    code-descriptors:
      code Code: type=SRC
