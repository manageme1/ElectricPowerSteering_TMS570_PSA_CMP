AUTOSAR XML (schema 314)
package /ComponentType
  internal behavior NvM_InternalBehavior: component=NvM
    322 x operation invoked event:
      OIT_EraseBlock_PS_ConfigBlock_EraseBlock: start-on-event=EraseBlock, operation=PS_ConfigBlock.EraseBlock
      OIT_EraseBlock_PS_NVM_BLOCK_CMS_ECUHWPN_EraseBlock: start-on-event=EraseBlock, operation=PS_NVM_BLOCK_CMS_ECUHWPN.EraseBlock
      OIT_EraseBlock_PS_NVM_BLOCK_CMS_ECUSRLNUM_EraseBlock: start-on-event=EraseBlock, operation=PS_NVM_BLOCK_CMS_ECUSRLNUM.EraseBlock
      OIT_EraseBlock_PS_NVM_BLOCK_CMS_EPSSRLNUM_EraseBlock: start-on-event=EraseBlock, operation=PS_NVM_BLOCK_CMS_EPSSRLNUM.EraseBlock
      OIT_EraseBlock_PS_NVM_BLOCK_CMS_IGNCNTR_EraseBlock: start-on-event=EraseBlock, operation=PS_NVM_BLOCK_CMS_IGNCNTR.EraseBlock
      OIT_EraseBlock_PS_NVM_BLOCK_CMS_NXTRMANUFSCRATCHPAD_EraseBlock: start-on-event=EraseBlock, operation=PS_NVM_BLOCK_CMS_NXTRMANUFSCRATCHPAD.EraseBlock
      OIT_EraseBlock_PS_NVM_BLOCK_CMS_NXTRMEC_EraseBlock: start-on-event=EraseBlock, operation=PS_NVM_BLOCK_CMS_NXTRMEC.EraseBlock
      OIT_EraseBlock_PS_NVM_BLOCK_DIAGMGR_BLACKBOX_EraseBlock: start-on-event=EraseBlock, operation=PS_NVM_BLOCK_DIAGMGR_BLACKBOX.EraseBlock
      OIT_EraseBlock_PS_NVM_BLOCK_DIAGMGR_LATCHCNTRS_EraseBlock: start-on-event=EraseBlock, operation=PS_NVM_BLOCK_DIAGMGR_LATCHCNTRS.EraseBlock
      OIT_EraseBlock_PS_NVM_BLOCK_DIAGMGR_NTCSTRG_EraseBlock: start-on-event=EraseBlock, operation=PS_NVM_BLOCK_DIAGMGR_NTCSTRG.EraseBlock
      OIT_EraseBlock_PS_NVM_BLOCK_EPSDEFEATS_EraseBlock: start-on-event=EraseBlock, operation=PS_NVM_BLOCK_EPSDEFEATS.EraseBlock
      OIT_EraseBlock_PS_NVM_BLOCK_SER_AUTHENTICATIONZONE_EraseBlock: start-on-event=EraseBlock, operation=PS_NVM_BLOCK_SER_AUTHENTICATIONZONE.EraseBlock
      OIT_EraseBlock_PS_NVM_BLOCK_SER_CUSTECUSRLNUM_EraseBlock: start-on-event=EraseBlock, operation=PS_NVM_BLOCK_SER_CUSTECUSRLNUM.EraseBlock
      OIT_EraseBlock_PS_NVM_BLOCK_SER_ECUMANUFACTURINGDATE_EraseBlock: start-on-event=EraseBlock, operation=PS_NVM_BLOCK_SER_ECUMANUFACTURINGDATE.EraseBlock
      OIT_EraseBlock_PS_NVM_BLOCK_SER_EMCSTANDARDIZATIONLABEL_EraseBlock: start-on-event=EraseBlock, operation=PS_NVM_BLOCK_SER_EMCSTANDARDIZATIONLABEL.EraseBlock
      OIT_EraseBlock_PS_NVM_BLOCK_SER_FLASHLOGA_EraseBlock: start-on-event=EraseBlock, operation=PS_NVM_BLOCK_SER_FLASHLOGA.EraseBlock
      OIT_EraseBlock_PS_NVM_BLOCK_SER_FLASHLOGB_EraseBlock: start-on-event=EraseBlock, operation=PS_NVM_BLOCK_SER_FLASHLOGB.EraseBlock
      OIT_EraseBlock_PS_NVM_BLOCK_SER_POWERPACKCONFIG_EraseBlock: start-on-event=EraseBlock, operation=PS_NVM_BLOCK_SER_POWERPACKCONFIG.EraseBlock
      OIT_EraseBlock_PS_NVM_BLOCK_SER_SECURITYKEY_EraseBlock: start-on-event=EraseBlock, operation=PS_NVM_BLOCK_SER_SECURITYKEY.EraseBlock
      OIT_EraseBlock_PS_NVM_BLOCK_SER_SECURITYVIOLATION_EraseBlock: start-on-event=EraseBlock, operation=PS_NVM_BLOCK_SER_SECURITYVIOLATION.EraseBlock
      OIT_EraseBlock_PS_NVM_BLOCK_SER_TUNINGSELECT_EraseBlock: start-on-event=EraseBlock, operation=PS_NVM_BLOCK_SER_TUNINGSELECT.EraseBlock
      OIT_EraseBlock_PS_Rte_NvmBlock_AbsHwPos_EOLVehCntrOffset_EraseBlock: start-on-event=EraseBlock, operation=PS_Rte_NvmBlock_AbsHwPos_EOLVehCntrOffset.EraseBlock
      OIT_EraseBlock_PS_Rte_NvmBlock_ActivePull_PullCmpLTComp_HwNm_f32_EraseBlock: start-on-event=EraseBlock, operation=PS_Rte_NvmBlock_ActivePull_PullCmpLTComp_HwNm_f32.EraseBlock
      OIT_EraseBlock_PS_Rte_NvmBlock_AvgFricLrn_AvgFricLrnData_EraseBlock: start-on-event=EraseBlock, operation=PS_Rte_NvmBlock_AvgFricLrn_AvgFricLrnData.EraseBlock
      OIT_EraseBlock_PS_Rte_NvmBlock_BatteryVoltage_OvervoltageData_EraseBlock: start-on-event=EraseBlock, operation=PS_Rte_NvmBlock_BatteryVoltage_OvervoltageData.EraseBlock
      OIT_EraseBlock_PS_Rte_NvmBlock_CmMtrCurr_CurrTempOffset_EraseBlock: start-on-event=EraseBlock, operation=PS_Rte_NvmBlock_CmMtrCurr_CurrTempOffset.EraseBlock
      OIT_EraseBlock_PS_Rte_NvmBlock_CmMtrCurr_ShCurrCal_EraseBlock: start-on-event=EraseBlock, operation=PS_Rte_NvmBlock_CmMtrCurr_ShCurrCal.EraseBlock
      OIT_EraseBlock_PS_Rte_NvmBlock_CurrParamComp_EOLNomMtrParam_EraseBlock: start-on-event=EraseBlock, operation=PS_Rte_NvmBlock_CurrParamComp_EOLNomMtrParam.EraseBlock
      OIT_EraseBlock_PS_Rte_NvmBlock_FaultLog_FaultLog_EraseBlock: start-on-event=EraseBlock, operation=PS_Rte_NvmBlock_FaultLog_FaultLog.EraseBlock
      OIT_EraseBlock_PS_Rte_NvmBlock_HwTqArbn_HwTqArbnEOLCh1OffsetTrimData_EraseBlock: start-on-event=EraseBlock, operation=PS_Rte_NvmBlock_HwTqArbn_HwTqArbnEOLCh1OffsetTrimData.EraseBlock
      OIT_EraseBlock_PS_Rte_NvmBlock_HwTqCorrln_HwTqCorrlnCh1CMCLPFSvData_EraseBlock: start-on-event=EraseBlock, operation=PS_Rte_NvmBlock_HwTqCorrln_HwTqCorrlnCh1CMCLPFSvData.EraseBlock
      OIT_EraseBlock_PS_Rte_NvmBlock_LrnEOT_LearnedEOT_EraseBlock: start-on-event=EraseBlock, operation=PS_Rte_NvmBlock_LrnEOT_LearnedEOT.EraseBlock
      OIT_EraseBlock_PS_Rte_NvmBlock_Polarity_Polarity_Cnt_Str_EraseBlock: start-on-event=EraseBlock, operation=PS_Rte_NvmBlock_Polarity_Polarity_Cnt_Str.EraseBlock
      OIT_EraseBlock_PS_Rte_NvmBlock_PsaAgArbn_PsaAgArbnLrndOffsData_EraseBlock: start-on-event=EraseBlock, operation=PS_Rte_NvmBlock_PsaAgArbn_PsaAgArbnLrndOffsData.EraseBlock
      OIT_EraseBlock_PS_Rte_NvmBlock_Sa_DigMSB_DigMSBEOLData_EraseBlock: start-on-event=EraseBlock, operation=PS_Rte_NvmBlock_Sa_DigMSB_DigMSBEOLData.EraseBlock
      OIT_EraseBlock_PS_Rte_NvmBlock_SrlComInput_ElecIntData_EraseBlock: start-on-event=EraseBlock, operation=PS_Rte_NvmBlock_SrlComInput_ElecIntData.EraseBlock
      OIT_EraseBlock_PS_Rte_NvmBlock_SrlComInput_ShutdownTimeData_EraseBlock: start-on-event=EraseBlock, operation=PS_Rte_NvmBlock_SrlComInput_ShutdownTimeData.EraseBlock
      OIT_EraseBlock_PS_Rte_NvmBlock_SrlComInput_VVHTYPEData_EraseBlock: start-on-event=EraseBlock, operation=PS_Rte_NvmBlock_SrlComInput_VVHTYPEData.EraseBlock
      OIT_EraseBlock_PS_Rte_NvmBlock_StaMd_CloseCheckData_EraseBlock: start-on-event=EraseBlock, operation=PS_Rte_NvmBlock_StaMd_CloseCheckData.EraseBlock
      OIT_EraseBlock_PS_Rte_NvmBlock_StaMd_TypeHRamBuffer_EraseBlock: start-on-event=EraseBlock, operation=PS_Rte_NvmBlock_StaMd_TypeHRamBuffer.EraseBlock
      OIT_EraseBlock_PS_Rte_NvmBlock_ThrmlDutyCycle_ThrmlDutyCycle_FltStVal_EraseBlock: start-on-event=EraseBlock, operation=PS_Rte_NvmBlock_ThrmlDutyCycle_ThrmlDutyCycle_FltStVal.EraseBlock
      OIT_EraseBlock_PS_Rte_NvmBlock_TrqCanc_CogTrqCal_EraseBlock: start-on-event=EraseBlock, operation=PS_Rte_NvmBlock_TrqCanc_CogTrqCal.EraseBlock
      OIT_EraseBlock_PS_Rte_NvmBlock_TrqCanc_CogTrqRplComp_EraseBlock: start-on-event=EraseBlock, operation=PS_Rte_NvmBlock_TrqCanc_CogTrqRplComp.EraseBlock
      OIT_EraseBlock_PS_Rte_NvmBlock_TrqCmdScl_TorqueCmdSF_Uls_f32_EraseBlock: start-on-event=EraseBlock, operation=PS_Rte_NvmBlock_TrqCmdScl_TorqueCmdSF_Uls_f32.EraseBlock
      OIT_EraseBlock_PS_Rte_NvmBlock_VehDyn_MotPosReset_EraseBlock: start-on-event=EraseBlock, operation=PS_Rte_NvmBlock_VehDyn_MotPosReset.EraseBlock
      OIT_GetErrorStatus_PS_ConfigBlock_GetErrorStatus: start-on-event=GetErrorStatus, operation=PS_ConfigBlock.GetErrorStatus
      OIT_GetErrorStatus_PS_NVM_BLOCK_CMS_ECUHWPN_GetErrorStatus: start-on-event=GetErrorStatus, operation=PS_NVM_BLOCK_CMS_ECUHWPN.GetErrorStatus
      OIT_GetErrorStatus_PS_NVM_BLOCK_CMS_ECUSRLNUM_GetErrorStatus: start-on-event=GetErrorStatus, operation=PS_NVM_BLOCK_CMS_ECUSRLNUM.GetErrorStatus
      OIT_GetErrorStatus_PS_NVM_BLOCK_CMS_EPSSRLNUM_GetErrorStatus: start-on-event=GetErrorStatus, operation=PS_NVM_BLOCK_CMS_EPSSRLNUM.GetErrorStatus
      OIT_GetErrorStatus_PS_NVM_BLOCK_CMS_IGNCNTR_GetErrorStatus: start-on-event=GetErrorStatus, operation=PS_NVM_BLOCK_CMS_IGNCNTR.GetErrorStatus
      OIT_GetErrorStatus_PS_NVM_BLOCK_CMS_NXTRMANUFSCRATCHPAD_GetErrorStatus: start-on-event=GetErrorStatus, operation=PS_NVM_BLOCK_CMS_NXTRMANUFSCRATCHPAD.GetErrorStatus
      OIT_GetErrorStatus_PS_NVM_BLOCK_CMS_NXTRMEC_GetErrorStatus: start-on-event=GetErrorStatus, operation=PS_NVM_BLOCK_CMS_NXTRMEC.GetErrorStatus
      OIT_GetErrorStatus_PS_NVM_BLOCK_DIAGMGR_BLACKBOX_GetErrorStatus: start-on-event=GetErrorStatus, operation=PS_NVM_BLOCK_DIAGMGR_BLACKBOX.GetErrorStatus
      OIT_GetErrorStatus_PS_NVM_BLOCK_DIAGMGR_LATCHCNTRS_GetErrorStatus: start-on-event=GetErrorStatus, operation=PS_NVM_BLOCK_DIAGMGR_LATCHCNTRS.GetErrorStatus
      OIT_GetErrorStatus_PS_NVM_BLOCK_DIAGMGR_NTCSTRG_GetErrorStatus: start-on-event=GetErrorStatus, operation=PS_NVM_BLOCK_DIAGMGR_NTCSTRG.GetErrorStatus
      OIT_GetErrorStatus_PS_NVM_BLOCK_EPSDEFEATS_GetErrorStatus: start-on-event=GetErrorStatus, operation=PS_NVM_BLOCK_EPSDEFEATS.GetErrorStatus
      OIT_GetErrorStatus_PS_NVM_BLOCK_SER_AUTHENTICATIONZONE_GetErrorStatus: start-on-event=GetErrorStatus, operation=PS_NVM_BLOCK_SER_AUTHENTICATIONZONE.GetErrorStatus
      OIT_GetErrorStatus_PS_NVM_BLOCK_SER_CUSTECUSRLNUM_GetErrorStatus: start-on-event=GetErrorStatus, operation=PS_NVM_BLOCK_SER_CUSTECUSRLNUM.GetErrorStatus
      OIT_GetErrorStatus_PS_NVM_BLOCK_SER_ECUMANUFACTURINGDATE_GetErrorStatus: start-on-event=GetErrorStatus, operation=PS_NVM_BLOCK_SER_ECUMANUFACTURINGDATE.GetErrorStatus
      OIT_GetErrorStatus_PS_NVM_BLOCK_SER_EMCSTANDARDIZATIONLABEL_GetErrorStatus: start-on-event=GetErrorStatus, operation=PS_NVM_BLOCK_SER_EMCSTANDARDIZATIONLABEL.GetErrorStatus
      OIT_GetErrorStatus_PS_NVM_BLOCK_SER_FLASHLOGA_GetErrorStatus: start-on-event=GetErrorStatus, operation=PS_NVM_BLOCK_SER_FLASHLOGA.GetErrorStatus
      OIT_GetErrorStatus_PS_NVM_BLOCK_SER_FLASHLOGB_GetErrorStatus: start-on-event=GetErrorStatus, operation=PS_NVM_BLOCK_SER_FLASHLOGB.GetErrorStatus
      OIT_GetErrorStatus_PS_NVM_BLOCK_SER_POWERPACKCONFIG_GetErrorStatus: start-on-event=GetErrorStatus, operation=PS_NVM_BLOCK_SER_POWERPACKCONFIG.GetErrorStatus
      OIT_GetErrorStatus_PS_NVM_BLOCK_SER_SECURITYKEY_GetErrorStatus: start-on-event=GetErrorStatus, operation=PS_NVM_BLOCK_SER_SECURITYKEY.GetErrorStatus
      OIT_GetErrorStatus_PS_NVM_BLOCK_SER_SECURITYVIOLATION_GetErrorStatus: start-on-event=GetErrorStatus, operation=PS_NVM_BLOCK_SER_SECURITYVIOLATION.GetErrorStatus
      OIT_GetErrorStatus_PS_NVM_BLOCK_SER_TUNINGSELECT_GetErrorStatus: start-on-event=GetErrorStatus, operation=PS_NVM_BLOCK_SER_TUNINGSELECT.GetErrorStatus
      OIT_GetErrorStatus_PS_Rte_NvmBlock_AbsHwPos_EOLVehCntrOffset_GetErrorStatus: start-on-event=GetErrorStatus, operation=PS_Rte_NvmBlock_AbsHwPos_EOLVehCntrOffset.GetErrorStatus
      OIT_GetErrorStatus_PS_Rte_NvmBlock_ActivePull_PullCmpLTComp_HwNm_f32_GetErrorStatus: start-on-event=GetErrorStatus, operation=PS_Rte_NvmBlock_ActivePull_PullCmpLTComp_HwNm_f32.GetErrorStatus
      OIT_GetErrorStatus_PS_Rte_NvmBlock_AvgFricLrn_AvgFricLrnData_GetErrorStatus: start-on-event=GetErrorStatus, operation=PS_Rte_NvmBlock_AvgFricLrn_AvgFricLrnData.GetErrorStatus
      OIT_GetErrorStatus_PS_Rte_NvmBlock_BatteryVoltage_OvervoltageData_GetErrorStatus: start-on-event=GetErrorStatus, operation=PS_Rte_NvmBlock_BatteryVoltage_OvervoltageData.GetErrorStatus
      OIT_GetErrorStatus_PS_Rte_NvmBlock_CmMtrCurr_CurrTempOffset_GetErrorStatus: start-on-event=GetErrorStatus, operation=PS_Rte_NvmBlock_CmMtrCurr_CurrTempOffset.GetErrorStatus
      OIT_GetErrorStatus_PS_Rte_NvmBlock_CmMtrCurr_ShCurrCal_GetErrorStatus: start-on-event=GetErrorStatus, operation=PS_Rte_NvmBlock_CmMtrCurr_ShCurrCal.GetErrorStatus
      OIT_GetErrorStatus_PS_Rte_NvmBlock_CurrParamComp_EOLNomMtrParam_GetErrorStatus: start-on-event=GetErrorStatus, operation=PS_Rte_NvmBlock_CurrParamComp_EOLNomMtrParam.GetErrorStatus
      OIT_GetErrorStatus_PS_Rte_NvmBlock_FaultLog_FaultLog_GetErrorStatus: start-on-event=GetErrorStatus, operation=PS_Rte_NvmBlock_FaultLog_FaultLog.GetErrorStatus
      OIT_GetErrorStatus_PS_Rte_NvmBlock_HwTqArbn_HwTqArbnEOLCh1OffsetTrimData_GetErrorStatus: start-on-event=GetErrorStatus, operation=PS_Rte_NvmBlock_HwTqArbn_HwTqArbnEOLCh1OffsetTrimData.GetErrorStatus
      OIT_GetErrorStatus_PS_Rte_NvmBlock_HwTqCorrln_HwTqCorrlnCh1CMCLPFSvData_GetErrorStatus: start-on-event=GetErrorStatus, operation=PS_Rte_NvmBlock_HwTqCorrln_HwTqCorrlnCh1CMCLPFSvData.GetErrorStatus
      OIT_GetErrorStatus_PS_Rte_NvmBlock_LrnEOT_LearnedEOT_GetErrorStatus: start-on-event=GetErrorStatus, operation=PS_Rte_NvmBlock_LrnEOT_LearnedEOT.GetErrorStatus
      OIT_GetErrorStatus_PS_Rte_NvmBlock_Polarity_Polarity_Cnt_Str_GetErrorStatus: start-on-event=GetErrorStatus, operation=PS_Rte_NvmBlock_Polarity_Polarity_Cnt_Str.GetErrorStatus
      OIT_GetErrorStatus_PS_Rte_NvmBlock_PsaAgArbn_PsaAgArbnLrndOffsData_GetErrorStatus: start-on-event=GetErrorStatus, operation=PS_Rte_NvmBlock_PsaAgArbn_PsaAgArbnLrndOffsData.GetErrorStatus
      OIT_GetErrorStatus_PS_Rte_NvmBlock_Sa_DigMSB_DigMSBEOLData_GetErrorStatus: start-on-event=GetErrorStatus, operation=PS_Rte_NvmBlock_Sa_DigMSB_DigMSBEOLData.GetErrorStatus
      OIT_GetErrorStatus_PS_Rte_NvmBlock_SrlComInput_ElecIntData_GetErrorStatus: start-on-event=GetErrorStatus, operation=PS_Rte_NvmBlock_SrlComInput_ElecIntData.GetErrorStatus
      OIT_GetErrorStatus_PS_Rte_NvmBlock_SrlComInput_ShutdownTimeData_GetErrorStatus: start-on-event=GetErrorStatus, operation=PS_Rte_NvmBlock_SrlComInput_ShutdownTimeData.GetErrorStatus
      OIT_GetErrorStatus_PS_Rte_NvmBlock_SrlComInput_VVHTYPEData_GetErrorStatus: start-on-event=GetErrorStatus, operation=PS_Rte_NvmBlock_SrlComInput_VVHTYPEData.GetErrorStatus
      OIT_GetErrorStatus_PS_Rte_NvmBlock_StaMd_CloseCheckData_GetErrorStatus: start-on-event=GetErrorStatus, operation=PS_Rte_NvmBlock_StaMd_CloseCheckData.GetErrorStatus
      OIT_GetErrorStatus_PS_Rte_NvmBlock_StaMd_TypeHRamBuffer_GetErrorStatus: start-on-event=GetErrorStatus, operation=PS_Rte_NvmBlock_StaMd_TypeHRamBuffer.GetErrorStatus
      OIT_GetErrorStatus_PS_Rte_NvmBlock_ThrmlDutyCycle_ThrmlDutyCycle_FltStVal_GetErrorStatus: start-on-event=GetErrorStatus, operation=PS_Rte_NvmBlock_ThrmlDutyCycle_ThrmlDutyCycle_FltStVal.GetErrorStatus
      OIT_GetErrorStatus_PS_Rte_NvmBlock_TrqCanc_CogTrqCal_GetErrorStatus: start-on-event=GetErrorStatus, operation=PS_Rte_NvmBlock_TrqCanc_CogTrqCal.GetErrorStatus
      OIT_GetErrorStatus_PS_Rte_NvmBlock_TrqCanc_CogTrqRplComp_GetErrorStatus: start-on-event=GetErrorStatus, operation=PS_Rte_NvmBlock_TrqCanc_CogTrqRplComp.GetErrorStatus
      OIT_GetErrorStatus_PS_Rte_NvmBlock_TrqCmdScl_TorqueCmdSF_Uls_f32_GetErrorStatus: start-on-event=GetErrorStatus, operation=PS_Rte_NvmBlock_TrqCmdScl_TorqueCmdSF_Uls_f32.GetErrorStatus
      OIT_GetErrorStatus_PS_Rte_NvmBlock_VehDyn_MotPosReset_GetErrorStatus: start-on-event=GetErrorStatus, operation=PS_Rte_NvmBlock_VehDyn_MotPosReset.GetErrorStatus
      OIT_InvalidateNvBlock_PS_ConfigBlock_InvalidateNvBlock: start-on-event=InvalidateNvBlock, operation=PS_ConfigBlock.InvalidateNvBlock
      OIT_InvalidateNvBlock_PS_NVM_BLOCK_CMS_ECUHWPN_InvalidateNvBlock: start-on-event=InvalidateNvBlock, operation=PS_NVM_BLOCK_CMS_ECUHWPN.InvalidateNvBlock
      OIT_InvalidateNvBlock_PS_NVM_BLOCK_CMS_ECUSRLNUM_InvalidateNvBlock: start-on-event=InvalidateNvBlock, operation=PS_NVM_BLOCK_CMS_ECUSRLNUM.InvalidateNvBlock
      OIT_InvalidateNvBlock_PS_NVM_BLOCK_CMS_EPSSRLNUM_InvalidateNvBlock: start-on-event=InvalidateNvBlock, operation=PS_NVM_BLOCK_CMS_EPSSRLNUM.InvalidateNvBlock
      OIT_InvalidateNvBlock_PS_NVM_BLOCK_CMS_IGNCNTR_InvalidateNvBlock: start-on-event=InvalidateNvBlock, operation=PS_NVM_BLOCK_CMS_IGNCNTR.InvalidateNvBlock
      OIT_InvalidateNvBlock_PS_NVM_BLOCK_CMS_NXTRMANUFSCRATCHPAD_InvalidateNvBlock: start-on-event=InvalidateNvBlock, operation=PS_NVM_BLOCK_CMS_NXTRMANUFSCRATCHPAD.InvalidateNvBlock
      OIT_InvalidateNvBlock_PS_NVM_BLOCK_CMS_NXTRMEC_InvalidateNvBlock: start-on-event=InvalidateNvBlock, operation=PS_NVM_BLOCK_CMS_NXTRMEC.InvalidateNvBlock
      OIT_InvalidateNvBlock_PS_NVM_BLOCK_DIAGMGR_BLACKBOX_InvalidateNvBlock: start-on-event=InvalidateNvBlock, operation=PS_NVM_BLOCK_DIAGMGR_BLACKBOX.InvalidateNvBlock
      OIT_InvalidateNvBlock_PS_NVM_BLOCK_DIAGMGR_LATCHCNTRS_InvalidateNvBlock: start-on-event=InvalidateNvBlock, operation=PS_NVM_BLOCK_DIAGMGR_LATCHCNTRS.InvalidateNvBlock
      OIT_InvalidateNvBlock_PS_NVM_BLOCK_DIAGMGR_NTCSTRG_InvalidateNvBlock: start-on-event=InvalidateNvBlock, operation=PS_NVM_BLOCK_DIAGMGR_NTCSTRG.InvalidateNvBlock
      OIT_InvalidateNvBlock_PS_NVM_BLOCK_EPSDEFEATS_InvalidateNvBlock: start-on-event=InvalidateNvBlock, operation=PS_NVM_BLOCK_EPSDEFEATS.InvalidateNvBlock
      OIT_InvalidateNvBlock_PS_NVM_BLOCK_SER_AUTHENTICATIONZONE_InvalidateNvBlock: start-on-event=InvalidateNvBlock, operation=PS_NVM_BLOCK_SER_AUTHENTICATIONZONE.InvalidateNvBlock
      OIT_InvalidateNvBlock_PS_NVM_BLOCK_SER_CUSTECUSRLNUM_InvalidateNvBlock: start-on-event=InvalidateNvBlock, operation=PS_NVM_BLOCK_SER_CUSTECUSRLNUM.InvalidateNvBlock
      OIT_InvalidateNvBlock_PS_NVM_BLOCK_SER_ECUMANUFACTURINGDATE_InvalidateNvBlock: start-on-event=InvalidateNvBlock, operation=PS_NVM_BLOCK_SER_ECUMANUFACTURINGDATE.InvalidateNvBlock
      OIT_InvalidateNvBlock_PS_NVM_BLOCK_SER_EMCSTANDARDIZATIONLABEL_InvalidateNvBlock: start-on-event=InvalidateNvBlock, operation=PS_NVM_BLOCK_SER_EMCSTANDARDIZATIONLABEL.InvalidateNvBlock
      OIT_InvalidateNvBlock_PS_NVM_BLOCK_SER_FLASHLOGA_InvalidateNvBlock: start-on-event=InvalidateNvBlock, operation=PS_NVM_BLOCK_SER_FLASHLOGA.InvalidateNvBlock
      OIT_InvalidateNvBlock_PS_NVM_BLOCK_SER_FLASHLOGB_InvalidateNvBlock: start-on-event=InvalidateNvBlock, operation=PS_NVM_BLOCK_SER_FLASHLOGB.InvalidateNvBlock
      OIT_InvalidateNvBlock_PS_NVM_BLOCK_SER_POWERPACKCONFIG_InvalidateNvBlock: start-on-event=InvalidateNvBlock, operation=PS_NVM_BLOCK_SER_POWERPACKCONFIG.InvalidateNvBlock
      OIT_InvalidateNvBlock_PS_NVM_BLOCK_SER_SECURITYKEY_InvalidateNvBlock: start-on-event=InvalidateNvBlock, operation=PS_NVM_BLOCK_SER_SECURITYKEY.InvalidateNvBlock
      OIT_InvalidateNvBlock_PS_NVM_BLOCK_SER_SECURITYVIOLATION_InvalidateNvBlock: start-on-event=InvalidateNvBlock, operation=PS_NVM_BLOCK_SER_SECURITYVIOLATION.InvalidateNvBlock
      OIT_InvalidateNvBlock_PS_NVM_BLOCK_SER_TUNINGSELECT_InvalidateNvBlock: start-on-event=InvalidateNvBlock, operation=PS_NVM_BLOCK_SER_TUNINGSELECT.InvalidateNvBlock
      OIT_InvalidateNvBlock_PS_Rte_NvmBlock_AbsHwPos_EOLVehCntrOffset_InvalidateNvBlock: start-on-event=InvalidateNvBlock, operation=PS_Rte_NvmBlock_AbsHwPos_EOLVehCntrOffset.InvalidateNvBlock
      OIT_InvalidateNvBlock_PS_Rte_NvmBlock_ActivePull_PullCmpLTComp_HwNm_f32_InvalidateNvBlock: start-on-event=InvalidateNvBlock, operation=PS_Rte_NvmBlock_ActivePull_PullCmpLTComp_HwNm_f32.InvalidateNvBlock
      OIT_InvalidateNvBlock_PS_Rte_NvmBlock_AvgFricLrn_AvgFricLrnData_InvalidateNvBlock: start-on-event=InvalidateNvBlock, operation=PS_Rte_NvmBlock_AvgFricLrn_AvgFricLrnData.InvalidateNvBlock
      OIT_InvalidateNvBlock_PS_Rte_NvmBlock_BatteryVoltage_OvervoltageData_InvalidateNvBlock: start-on-event=InvalidateNvBlock, operation=PS_Rte_NvmBlock_BatteryVoltage_OvervoltageData.InvalidateNvBlock
      OIT_InvalidateNvBlock_PS_Rte_NvmBlock_CmMtrCurr_CurrTempOffset_InvalidateNvBlock: start-on-event=InvalidateNvBlock, operation=PS_Rte_NvmBlock_CmMtrCurr_CurrTempOffset.InvalidateNvBlock
      OIT_InvalidateNvBlock_PS_Rte_NvmBlock_CmMtrCurr_ShCurrCal_InvalidateNvBlock: start-on-event=InvalidateNvBlock, operation=PS_Rte_NvmBlock_CmMtrCurr_ShCurrCal.InvalidateNvBlock
      OIT_InvalidateNvBlock_PS_Rte_NvmBlock_CurrParamComp_EOLNomMtrParam_InvalidateNvBlock: start-on-event=InvalidateNvBlock, operation=PS_Rte_NvmBlock_CurrParamComp_EOLNomMtrParam.InvalidateNvBlock
      OIT_InvalidateNvBlock_PS_Rte_NvmBlock_FaultLog_FaultLog_InvalidateNvBlock: start-on-event=InvalidateNvBlock, operation=PS_Rte_NvmBlock_FaultLog_FaultLog.InvalidateNvBlock
      OIT_InvalidateNvBlock_PS_Rte_NvmBlock_HwTqArbn_HwTqArbnEOLCh1OffsetTrimData_InvalidateNvBlock: start-on-event=InvalidateNvBlock, operation=PS_Rte_NvmBlock_HwTqArbn_HwTqArbnEOLCh1OffsetTrimData.InvalidateNvBlock
      OIT_InvalidateNvBlock_PS_Rte_NvmBlock_HwTqCorrln_HwTqCorrlnCh1CMCLPFSvData_InvalidateNvBlock: start-on-event=InvalidateNvBlock, operation=PS_Rte_NvmBlock_HwTqCorrln_HwTqCorrlnCh1CMCLPFSvData.InvalidateNvBlock
      OIT_InvalidateNvBlock_PS_Rte_NvmBlock_LrnEOT_LearnedEOT_InvalidateNvBlock: start-on-event=InvalidateNvBlock, operation=PS_Rte_NvmBlock_LrnEOT_LearnedEOT.InvalidateNvBlock
      OIT_InvalidateNvBlock_PS_Rte_NvmBlock_Polarity_Polarity_Cnt_Str_InvalidateNvBlock: start-on-event=InvalidateNvBlock, operation=PS_Rte_NvmBlock_Polarity_Polarity_Cnt_Str.InvalidateNvBlock
      OIT_InvalidateNvBlock_PS_Rte_NvmBlock_PsaAgArbn_PsaAgArbnLrndOffsData_InvalidateNvBlock: start-on-event=InvalidateNvBlock, operation=PS_Rte_NvmBlock_PsaAgArbn_PsaAgArbnLrndOffsData.InvalidateNvBlock
      OIT_InvalidateNvBlock_PS_Rte_NvmBlock_Sa_DigMSB_DigMSBEOLData_InvalidateNvBlock: start-on-event=InvalidateNvBlock, operation=PS_Rte_NvmBlock_Sa_DigMSB_DigMSBEOLData.InvalidateNvBlock
      OIT_InvalidateNvBlock_PS_Rte_NvmBlock_SrlComInput_ElecIntData_InvalidateNvBlock: start-on-event=InvalidateNvBlock, operation=PS_Rte_NvmBlock_SrlComInput_ElecIntData.InvalidateNvBlock
      OIT_InvalidateNvBlock_PS_Rte_NvmBlock_SrlComInput_ShutdownTimeData_InvalidateNvBlock: start-on-event=InvalidateNvBlock, operation=PS_Rte_NvmBlock_SrlComInput_ShutdownTimeData.InvalidateNvBlock
      OIT_InvalidateNvBlock_PS_Rte_NvmBlock_SrlComInput_VVHTYPEData_InvalidateNvBlock: start-on-event=InvalidateNvBlock, operation=PS_Rte_NvmBlock_SrlComInput_VVHTYPEData.InvalidateNvBlock
      OIT_InvalidateNvBlock_PS_Rte_NvmBlock_StaMd_CloseCheckData_InvalidateNvBlock: start-on-event=InvalidateNvBlock, operation=PS_Rte_NvmBlock_StaMd_CloseCheckData.InvalidateNvBlock
      OIT_InvalidateNvBlock_PS_Rte_NvmBlock_StaMd_TypeHRamBuffer_InvalidateNvBlock: start-on-event=InvalidateNvBlock, operation=PS_Rte_NvmBlock_StaMd_TypeHRamBuffer.InvalidateNvBlock
      OIT_InvalidateNvBlock_PS_Rte_NvmBlock_ThrmlDutyCycle_ThrmlDutyCycle_FltStVal_InvalidateNvBlock: start-on-event=InvalidateNvBlock, operation=PS_Rte_NvmBlock_ThrmlDutyCycle_ThrmlDutyCycle_FltStVal.InvalidateNvBlock
      OIT_InvalidateNvBlock_PS_Rte_NvmBlock_TrqCanc_CogTrqCal_InvalidateNvBlock: start-on-event=InvalidateNvBlock, operation=PS_Rte_NvmBlock_TrqCanc_CogTrqCal.InvalidateNvBlock
      OIT_InvalidateNvBlock_PS_Rte_NvmBlock_TrqCanc_CogTrqRplComp_InvalidateNvBlock: start-on-event=InvalidateNvBlock, operation=PS_Rte_NvmBlock_TrqCanc_CogTrqRplComp.InvalidateNvBlock
      OIT_InvalidateNvBlock_PS_Rte_NvmBlock_TrqCmdScl_TorqueCmdSF_Uls_f32_InvalidateNvBlock: start-on-event=InvalidateNvBlock, operation=PS_Rte_NvmBlock_TrqCmdScl_TorqueCmdSF_Uls_f32.InvalidateNvBlock
      OIT_InvalidateNvBlock_PS_Rte_NvmBlock_VehDyn_MotPosReset_InvalidateNvBlock: start-on-event=InvalidateNvBlock, operation=PS_Rte_NvmBlock_VehDyn_MotPosReset.InvalidateNvBlock
      OIT_ReadBlock_PS_ConfigBlock_ReadBlock: start-on-event=ReadBlock, operation=PS_ConfigBlock.ReadBlock
      OIT_ReadBlock_PS_NVM_BLOCK_CMS_ECUHWPN_ReadBlock: start-on-event=ReadBlock, operation=PS_NVM_BLOCK_CMS_ECUHWPN.ReadBlock
      OIT_ReadBlock_PS_NVM_BLOCK_CMS_ECUSRLNUM_ReadBlock: start-on-event=ReadBlock, operation=PS_NVM_BLOCK_CMS_ECUSRLNUM.ReadBlock
      OIT_ReadBlock_PS_NVM_BLOCK_CMS_EPSSRLNUM_ReadBlock: start-on-event=ReadBlock, operation=PS_NVM_BLOCK_CMS_EPSSRLNUM.ReadBlock
      OIT_ReadBlock_PS_NVM_BLOCK_CMS_IGNCNTR_ReadBlock: start-on-event=ReadBlock, operation=PS_NVM_BLOCK_CMS_IGNCNTR.ReadBlock
      OIT_ReadBlock_PS_NVM_BLOCK_CMS_NXTRMANUFSCRATCHPAD_ReadBlock: start-on-event=ReadBlock, operation=PS_NVM_BLOCK_CMS_NXTRMANUFSCRATCHPAD.ReadBlock
      OIT_ReadBlock_PS_NVM_BLOCK_CMS_NXTRMEC_ReadBlock: start-on-event=ReadBlock, operation=PS_NVM_BLOCK_CMS_NXTRMEC.ReadBlock
      OIT_ReadBlock_PS_NVM_BLOCK_DIAGMGR_BLACKBOX_ReadBlock: start-on-event=ReadBlock, operation=PS_NVM_BLOCK_DIAGMGR_BLACKBOX.ReadBlock
      OIT_ReadBlock_PS_NVM_BLOCK_DIAGMGR_LATCHCNTRS_ReadBlock: start-on-event=ReadBlock, operation=PS_NVM_BLOCK_DIAGMGR_LATCHCNTRS.ReadBlock
      OIT_ReadBlock_PS_NVM_BLOCK_DIAGMGR_NTCSTRG_ReadBlock: start-on-event=ReadBlock, operation=PS_NVM_BLOCK_DIAGMGR_NTCSTRG.ReadBlock
      OIT_ReadBlock_PS_NVM_BLOCK_EPSDEFEATS_ReadBlock: start-on-event=ReadBlock, operation=PS_NVM_BLOCK_EPSDEFEATS.ReadBlock
      OIT_ReadBlock_PS_NVM_BLOCK_SER_AUTHENTICATIONZONE_ReadBlock: start-on-event=ReadBlock, operation=PS_NVM_BLOCK_SER_AUTHENTICATIONZONE.ReadBlock
      OIT_ReadBlock_PS_NVM_BLOCK_SER_CUSTECUSRLNUM_ReadBlock: start-on-event=ReadBlock, operation=PS_NVM_BLOCK_SER_CUSTECUSRLNUM.ReadBlock
      OIT_ReadBlock_PS_NVM_BLOCK_SER_ECUMANUFACTURINGDATE_ReadBlock: start-on-event=ReadBlock, operation=PS_NVM_BLOCK_SER_ECUMANUFACTURINGDATE.ReadBlock
      OIT_ReadBlock_PS_NVM_BLOCK_SER_EMCSTANDARDIZATIONLABEL_ReadBlock: start-on-event=ReadBlock, operation=PS_NVM_BLOCK_SER_EMCSTANDARDIZATIONLABEL.ReadBlock
      OIT_ReadBlock_PS_NVM_BLOCK_SER_FLASHLOGA_ReadBlock: start-on-event=ReadBlock, operation=PS_NVM_BLOCK_SER_FLASHLOGA.ReadBlock
      OIT_ReadBlock_PS_NVM_BLOCK_SER_FLASHLOGB_ReadBlock: start-on-event=ReadBlock, operation=PS_NVM_BLOCK_SER_FLASHLOGB.ReadBlock
      OIT_ReadBlock_PS_NVM_BLOCK_SER_POWERPACKCONFIG_ReadBlock: start-on-event=ReadBlock, operation=PS_NVM_BLOCK_SER_POWERPACKCONFIG.ReadBlock
      OIT_ReadBlock_PS_NVM_BLOCK_SER_SECURITYKEY_ReadBlock: start-on-event=ReadBlock, operation=PS_NVM_BLOCK_SER_SECURITYKEY.ReadBlock
      OIT_ReadBlock_PS_NVM_BLOCK_SER_SECURITYVIOLATION_ReadBlock: start-on-event=ReadBlock, operation=PS_NVM_BLOCK_SER_SECURITYVIOLATION.ReadBlock
      OIT_ReadBlock_PS_NVM_BLOCK_SER_TUNINGSELECT_ReadBlock: start-on-event=ReadBlock, operation=PS_NVM_BLOCK_SER_TUNINGSELECT.ReadBlock
      OIT_ReadBlock_PS_Rte_NvmBlock_AbsHwPos_EOLVehCntrOffset_ReadBlock: start-on-event=ReadBlock, operation=PS_Rte_NvmBlock_AbsHwPos_EOLVehCntrOffset.ReadBlock
      OIT_ReadBlock_PS_Rte_NvmBlock_ActivePull_PullCmpLTComp_HwNm_f32_ReadBlock: start-on-event=ReadBlock, operation=PS_Rte_NvmBlock_ActivePull_PullCmpLTComp_HwNm_f32.ReadBlock
      OIT_ReadBlock_PS_Rte_NvmBlock_AvgFricLrn_AvgFricLrnData_ReadBlock: start-on-event=ReadBlock, operation=PS_Rte_NvmBlock_AvgFricLrn_AvgFricLrnData.ReadBlock
      OIT_ReadBlock_PS_Rte_NvmBlock_BatteryVoltage_OvervoltageData_ReadBlock: start-on-event=ReadBlock, operation=PS_Rte_NvmBlock_BatteryVoltage_OvervoltageData.ReadBlock
      OIT_ReadBlock_PS_Rte_NvmBlock_CmMtrCurr_CurrTempOffset_ReadBlock: start-on-event=ReadBlock, operation=PS_Rte_NvmBlock_CmMtrCurr_CurrTempOffset.ReadBlock
      OIT_ReadBlock_PS_Rte_NvmBlock_CmMtrCurr_ShCurrCal_ReadBlock: start-on-event=ReadBlock, operation=PS_Rte_NvmBlock_CmMtrCurr_ShCurrCal.ReadBlock
      OIT_ReadBlock_PS_Rte_NvmBlock_CurrParamComp_EOLNomMtrParam_ReadBlock: start-on-event=ReadBlock, operation=PS_Rte_NvmBlock_CurrParamComp_EOLNomMtrParam.ReadBlock
      OIT_ReadBlock_PS_Rte_NvmBlock_FaultLog_FaultLog_ReadBlock: start-on-event=ReadBlock, operation=PS_Rte_NvmBlock_FaultLog_FaultLog.ReadBlock
      OIT_ReadBlock_PS_Rte_NvmBlock_HwTqArbn_HwTqArbnEOLCh1OffsetTrimData_ReadBlock: start-on-event=ReadBlock, operation=PS_Rte_NvmBlock_HwTqArbn_HwTqArbnEOLCh1OffsetTrimData.ReadBlock
      OIT_ReadBlock_PS_Rte_NvmBlock_HwTqCorrln_HwTqCorrlnCh1CMCLPFSvData_ReadBlock: start-on-event=ReadBlock, operation=PS_Rte_NvmBlock_HwTqCorrln_HwTqCorrlnCh1CMCLPFSvData.ReadBlock
      OIT_ReadBlock_PS_Rte_NvmBlock_LrnEOT_LearnedEOT_ReadBlock: start-on-event=ReadBlock, operation=PS_Rte_NvmBlock_LrnEOT_LearnedEOT.ReadBlock
      OIT_ReadBlock_PS_Rte_NvmBlock_Polarity_Polarity_Cnt_Str_ReadBlock: start-on-event=ReadBlock, operation=PS_Rte_NvmBlock_Polarity_Polarity_Cnt_Str.ReadBlock
      OIT_ReadBlock_PS_Rte_NvmBlock_PsaAgArbn_PsaAgArbnLrndOffsData_ReadBlock: start-on-event=ReadBlock, operation=PS_Rte_NvmBlock_PsaAgArbn_PsaAgArbnLrndOffsData.ReadBlock
      OIT_ReadBlock_PS_Rte_NvmBlock_Sa_DigMSB_DigMSBEOLData_ReadBlock: start-on-event=ReadBlock, operation=PS_Rte_NvmBlock_Sa_DigMSB_DigMSBEOLData.ReadBlock
      OIT_ReadBlock_PS_Rte_NvmBlock_SrlComInput_ElecIntData_ReadBlock: start-on-event=ReadBlock, operation=PS_Rte_NvmBlock_SrlComInput_ElecIntData.ReadBlock
      OIT_ReadBlock_PS_Rte_NvmBlock_SrlComInput_ShutdownTimeData_ReadBlock: start-on-event=ReadBlock, operation=PS_Rte_NvmBlock_SrlComInput_ShutdownTimeData.ReadBlock
      OIT_ReadBlock_PS_Rte_NvmBlock_SrlComInput_VVHTYPEData_ReadBlock: start-on-event=ReadBlock, operation=PS_Rte_NvmBlock_SrlComInput_VVHTYPEData.ReadBlock
      OIT_ReadBlock_PS_Rte_NvmBlock_StaMd_CloseCheckData_ReadBlock: start-on-event=ReadBlock, operation=PS_Rte_NvmBlock_StaMd_CloseCheckData.ReadBlock
      OIT_ReadBlock_PS_Rte_NvmBlock_StaMd_TypeHRamBuffer_ReadBlock: start-on-event=ReadBlock, operation=PS_Rte_NvmBlock_StaMd_TypeHRamBuffer.ReadBlock
      OIT_ReadBlock_PS_Rte_NvmBlock_ThrmlDutyCycle_ThrmlDutyCycle_FltStVal_ReadBlock: start-on-event=ReadBlock, operation=PS_Rte_NvmBlock_ThrmlDutyCycle_ThrmlDutyCycle_FltStVal.ReadBlock
      OIT_ReadBlock_PS_Rte_NvmBlock_TrqCanc_CogTrqCal_ReadBlock: start-on-event=ReadBlock, operation=PS_Rte_NvmBlock_TrqCanc_CogTrqCal.ReadBlock
      OIT_ReadBlock_PS_Rte_NvmBlock_TrqCanc_CogTrqRplComp_ReadBlock: start-on-event=ReadBlock, operation=PS_Rte_NvmBlock_TrqCanc_CogTrqRplComp.ReadBlock
      OIT_ReadBlock_PS_Rte_NvmBlock_TrqCmdScl_TorqueCmdSF_Uls_f32_ReadBlock: start-on-event=ReadBlock, operation=PS_Rte_NvmBlock_TrqCmdScl_TorqueCmdSF_Uls_f32.ReadBlock
      OIT_ReadBlock_PS_Rte_NvmBlock_VehDyn_MotPosReset_ReadBlock: start-on-event=ReadBlock, operation=PS_Rte_NvmBlock_VehDyn_MotPosReset.ReadBlock
      OIT_RestoreBlockDefaults_PS_NVM_BLOCK_SER_AUTHENTICATIONZONE_RestoreBlockDefaults: start-on-event=RestoreBlockDefaults, operation=PS_NVM_BLOCK_SER_AUTHENTICATIONZONE.RestoreBlockDefaults
      OIT_RestoreBlockDefaults_PS_NVM_BLOCK_SER_CUSTECUSRLNUM_RestoreBlockDefaults: start-on-event=RestoreBlockDefaults, operation=PS_NVM_BLOCK_SER_CUSTECUSRLNUM.RestoreBlockDefaults
      OIT_RestoreBlockDefaults_PS_NVM_BLOCK_SER_ECUMANUFACTURINGDATE_RestoreBlockDefaults: start-on-event=RestoreBlockDefaults, operation=PS_NVM_BLOCK_SER_ECUMANUFACTURINGDATE.RestoreBlockDefaults
      OIT_RestoreBlockDefaults_PS_NVM_BLOCK_SER_EMCSTANDARDIZATIONLABEL_RestoreBlockDefaults: start-on-event=RestoreBlockDefaults, operation=PS_NVM_BLOCK_SER_EMCSTANDARDIZATIONLABEL.RestoreBlockDefaults
      OIT_RestoreBlockDefaults_PS_NVM_BLOCK_SER_POWERPACKCONFIG_RestoreBlockDefaults: start-on-event=RestoreBlockDefaults, operation=PS_NVM_BLOCK_SER_POWERPACKCONFIG.RestoreBlockDefaults
      OIT_RestoreBlockDefaults_PS_NVM_BLOCK_SER_SECURITYKEY_RestoreBlockDefaults: start-on-event=RestoreBlockDefaults, operation=PS_NVM_BLOCK_SER_SECURITYKEY.RestoreBlockDefaults
      OIT_RestoreBlockDefaults_PS_NVM_BLOCK_SER_TUNINGSELECT_RestoreBlockDefaults: start-on-event=RestoreBlockDefaults, operation=PS_NVM_BLOCK_SER_TUNINGSELECT.RestoreBlockDefaults
      OIT_SetBlockProtection_PAdmin_ConfigBlock_SetBlockProtection: start-on-event=SetBlockProtection, operation=PAdmin_ConfigBlock.SetBlockProtection
      OIT_SetBlockProtection_PAdmin_NVM_BLOCK_CMS_ECUHWPN_SetBlockProtection: start-on-event=SetBlockProtection, operation=PAdmin_NVM_BLOCK_CMS_ECUHWPN.SetBlockProtection
      OIT_SetBlockProtection_PAdmin_NVM_BLOCK_CMS_ECUSRLNUM_SetBlockProtection: start-on-event=SetBlockProtection, operation=PAdmin_NVM_BLOCK_CMS_ECUSRLNUM.SetBlockProtection
      OIT_SetBlockProtection_PAdmin_NVM_BLOCK_CMS_EPSSRLNUM_SetBlockProtection: start-on-event=SetBlockProtection, operation=PAdmin_NVM_BLOCK_CMS_EPSSRLNUM.SetBlockProtection
      OIT_SetBlockProtection_PAdmin_NVM_BLOCK_CMS_IGNCNTR_SetBlockProtection: start-on-event=SetBlockProtection, operation=PAdmin_NVM_BLOCK_CMS_IGNCNTR.SetBlockProtection
      OIT_SetBlockProtection_PAdmin_NVM_BLOCK_CMS_NXTRMANUFSCRATCHPAD_SetBlockProtection: start-on-event=SetBlockProtection, operation=PAdmin_NVM_BLOCK_CMS_NXTRMANUFSCRATCHPAD.SetBlockProtection
      OIT_SetBlockProtection_PAdmin_NVM_BLOCK_CMS_NXTRMEC_SetBlockProtection: start-on-event=SetBlockProtection, operation=PAdmin_NVM_BLOCK_CMS_NXTRMEC.SetBlockProtection
      OIT_SetBlockProtection_PAdmin_NVM_BLOCK_DIAGMGR_BLACKBOX_SetBlockProtection: start-on-event=SetBlockProtection, operation=PAdmin_NVM_BLOCK_DIAGMGR_BLACKBOX.SetBlockProtection
      OIT_SetBlockProtection_PAdmin_NVM_BLOCK_DIAGMGR_LATCHCNTRS_SetBlockProtection: start-on-event=SetBlockProtection, operation=PAdmin_NVM_BLOCK_DIAGMGR_LATCHCNTRS.SetBlockProtection
      OIT_SetBlockProtection_PAdmin_NVM_BLOCK_DIAGMGR_NTCSTRG_SetBlockProtection: start-on-event=SetBlockProtection, operation=PAdmin_NVM_BLOCK_DIAGMGR_NTCSTRG.SetBlockProtection
      OIT_SetBlockProtection_PAdmin_NVM_BLOCK_EPSDEFEATS_SetBlockProtection: start-on-event=SetBlockProtection, operation=PAdmin_NVM_BLOCK_EPSDEFEATS.SetBlockProtection
      OIT_SetBlockProtection_PAdmin_NVM_BLOCK_SER_AUTHENTICATIONZONE_SetBlockProtection: start-on-event=SetBlockProtection, operation=PAdmin_NVM_BLOCK_SER_AUTHENTICATIONZONE.SetBlockProtection
      OIT_SetBlockProtection_PAdmin_NVM_BLOCK_SER_CUSTECUSRLNUM_SetBlockProtection: start-on-event=SetBlockProtection, operation=PAdmin_NVM_BLOCK_SER_CUSTECUSRLNUM.SetBlockProtection
      OIT_SetBlockProtection_PAdmin_NVM_BLOCK_SER_ECUMANUFACTURINGDATE_SetBlockProtection: start-on-event=SetBlockProtection, operation=PAdmin_NVM_BLOCK_SER_ECUMANUFACTURINGDATE.SetBlockProtection
      OIT_SetBlockProtection_PAdmin_NVM_BLOCK_SER_EMCSTANDARDIZATIONLABEL_SetBlockProtection: start-on-event=SetBlockProtection, operation=PAdmin_NVM_BLOCK_SER_EMCSTANDARDIZATIONLABEL.SetBlockProtection
      OIT_SetBlockProtection_PAdmin_NVM_BLOCK_SER_FLASHLOGA_SetBlockProtection: start-on-event=SetBlockProtection, operation=PAdmin_NVM_BLOCK_SER_FLASHLOGA.SetBlockProtection
      OIT_SetBlockProtection_PAdmin_NVM_BLOCK_SER_FLASHLOGB_SetBlockProtection: start-on-event=SetBlockProtection, operation=PAdmin_NVM_BLOCK_SER_FLASHLOGB.SetBlockProtection
      OIT_SetBlockProtection_PAdmin_NVM_BLOCK_SER_POWERPACKCONFIG_SetBlockProtection: start-on-event=SetBlockProtection, operation=PAdmin_NVM_BLOCK_SER_POWERPACKCONFIG.SetBlockProtection
      OIT_SetBlockProtection_PAdmin_NVM_BLOCK_SER_SECURITYKEY_SetBlockProtection: start-on-event=SetBlockProtection, operation=PAdmin_NVM_BLOCK_SER_SECURITYKEY.SetBlockProtection
      OIT_SetBlockProtection_PAdmin_NVM_BLOCK_SER_SECURITYVIOLATION_SetBlockProtection: start-on-event=SetBlockProtection, operation=PAdmin_NVM_BLOCK_SER_SECURITYVIOLATION.SetBlockProtection
      OIT_SetBlockProtection_PAdmin_NVM_BLOCK_SER_TUNINGSELECT_SetBlockProtection: start-on-event=SetBlockProtection, operation=PAdmin_NVM_BLOCK_SER_TUNINGSELECT.SetBlockProtection
      OIT_SetBlockProtection_PAdmin_Rte_NvmBlock_AbsHwPos_EOLVehCntrOffset_SetBlockProtection: start-on-event=SetBlockProtection, operation=PAdmin_Rte_NvmBlock_AbsHwPos_EOLVehCntrOffset.SetBlockProtection
      OIT_SetBlockProtection_PAdmin_Rte_NvmBlock_ActivePull_PullCmpLTComp_HwNm_f32_SetBlockProtection: start-on-event=SetBlockProtection, operation=PAdmin_Rte_NvmBlock_ActivePull_PullCmpLTComp_HwNm_f32.SetBlockProtection
      OIT_SetBlockProtection_PAdmin_Rte_NvmBlock_AvgFricLrn_AvgFricLrnData_SetBlockProtection: start-on-event=SetBlockProtection, operation=PAdmin_Rte_NvmBlock_AvgFricLrn_AvgFricLrnData.SetBlockProtection
      OIT_SetBlockProtection_PAdmin_Rte_NvmBlock_BatteryVoltage_OvervoltageData_SetBlockProtection: start-on-event=SetBlockProtection, operation=PAdmin_Rte_NvmBlock_BatteryVoltage_OvervoltageData.SetBlockProtection
      OIT_SetBlockProtection_PAdmin_Rte_NvmBlock_CmMtrCurr_CurrTempOffset_SetBlockProtection: start-on-event=SetBlockProtection, operation=PAdmin_Rte_NvmBlock_CmMtrCurr_CurrTempOffset.SetBlockProtection
      OIT_SetBlockProtection_PAdmin_Rte_NvmBlock_CmMtrCurr_ShCurrCal_SetBlockProtection: start-on-event=SetBlockProtection, operation=PAdmin_Rte_NvmBlock_CmMtrCurr_ShCurrCal.SetBlockProtection
      OIT_SetBlockProtection_PAdmin_Rte_NvmBlock_CurrParamComp_EOLNomMtrParam_SetBlockProtection: start-on-event=SetBlockProtection, operation=PAdmin_Rte_NvmBlock_CurrParamComp_EOLNomMtrParam.SetBlockProtection
      OIT_SetBlockProtection_PAdmin_Rte_NvmBlock_FaultLog_FaultLog_SetBlockProtection: start-on-event=SetBlockProtection, operation=PAdmin_Rte_NvmBlock_FaultLog_FaultLog.SetBlockProtection
      OIT_SetBlockProtection_PAdmin_Rte_NvmBlock_HwTqArbn_HwTqArbnEOLCh1OffsetTrimData_SetBlockProtection: start-on-event=SetBlockProtection, operation=PAdmin_Rte_NvmBlock_HwTqArbn_HwTqArbnEOLCh1OffsetTrimData.SetBlockProtection
      OIT_SetBlockProtection_PAdmin_Rte_NvmBlock_HwTqCorrln_HwTqCorrlnCh1CMCLPFSvData_SetBlockProtection: start-on-event=SetBlockProtection, operation=PAdmin_Rte_NvmBlock_HwTqCorrln_HwTqCorrlnCh1CMCLPFSvData.SetBlockProtection
      OIT_SetBlockProtection_PAdmin_Rte_NvmBlock_LrnEOT_LearnedEOT_SetBlockProtection: start-on-event=SetBlockProtection, operation=PAdmin_Rte_NvmBlock_LrnEOT_LearnedEOT.SetBlockProtection
      OIT_SetBlockProtection_PAdmin_Rte_NvmBlock_Polarity_Polarity_Cnt_Str_SetBlockProtection: start-on-event=SetBlockProtection, operation=PAdmin_Rte_NvmBlock_Polarity_Polarity_Cnt_Str.SetBlockProtection
      OIT_SetBlockProtection_PAdmin_Rte_NvmBlock_PsaAgArbn_PsaAgArbnLrndOffsData_SetBlockProtection: start-on-event=SetBlockProtection, operation=PAdmin_Rte_NvmBlock_PsaAgArbn_PsaAgArbnLrndOffsData.SetBlockProtection
      OIT_SetBlockProtection_PAdmin_Rte_NvmBlock_Sa_DigMSB_DigMSBEOLData_SetBlockProtection: start-on-event=SetBlockProtection, operation=PAdmin_Rte_NvmBlock_Sa_DigMSB_DigMSBEOLData.SetBlockProtection
      OIT_SetBlockProtection_PAdmin_Rte_NvmBlock_SrlComInput_ElecIntData_SetBlockProtection: start-on-event=SetBlockProtection, operation=PAdmin_Rte_NvmBlock_SrlComInput_ElecIntData.SetBlockProtection
      OIT_SetBlockProtection_PAdmin_Rte_NvmBlock_SrlComInput_ShutdownTimeData_SetBlockProtection: start-on-event=SetBlockProtection, operation=PAdmin_Rte_NvmBlock_SrlComInput_ShutdownTimeData.SetBlockProtection
      OIT_SetBlockProtection_PAdmin_Rte_NvmBlock_SrlComInput_VVHTYPEData_SetBlockProtection: start-on-event=SetBlockProtection, operation=PAdmin_Rte_NvmBlock_SrlComInput_VVHTYPEData.SetBlockProtection
      OIT_SetBlockProtection_PAdmin_Rte_NvmBlock_StaMd_CloseCheckData_SetBlockProtection: start-on-event=SetBlockProtection, operation=PAdmin_Rte_NvmBlock_StaMd_CloseCheckData.SetBlockProtection
      OIT_SetBlockProtection_PAdmin_Rte_NvmBlock_StaMd_TypeHRamBuffer_SetBlockProtection: start-on-event=SetBlockProtection, operation=PAdmin_Rte_NvmBlock_StaMd_TypeHRamBuffer.SetBlockProtection
      OIT_SetBlockProtection_PAdmin_Rte_NvmBlock_ThrmlDutyCycle_ThrmlDutyCycle_FltStVal_SetBlockProtection: start-on-event=SetBlockProtection, operation=PAdmin_Rte_NvmBlock_ThrmlDutyCycle_ThrmlDutyCycle_FltStVal.SetBlockProtection
      OIT_SetBlockProtection_PAdmin_Rte_NvmBlock_TrqCanc_CogTrqCal_SetBlockProtection: start-on-event=SetBlockProtection, operation=PAdmin_Rte_NvmBlock_TrqCanc_CogTrqCal.SetBlockProtection
      OIT_SetBlockProtection_PAdmin_Rte_NvmBlock_TrqCanc_CogTrqRplComp_SetBlockProtection: start-on-event=SetBlockProtection, operation=PAdmin_Rte_NvmBlock_TrqCanc_CogTrqRplComp.SetBlockProtection
      OIT_SetBlockProtection_PAdmin_Rte_NvmBlock_TrqCmdScl_TorqueCmdSF_Uls_f32_SetBlockProtection: start-on-event=SetBlockProtection, operation=PAdmin_Rte_NvmBlock_TrqCmdScl_TorqueCmdSF_Uls_f32.SetBlockProtection
      OIT_SetBlockProtection_PAdmin_Rte_NvmBlock_VehDyn_MotPosReset_SetBlockProtection: start-on-event=SetBlockProtection, operation=PAdmin_Rte_NvmBlock_VehDyn_MotPosReset.SetBlockProtection
      OIT_SetRamBlockStatus_PS_ConfigBlock_SetRamBlockStatus: start-on-event=SetRamBlockStatus, operation=PS_ConfigBlock.SetRamBlockStatus
      OIT_SetRamBlockStatus_PS_NVM_BLOCK_CMS_ECUHWPN_SetRamBlockStatus: start-on-event=SetRamBlockStatus, operation=PS_NVM_BLOCK_CMS_ECUHWPN.SetRamBlockStatus
      OIT_SetRamBlockStatus_PS_NVM_BLOCK_CMS_ECUSRLNUM_SetRamBlockStatus: start-on-event=SetRamBlockStatus, operation=PS_NVM_BLOCK_CMS_ECUSRLNUM.SetRamBlockStatus
      OIT_SetRamBlockStatus_PS_NVM_BLOCK_CMS_EPSSRLNUM_SetRamBlockStatus: start-on-event=SetRamBlockStatus, operation=PS_NVM_BLOCK_CMS_EPSSRLNUM.SetRamBlockStatus
      OIT_SetRamBlockStatus_PS_NVM_BLOCK_CMS_IGNCNTR_SetRamBlockStatus: start-on-event=SetRamBlockStatus, operation=PS_NVM_BLOCK_CMS_IGNCNTR.SetRamBlockStatus
      OIT_SetRamBlockStatus_PS_NVM_BLOCK_CMS_NXTRMANUFSCRATCHPAD_SetRamBlockStatus: start-on-event=SetRamBlockStatus, operation=PS_NVM_BLOCK_CMS_NXTRMANUFSCRATCHPAD.SetRamBlockStatus
      OIT_SetRamBlockStatus_PS_NVM_BLOCK_CMS_NXTRMEC_SetRamBlockStatus: start-on-event=SetRamBlockStatus, operation=PS_NVM_BLOCK_CMS_NXTRMEC.SetRamBlockStatus
      OIT_SetRamBlockStatus_PS_NVM_BLOCK_DIAGMGR_BLACKBOX_SetRamBlockStatus: start-on-event=SetRamBlockStatus, operation=PS_NVM_BLOCK_DIAGMGR_BLACKBOX.SetRamBlockStatus
      OIT_SetRamBlockStatus_PS_NVM_BLOCK_DIAGMGR_LATCHCNTRS_SetRamBlockStatus: start-on-event=SetRamBlockStatus, operation=PS_NVM_BLOCK_DIAGMGR_LATCHCNTRS.SetRamBlockStatus
      OIT_SetRamBlockStatus_PS_NVM_BLOCK_DIAGMGR_NTCSTRG_SetRamBlockStatus: start-on-event=SetRamBlockStatus, operation=PS_NVM_BLOCK_DIAGMGR_NTCSTRG.SetRamBlockStatus
      OIT_SetRamBlockStatus_PS_NVM_BLOCK_EPSDEFEATS_SetRamBlockStatus: start-on-event=SetRamBlockStatus, operation=PS_NVM_BLOCK_EPSDEFEATS.SetRamBlockStatus
      OIT_SetRamBlockStatus_PS_NVM_BLOCK_SER_AUTHENTICATIONZONE_SetRamBlockStatus: start-on-event=SetRamBlockStatus, operation=PS_NVM_BLOCK_SER_AUTHENTICATIONZONE.SetRamBlockStatus
      OIT_SetRamBlockStatus_PS_NVM_BLOCK_SER_CUSTECUSRLNUM_SetRamBlockStatus: start-on-event=SetRamBlockStatus, operation=PS_NVM_BLOCK_SER_CUSTECUSRLNUM.SetRamBlockStatus
      OIT_SetRamBlockStatus_PS_NVM_BLOCK_SER_ECUMANUFACTURINGDATE_SetRamBlockStatus: start-on-event=SetRamBlockStatus, operation=PS_NVM_BLOCK_SER_ECUMANUFACTURINGDATE.SetRamBlockStatus
      OIT_SetRamBlockStatus_PS_NVM_BLOCK_SER_EMCSTANDARDIZATIONLABEL_SetRamBlockStatus: start-on-event=SetRamBlockStatus, operation=PS_NVM_BLOCK_SER_EMCSTANDARDIZATIONLABEL.SetRamBlockStatus
      OIT_SetRamBlockStatus_PS_NVM_BLOCK_SER_FLASHLOGA_SetRamBlockStatus: start-on-event=SetRamBlockStatus, operation=PS_NVM_BLOCK_SER_FLASHLOGA.SetRamBlockStatus
      OIT_SetRamBlockStatus_PS_NVM_BLOCK_SER_FLASHLOGB_SetRamBlockStatus: start-on-event=SetRamBlockStatus, operation=PS_NVM_BLOCK_SER_FLASHLOGB.SetRamBlockStatus
      OIT_SetRamBlockStatus_PS_NVM_BLOCK_SER_POWERPACKCONFIG_SetRamBlockStatus: start-on-event=SetRamBlockStatus, operation=PS_NVM_BLOCK_SER_POWERPACKCONFIG.SetRamBlockStatus
      OIT_SetRamBlockStatus_PS_NVM_BLOCK_SER_SECURITYKEY_SetRamBlockStatus: start-on-event=SetRamBlockStatus, operation=PS_NVM_BLOCK_SER_SECURITYKEY.SetRamBlockStatus
      OIT_SetRamBlockStatus_PS_NVM_BLOCK_SER_SECURITYVIOLATION_SetRamBlockStatus: start-on-event=SetRamBlockStatus, operation=PS_NVM_BLOCK_SER_SECURITYVIOLATION.SetRamBlockStatus
      OIT_SetRamBlockStatus_PS_NVM_BLOCK_SER_TUNINGSELECT_SetRamBlockStatus: start-on-event=SetRamBlockStatus, operation=PS_NVM_BLOCK_SER_TUNINGSELECT.SetRamBlockStatus
      OIT_SetRamBlockStatus_PS_Rte_NvmBlock_AbsHwPos_EOLVehCntrOffset_SetRamBlockStatus: start-on-event=SetRamBlockStatus, operation=PS_Rte_NvmBlock_AbsHwPos_EOLVehCntrOffset.SetRamBlockStatus
      OIT_SetRamBlockStatus_PS_Rte_NvmBlock_ActivePull_PullCmpLTComp_HwNm_f32_SetRamBlockStatus: start-on-event=SetRamBlockStatus, operation=PS_Rte_NvmBlock_ActivePull_PullCmpLTComp_HwNm_f32.SetRamBlockStatus
      OIT_SetRamBlockStatus_PS_Rte_NvmBlock_AvgFricLrn_AvgFricLrnData_SetRamBlockStatus: start-on-event=SetRamBlockStatus, operation=PS_Rte_NvmBlock_AvgFricLrn_AvgFricLrnData.SetRamBlockStatus
      OIT_SetRamBlockStatus_PS_Rte_NvmBlock_BatteryVoltage_OvervoltageData_SetRamBlockStatus: start-on-event=SetRamBlockStatus, operation=PS_Rte_NvmBlock_BatteryVoltage_OvervoltageData.SetRamBlockStatus
      OIT_SetRamBlockStatus_PS_Rte_NvmBlock_CmMtrCurr_CurrTempOffset_SetRamBlockStatus: start-on-event=SetRamBlockStatus, operation=PS_Rte_NvmBlock_CmMtrCurr_CurrTempOffset.SetRamBlockStatus
      OIT_SetRamBlockStatus_PS_Rte_NvmBlock_CmMtrCurr_ShCurrCal_SetRamBlockStatus: start-on-event=SetRamBlockStatus, operation=PS_Rte_NvmBlock_CmMtrCurr_ShCurrCal.SetRamBlockStatus
      OIT_SetRamBlockStatus_PS_Rte_NvmBlock_CurrParamComp_EOLNomMtrParam_SetRamBlockStatus: start-on-event=SetRamBlockStatus, operation=PS_Rte_NvmBlock_CurrParamComp_EOLNomMtrParam.SetRamBlockStatus
      OIT_SetRamBlockStatus_PS_Rte_NvmBlock_FaultLog_FaultLog_SetRamBlockStatus: start-on-event=SetRamBlockStatus, operation=PS_Rte_NvmBlock_FaultLog_FaultLog.SetRamBlockStatus
      OIT_SetRamBlockStatus_PS_Rte_NvmBlock_HwTqArbn_HwTqArbnEOLCh1OffsetTrimData_SetRamBlockStatus: start-on-event=SetRamBlockStatus, operation=PS_Rte_NvmBlock_HwTqArbn_HwTqArbnEOLCh1OffsetTrimData.SetRamBlockStatus
      OIT_SetRamBlockStatus_PS_Rte_NvmBlock_HwTqCorrln_HwTqCorrlnCh1CMCLPFSvData_SetRamBlockStatus: start-on-event=SetRamBlockStatus, operation=PS_Rte_NvmBlock_HwTqCorrln_HwTqCorrlnCh1CMCLPFSvData.SetRamBlockStatus
      OIT_SetRamBlockStatus_PS_Rte_NvmBlock_LrnEOT_LearnedEOT_SetRamBlockStatus: start-on-event=SetRamBlockStatus, operation=PS_Rte_NvmBlock_LrnEOT_LearnedEOT.SetRamBlockStatus
      OIT_SetRamBlockStatus_PS_Rte_NvmBlock_Polarity_Polarity_Cnt_Str_SetRamBlockStatus: start-on-event=SetRamBlockStatus, operation=PS_Rte_NvmBlock_Polarity_Polarity_Cnt_Str.SetRamBlockStatus
      OIT_SetRamBlockStatus_PS_Rte_NvmBlock_PsaAgArbn_PsaAgArbnLrndOffsData_SetRamBlockStatus: start-on-event=SetRamBlockStatus, operation=PS_Rte_NvmBlock_PsaAgArbn_PsaAgArbnLrndOffsData.SetRamBlockStatus
      OIT_SetRamBlockStatus_PS_Rte_NvmBlock_Sa_DigMSB_DigMSBEOLData_SetRamBlockStatus: start-on-event=SetRamBlockStatus, operation=PS_Rte_NvmBlock_Sa_DigMSB_DigMSBEOLData.SetRamBlockStatus
      OIT_SetRamBlockStatus_PS_Rte_NvmBlock_SrlComInput_ElecIntData_SetRamBlockStatus: start-on-event=SetRamBlockStatus, operation=PS_Rte_NvmBlock_SrlComInput_ElecIntData.SetRamBlockStatus
      OIT_SetRamBlockStatus_PS_Rte_NvmBlock_SrlComInput_ShutdownTimeData_SetRamBlockStatus: start-on-event=SetRamBlockStatus, operation=PS_Rte_NvmBlock_SrlComInput_ShutdownTimeData.SetRamBlockStatus
      OIT_SetRamBlockStatus_PS_Rte_NvmBlock_SrlComInput_VVHTYPEData_SetRamBlockStatus: start-on-event=SetRamBlockStatus, operation=PS_Rte_NvmBlock_SrlComInput_VVHTYPEData.SetRamBlockStatus
      OIT_SetRamBlockStatus_PS_Rte_NvmBlock_StaMd_CloseCheckData_SetRamBlockStatus: start-on-event=SetRamBlockStatus, operation=PS_Rte_NvmBlock_StaMd_CloseCheckData.SetRamBlockStatus
      OIT_SetRamBlockStatus_PS_Rte_NvmBlock_StaMd_TypeHRamBuffer_SetRamBlockStatus: start-on-event=SetRamBlockStatus, operation=PS_Rte_NvmBlock_StaMd_TypeHRamBuffer.SetRamBlockStatus
      OIT_SetRamBlockStatus_PS_Rte_NvmBlock_ThrmlDutyCycle_ThrmlDutyCycle_FltStVal_SetRamBlockStatus: start-on-event=SetRamBlockStatus, operation=PS_Rte_NvmBlock_ThrmlDutyCycle_ThrmlDutyCycle_FltStVal.SetRamBlockStatus
      OIT_SetRamBlockStatus_PS_Rte_NvmBlock_TrqCanc_CogTrqCal_SetRamBlockStatus: start-on-event=SetRamBlockStatus, operation=PS_Rte_NvmBlock_TrqCanc_CogTrqCal.SetRamBlockStatus
      OIT_SetRamBlockStatus_PS_Rte_NvmBlock_TrqCanc_CogTrqRplComp_SetRamBlockStatus: start-on-event=SetRamBlockStatus, operation=PS_Rte_NvmBlock_TrqCanc_CogTrqRplComp.SetRamBlockStatus
      OIT_SetRamBlockStatus_PS_Rte_NvmBlock_TrqCmdScl_TorqueCmdSF_Uls_f32_SetRamBlockStatus: start-on-event=SetRamBlockStatus, operation=PS_Rte_NvmBlock_TrqCmdScl_TorqueCmdSF_Uls_f32.SetRamBlockStatus
      OIT_SetRamBlockStatus_PS_Rte_NvmBlock_VehDyn_MotPosReset_SetRamBlockStatus: start-on-event=SetRamBlockStatus, operation=PS_Rte_NvmBlock_VehDyn_MotPosReset.SetRamBlockStatus
      OIT_WriteBlock_PS_ConfigBlock_WriteBlock: start-on-event=WriteBlock, operation=PS_ConfigBlock.WriteBlock
      OIT_WriteBlock_PS_NVM_BLOCK_CMS_ECUHWPN_WriteBlock: start-on-event=WriteBlock, operation=PS_NVM_BLOCK_CMS_ECUHWPN.WriteBlock
      OIT_WriteBlock_PS_NVM_BLOCK_CMS_ECUSRLNUM_WriteBlock: start-on-event=WriteBlock, operation=PS_NVM_BLOCK_CMS_ECUSRLNUM.WriteBlock
      OIT_WriteBlock_PS_NVM_BLOCK_CMS_EPSSRLNUM_WriteBlock: start-on-event=WriteBlock, operation=PS_NVM_BLOCK_CMS_EPSSRLNUM.WriteBlock
      OIT_WriteBlock_PS_NVM_BLOCK_CMS_IGNCNTR_WriteBlock: start-on-event=WriteBlock, operation=PS_NVM_BLOCK_CMS_IGNCNTR.WriteBlock
      OIT_WriteBlock_PS_NVM_BLOCK_CMS_NXTRMANUFSCRATCHPAD_WriteBlock: start-on-event=WriteBlock, operation=PS_NVM_BLOCK_CMS_NXTRMANUFSCRATCHPAD.WriteBlock
      OIT_WriteBlock_PS_NVM_BLOCK_CMS_NXTRMEC_WriteBlock: start-on-event=WriteBlock, operation=PS_NVM_BLOCK_CMS_NXTRMEC.WriteBlock
      OIT_WriteBlock_PS_NVM_BLOCK_DIAGMGR_BLACKBOX_WriteBlock: start-on-event=WriteBlock, operation=PS_NVM_BLOCK_DIAGMGR_BLACKBOX.WriteBlock
      OIT_WriteBlock_PS_NVM_BLOCK_DIAGMGR_LATCHCNTRS_WriteBlock: start-on-event=WriteBlock, operation=PS_NVM_BLOCK_DIAGMGR_LATCHCNTRS.WriteBlock
      OIT_WriteBlock_PS_NVM_BLOCK_DIAGMGR_NTCSTRG_WriteBlock: start-on-event=WriteBlock, operation=PS_NVM_BLOCK_DIAGMGR_NTCSTRG.WriteBlock
      OIT_WriteBlock_PS_NVM_BLOCK_EPSDEFEATS_WriteBlock: start-on-event=WriteBlock, operation=PS_NVM_BLOCK_EPSDEFEATS.WriteBlock
      OIT_WriteBlock_PS_NVM_BLOCK_SER_AUTHENTICATIONZONE_WriteBlock: start-on-event=WriteBlock, operation=PS_NVM_BLOCK_SER_AUTHENTICATIONZONE.WriteBlock
      OIT_WriteBlock_PS_NVM_BLOCK_SER_CUSTECUSRLNUM_WriteBlock: start-on-event=WriteBlock, operation=PS_NVM_BLOCK_SER_CUSTECUSRLNUM.WriteBlock
      OIT_WriteBlock_PS_NVM_BLOCK_SER_ECUMANUFACTURINGDATE_WriteBlock: start-on-event=WriteBlock, operation=PS_NVM_BLOCK_SER_ECUMANUFACTURINGDATE.WriteBlock
      OIT_WriteBlock_PS_NVM_BLOCK_SER_EMCSTANDARDIZATIONLABEL_WriteBlock: start-on-event=WriteBlock, operation=PS_NVM_BLOCK_SER_EMCSTANDARDIZATIONLABEL.WriteBlock
      OIT_WriteBlock_PS_NVM_BLOCK_SER_FLASHLOGA_WriteBlock: start-on-event=WriteBlock, operation=PS_NVM_BLOCK_SER_FLASHLOGA.WriteBlock
      OIT_WriteBlock_PS_NVM_BLOCK_SER_FLASHLOGB_WriteBlock: start-on-event=WriteBlock, operation=PS_NVM_BLOCK_SER_FLASHLOGB.WriteBlock
      OIT_WriteBlock_PS_NVM_BLOCK_SER_POWERPACKCONFIG_WriteBlock: start-on-event=WriteBlock, operation=PS_NVM_BLOCK_SER_POWERPACKCONFIG.WriteBlock
      OIT_WriteBlock_PS_NVM_BLOCK_SER_SECURITYKEY_WriteBlock: start-on-event=WriteBlock, operation=PS_NVM_BLOCK_SER_SECURITYKEY.WriteBlock
      OIT_WriteBlock_PS_NVM_BLOCK_SER_SECURITYVIOLATION_WriteBlock: start-on-event=WriteBlock, operation=PS_NVM_BLOCK_SER_SECURITYVIOLATION.WriteBlock
      OIT_WriteBlock_PS_NVM_BLOCK_SER_TUNINGSELECT_WriteBlock: start-on-event=WriteBlock, operation=PS_NVM_BLOCK_SER_TUNINGSELECT.WriteBlock
      OIT_WriteBlock_PS_Rte_NvmBlock_AbsHwPos_EOLVehCntrOffset_WriteBlock: start-on-event=WriteBlock, operation=PS_Rte_NvmBlock_AbsHwPos_EOLVehCntrOffset.WriteBlock
      OIT_WriteBlock_PS_Rte_NvmBlock_ActivePull_PullCmpLTComp_HwNm_f32_WriteBlock: start-on-event=WriteBlock, operation=PS_Rte_NvmBlock_ActivePull_PullCmpLTComp_HwNm_f32.WriteBlock
      OIT_WriteBlock_PS_Rte_NvmBlock_AvgFricLrn_AvgFricLrnData_WriteBlock: start-on-event=WriteBlock, operation=PS_Rte_NvmBlock_AvgFricLrn_AvgFricLrnData.WriteBlock
      OIT_WriteBlock_PS_Rte_NvmBlock_BatteryVoltage_OvervoltageData_WriteBlock: start-on-event=WriteBlock, operation=PS_Rte_NvmBlock_BatteryVoltage_OvervoltageData.WriteBlock
      OIT_WriteBlock_PS_Rte_NvmBlock_CmMtrCurr_CurrTempOffset_WriteBlock: start-on-event=WriteBlock, operation=PS_Rte_NvmBlock_CmMtrCurr_CurrTempOffset.WriteBlock
      OIT_WriteBlock_PS_Rte_NvmBlock_CmMtrCurr_ShCurrCal_WriteBlock: start-on-event=WriteBlock, operation=PS_Rte_NvmBlock_CmMtrCurr_ShCurrCal.WriteBlock
      OIT_WriteBlock_PS_Rte_NvmBlock_CurrParamComp_EOLNomMtrParam_WriteBlock: start-on-event=WriteBlock, operation=PS_Rte_NvmBlock_CurrParamComp_EOLNomMtrParam.WriteBlock
      OIT_WriteBlock_PS_Rte_NvmBlock_FaultLog_FaultLog_WriteBlock: start-on-event=WriteBlock, operation=PS_Rte_NvmBlock_FaultLog_FaultLog.WriteBlock
      OIT_WriteBlock_PS_Rte_NvmBlock_HwTqArbn_HwTqArbnEOLCh1OffsetTrimData_WriteBlock: start-on-event=WriteBlock, operation=PS_Rte_NvmBlock_HwTqArbn_HwTqArbnEOLCh1OffsetTrimData.WriteBlock
      OIT_WriteBlock_PS_Rte_NvmBlock_HwTqCorrln_HwTqCorrlnCh1CMCLPFSvData_WriteBlock: start-on-event=WriteBlock, operation=PS_Rte_NvmBlock_HwTqCorrln_HwTqCorrlnCh1CMCLPFSvData.WriteBlock
      OIT_WriteBlock_PS_Rte_NvmBlock_LrnEOT_LearnedEOT_WriteBlock: start-on-event=WriteBlock, operation=PS_Rte_NvmBlock_LrnEOT_LearnedEOT.WriteBlock
      OIT_WriteBlock_PS_Rte_NvmBlock_Polarity_Polarity_Cnt_Str_WriteBlock: start-on-event=WriteBlock, operation=PS_Rte_NvmBlock_Polarity_Polarity_Cnt_Str.WriteBlock
      OIT_WriteBlock_PS_Rte_NvmBlock_PsaAgArbn_PsaAgArbnLrndOffsData_WriteBlock: start-on-event=WriteBlock, operation=PS_Rte_NvmBlock_PsaAgArbn_PsaAgArbnLrndOffsData.WriteBlock
      OIT_WriteBlock_PS_Rte_NvmBlock_Sa_DigMSB_DigMSBEOLData_WriteBlock: start-on-event=WriteBlock, operation=PS_Rte_NvmBlock_Sa_DigMSB_DigMSBEOLData.WriteBlock
      OIT_WriteBlock_PS_Rte_NvmBlock_SrlComInput_ElecIntData_WriteBlock: start-on-event=WriteBlock, operation=PS_Rte_NvmBlock_SrlComInput_ElecIntData.WriteBlock
      OIT_WriteBlock_PS_Rte_NvmBlock_SrlComInput_ShutdownTimeData_WriteBlock: start-on-event=WriteBlock, operation=PS_Rte_NvmBlock_SrlComInput_ShutdownTimeData.WriteBlock
      OIT_WriteBlock_PS_Rte_NvmBlock_SrlComInput_VVHTYPEData_WriteBlock: start-on-event=WriteBlock, operation=PS_Rte_NvmBlock_SrlComInput_VVHTYPEData.WriteBlock
      OIT_WriteBlock_PS_Rte_NvmBlock_StaMd_CloseCheckData_WriteBlock: start-on-event=WriteBlock, operation=PS_Rte_NvmBlock_StaMd_CloseCheckData.WriteBlock
      OIT_WriteBlock_PS_Rte_NvmBlock_StaMd_TypeHRamBuffer_WriteBlock: start-on-event=WriteBlock, operation=PS_Rte_NvmBlock_StaMd_TypeHRamBuffer.WriteBlock
      OIT_WriteBlock_PS_Rte_NvmBlock_ThrmlDutyCycle_ThrmlDutyCycle_FltStVal_WriteBlock: start-on-event=WriteBlock, operation=PS_Rte_NvmBlock_ThrmlDutyCycle_ThrmlDutyCycle_FltStVal.WriteBlock
      OIT_WriteBlock_PS_Rte_NvmBlock_TrqCanc_CogTrqCal_WriteBlock: start-on-event=WriteBlock, operation=PS_Rte_NvmBlock_TrqCanc_CogTrqCal.WriteBlock
      OIT_WriteBlock_PS_Rte_NvmBlock_TrqCanc_CogTrqRplComp_WriteBlock: start-on-event=WriteBlock, operation=PS_Rte_NvmBlock_TrqCanc_CogTrqRplComp.WriteBlock
      OIT_WriteBlock_PS_Rte_NvmBlock_TrqCmdScl_TorqueCmdSF_Uls_f32_WriteBlock: start-on-event=WriteBlock, operation=PS_Rte_NvmBlock_TrqCmdScl_TorqueCmdSF_Uls_f32.WriteBlock
      OIT_WriteBlock_PS_Rte_NvmBlock_VehDyn_MotPosReset_WriteBlock: start-on-event=WriteBlock, operation=PS_Rte_NvmBlock_VehDyn_MotPosReset.WriteBlock
    port-api-option enable-take-address=false, indirect-api=false, port=PAdmin_ConfigBlock:
      port-arg-values:
        integer literal NvM_AdminBlockId_1: type=NvM_BlockIdType, value=1
    port-api-option enable-take-address=false, indirect-api=false, port=PAdmin_NVM_BLOCK_CMS_ECUHWPN:
      port-arg-values:
        integer literal NvM_AdminBlockId_11: type=NvM_BlockIdType, value=11
    port-api-option enable-take-address=false, indirect-api=false, port=PAdmin_NVM_BLOCK_CMS_ECUSRLNUM:
      port-arg-values:
        integer literal NvM_AdminBlockId_9: type=NvM_BlockIdType, value=9
    port-api-option enable-take-address=false, indirect-api=false, port=PAdmin_NVM_BLOCK_CMS_EPSSRLNUM:
      port-arg-values:
        integer literal NvM_AdminBlockId_10: type=NvM_BlockIdType, value=10
    port-api-option enable-take-address=false, indirect-api=false, port=PAdmin_NVM_BLOCK_CMS_IGNCNTR:
      port-arg-values:
        integer literal NvM_AdminBlockId_13: type=NvM_BlockIdType, value=13
    port-api-option enable-take-address=false, indirect-api=false, port=PAdmin_NVM_BLOCK_CMS_NXTRMANUFSCRATCHPAD:
      port-arg-values:
        integer literal NvM_AdminBlockId_12: type=NvM_BlockIdType, value=12
    port-api-option enable-take-address=false, indirect-api=false, port=PAdmin_NVM_BLOCK_CMS_NXTRMEC:
      port-arg-values:
        integer literal NvM_AdminBlockId_8: type=NvM_BlockIdType, value=8
    port-api-option enable-take-address=false, indirect-api=false, port=PAdmin_NVM_BLOCK_DIAGMGR_BLACKBOX:
      port-arg-values:
        integer literal NvM_AdminBlockId_16: type=NvM_BlockIdType, value=16
    port-api-option enable-take-address=false, indirect-api=false, port=PAdmin_NVM_BLOCK_DIAGMGR_LATCHCNTRS:
      port-arg-values:
        integer literal NvM_AdminBlockId_19: type=NvM_BlockIdType, value=19
    port-api-option enable-take-address=false, indirect-api=false, port=PAdmin_NVM_BLOCK_DIAGMGR_NTCSTRG:
      port-arg-values:
        integer literal NvM_AdminBlockId_2: type=NvM_BlockIdType, value=2
    port-api-option enable-take-address=false, indirect-api=false, port=PAdmin_NVM_BLOCK_EPSDEFEATS:
      port-arg-values:
        integer literal NvM_AdminBlockId_3: type=NvM_BlockIdType, value=3
    port-api-option enable-take-address=false, indirect-api=false, port=PAdmin_NVM_BLOCK_SER_AUTHENTICATIONZONE:
      port-arg-values:
        integer literal NvM_AdminBlockId_24: type=NvM_BlockIdType, value=24
    port-api-option enable-take-address=false, indirect-api=false, port=PAdmin_NVM_BLOCK_SER_CUSTECUSRLNUM:
      port-arg-values:
        integer literal NvM_AdminBlockId_27: type=NvM_BlockIdType, value=27
    port-api-option enable-take-address=false, indirect-api=false, port=PAdmin_NVM_BLOCK_SER_ECUMANUFACTURINGDATE:
      port-arg-values:
        integer literal NvM_AdminBlockId_25: type=NvM_BlockIdType, value=25
    port-api-option enable-take-address=false, indirect-api=false, port=PAdmin_NVM_BLOCK_SER_EMCSTANDARDIZATIONLABEL:
      port-arg-values:
        integer literal NvM_AdminBlockId_26: type=NvM_BlockIdType, value=26
    port-api-option enable-take-address=false, indirect-api=false, port=PAdmin_NVM_BLOCK_SER_FLASHLOGA:
      port-arg-values:
        integer literal NvM_AdminBlockId_20: type=NvM_BlockIdType, value=20
    port-api-option enable-take-address=false, indirect-api=false, port=PAdmin_NVM_BLOCK_SER_FLASHLOGB:
      port-arg-values:
        integer literal NvM_AdminBlockId_21: type=NvM_BlockIdType, value=21
    port-api-option enable-take-address=false, indirect-api=false, port=PAdmin_NVM_BLOCK_SER_POWERPACKCONFIG:
      port-arg-values:
        integer literal NvM_AdminBlockId_49: type=NvM_BlockIdType, value=49
    port-api-option enable-take-address=false, indirect-api=false, port=PAdmin_NVM_BLOCK_SER_SECURITYKEY:
      port-arg-values:
        integer literal NvM_AdminBlockId_28: type=NvM_BlockIdType, value=28
    port-api-option enable-take-address=false, indirect-api=false, port=PAdmin_NVM_BLOCK_SER_SECURITYVIOLATION:
      port-arg-values:
        integer literal NvM_AdminBlockId_22: type=NvM_BlockIdType, value=22
    port-api-option enable-take-address=false, indirect-api=false, port=PAdmin_NVM_BLOCK_SER_TUNINGSELECT:
      port-arg-values:
        integer literal NvM_AdminBlockId_31: type=NvM_BlockIdType, value=31
    port-api-option enable-take-address=false, indirect-api=false, port=PAdmin_Rte_NvmBlock_AbsHwPos_EOLVehCntrOffset:
      port-arg-values:
        integer literal NvM_AdminBlockId_46: type=NvM_BlockIdType, value=46
    port-api-option enable-take-address=false, indirect-api=false, port=PAdmin_Rte_NvmBlock_ActivePull_PullCmpLTComp_HwNm_f32:
      port-arg-values:
        integer literal NvM_AdminBlockId_54: type=NvM_BlockIdType, value=54
    port-api-option enable-take-address=false, indirect-api=false, port=PAdmin_Rte_NvmBlock_AvgFricLrn_AvgFricLrnData:
      port-arg-values:
        integer literal NvM_AdminBlockId_39: type=NvM_BlockIdType, value=39
    port-api-option enable-take-address=false, indirect-api=false, port=PAdmin_Rte_NvmBlock_BatteryVoltage_OvervoltageData:
      port-arg-values:
        integer literal NvM_AdminBlockId_17: type=NvM_BlockIdType, value=17
    port-api-option enable-take-address=false, indirect-api=false, port=PAdmin_Rte_NvmBlock_CmMtrCurr_CurrTempOffset:
      port-arg-values:
        integer literal NvM_AdminBlockId_40: type=NvM_BlockIdType, value=40
    port-api-option enable-take-address=false, indirect-api=false, port=PAdmin_Rte_NvmBlock_CmMtrCurr_ShCurrCal:
      port-arg-values:
        integer literal NvM_AdminBlockId_33: type=NvM_BlockIdType, value=33
    port-api-option enable-take-address=false, indirect-api=false, port=PAdmin_Rte_NvmBlock_CurrParamComp_EOLNomMtrParam:
      port-arg-values:
        integer literal NvM_AdminBlockId_7: type=NvM_BlockIdType, value=7
    port-api-option enable-take-address=false, indirect-api=false, port=PAdmin_Rte_NvmBlock_FaultLog_FaultLog:
      port-arg-values:
        integer literal NvM_AdminBlockId_42: type=NvM_BlockIdType, value=42
    port-api-option enable-take-address=false, indirect-api=false, port=PAdmin_Rte_NvmBlock_HwTqArbn_HwTqArbnEOLCh1OffsetTrimData:
      port-arg-values:
        integer literal NvM_AdminBlockId_51: type=NvM_BlockIdType, value=51
    port-api-option enable-take-address=false, indirect-api=false, port=PAdmin_Rte_NvmBlock_HwTqCorrln_HwTqCorrlnCh1CMCLPFSvData:
      port-arg-values:
        integer literal NvM_AdminBlockId_47: type=NvM_BlockIdType, value=47
    port-api-option enable-take-address=false, indirect-api=false, port=PAdmin_Rte_NvmBlock_LrnEOT_LearnedEOT:
      port-arg-values:
        integer literal NvM_AdminBlockId_38: type=NvM_BlockIdType, value=38
    port-api-option enable-take-address=false, indirect-api=false, port=PAdmin_Rte_NvmBlock_Polarity_Polarity_Cnt_Str:
      port-arg-values:
        integer literal NvM_AdminBlockId_6: type=NvM_BlockIdType, value=6
    port-api-option enable-take-address=false, indirect-api=false, port=PAdmin_Rte_NvmBlock_PsaAgArbn_PsaAgArbnLrndOffsData:
      port-arg-values:
        integer literal NvM_AdminBlockId_53: type=NvM_BlockIdType, value=53
    port-api-option enable-take-address=false, indirect-api=false, port=PAdmin_Rte_NvmBlock_Sa_DigMSB_DigMSBEOLData:
      port-arg-values:
        integer literal NvM_AdminBlockId_15: type=NvM_BlockIdType, value=15
    port-api-option enable-take-address=false, indirect-api=false, port=PAdmin_Rte_NvmBlock_SrlComInput_ElecIntData:
      port-arg-values:
        integer literal NvM_AdminBlockId_30: type=NvM_BlockIdType, value=30
    port-api-option enable-take-address=false, indirect-api=false, port=PAdmin_Rte_NvmBlock_SrlComInput_ShutdownTimeData:
      port-arg-values:
        integer literal NvM_AdminBlockId_44: type=NvM_BlockIdType, value=44
    port-api-option enable-take-address=false, indirect-api=false, port=PAdmin_Rte_NvmBlock_SrlComInput_VVHTYPEData:
      port-arg-values:
        integer literal NvM_AdminBlockId_29: type=NvM_BlockIdType, value=29
    port-api-option enable-take-address=false, indirect-api=false, port=PAdmin_Rte_NvmBlock_StaMd_CloseCheckData:
      port-arg-values:
        integer literal NvM_AdminBlockId_14: type=NvM_BlockIdType, value=14
    port-api-option enable-take-address=false, indirect-api=false, port=PAdmin_Rte_NvmBlock_StaMd_TypeHRamBuffer:
      port-arg-values:
        integer literal NvM_AdminBlockId_5: type=NvM_BlockIdType, value=5
    port-api-option enable-take-address=false, indirect-api=false, port=PAdmin_Rte_NvmBlock_ThrmlDutyCycle_ThrmlDutyCycle_FltStVal:
      port-arg-values:
        integer literal NvM_AdminBlockId_18: type=NvM_BlockIdType, value=18
    port-api-option enable-take-address=false, indirect-api=false, port=PAdmin_Rte_NvmBlock_TrqCanc_CogTrqCal:
      port-arg-values:
        integer literal NvM_AdminBlockId_34: type=NvM_BlockIdType, value=34
    port-api-option enable-take-address=false, indirect-api=false, port=PAdmin_Rte_NvmBlock_TrqCanc_CogTrqRplComp:
      port-arg-values:
        integer literal NvM_AdminBlockId_35: type=NvM_BlockIdType, value=35
    port-api-option enable-take-address=false, indirect-api=false, port=PAdmin_Rte_NvmBlock_TrqCmdScl_TorqueCmdSF_Uls_f32:
      port-arg-values:
        integer literal NvM_AdminBlockId_52: type=NvM_BlockIdType, value=52
    port-api-option enable-take-address=false, indirect-api=false, port=PAdmin_Rte_NvmBlock_VehDyn_MotPosReset:
      port-arg-values:
        integer literal NvM_AdminBlockId_23: type=NvM_BlockIdType, value=23
    port-api-option enable-take-address=false, indirect-api=false, port=PS_ConfigBlock:
      port-arg-values:
        integer literal NvM_ServiceBlockId_1: type=NvM_BlockIdType, value=1
    port-api-option enable-take-address=false, indirect-api=false, port=PS_NVM_BLOCK_CMS_ECUHWPN:
      port-arg-values:
        integer literal NvM_ServiceBlockId_11: type=NvM_BlockIdType, value=11
    port-api-option enable-take-address=false, indirect-api=false, port=PS_NVM_BLOCK_CMS_ECUSRLNUM:
      port-arg-values:
        integer literal NvM_ServiceBlockId_9: type=NvM_BlockIdType, value=9
    port-api-option enable-take-address=false, indirect-api=false, port=PS_NVM_BLOCK_CMS_EPSSRLNUM:
      port-arg-values:
        integer literal NvM_ServiceBlockId_10: type=NvM_BlockIdType, value=10
    port-api-option enable-take-address=false, indirect-api=false, port=PS_NVM_BLOCK_CMS_IGNCNTR:
      port-arg-values:
        integer literal NvM_ServiceBlockId_13: type=NvM_BlockIdType, value=13
    port-api-option enable-take-address=false, indirect-api=false, port=PS_NVM_BLOCK_CMS_NXTRMANUFSCRATCHPAD:
      port-arg-values:
        integer literal NvM_ServiceBlockId_12: type=NvM_BlockIdType, value=12
    port-api-option enable-take-address=false, indirect-api=false, port=PS_NVM_BLOCK_CMS_NXTRMEC:
      port-arg-values:
        integer literal NvM_ServiceBlockId_8: type=NvM_BlockIdType, value=8
    port-api-option enable-take-address=false, indirect-api=false, port=PS_NVM_BLOCK_DIAGMGR_BLACKBOX:
      port-arg-values:
        integer literal NvM_ServiceBlockId_16: type=NvM_BlockIdType, value=16
    port-api-option enable-take-address=false, indirect-api=false, port=PS_NVM_BLOCK_DIAGMGR_LATCHCNTRS:
      port-arg-values:
        integer literal NvM_ServiceBlockId_19: type=NvM_BlockIdType, value=19
    port-api-option enable-take-address=false, indirect-api=false, port=PS_NVM_BLOCK_DIAGMGR_NTCSTRG:
      port-arg-values:
        integer literal NvM_ServiceBlockId_2: type=NvM_BlockIdType, value=2
    port-api-option enable-take-address=false, indirect-api=false, port=PS_NVM_BLOCK_EPSDEFEATS:
      port-arg-values:
        integer literal NvM_ServiceBlockId_3: type=NvM_BlockIdType, value=3
    port-api-option enable-take-address=false, indirect-api=false, port=PS_NVM_BLOCK_SER_AUTHENTICATIONZONE:
      port-arg-values:
        integer literal NvM_ServiceBlockId_24: type=NvM_BlockIdType, value=24
    port-api-option enable-take-address=false, indirect-api=false, port=PS_NVM_BLOCK_SER_CUSTECUSRLNUM:
      port-arg-values:
        integer literal NvM_ServiceBlockId_27: type=NvM_BlockIdType, value=27
    port-api-option enable-take-address=false, indirect-api=false, port=PS_NVM_BLOCK_SER_ECUMANUFACTURINGDATE:
      port-arg-values:
        integer literal NvM_ServiceBlockId_25: type=NvM_BlockIdType, value=25
    port-api-option enable-take-address=false, indirect-api=false, port=PS_NVM_BLOCK_SER_EMCSTANDARDIZATIONLABEL:
      port-arg-values:
        integer literal NvM_ServiceBlockId_26: type=NvM_BlockIdType, value=26
    port-api-option enable-take-address=false, indirect-api=false, port=PS_NVM_BLOCK_SER_FLASHLOGA:
      port-arg-values:
        integer literal NvM_ServiceBlockId_20: type=NvM_BlockIdType, value=20
    port-api-option enable-take-address=false, indirect-api=false, port=PS_NVM_BLOCK_SER_FLASHLOGB:
      port-arg-values:
        integer literal NvM_ServiceBlockId_21: type=NvM_BlockIdType, value=21
    port-api-option enable-take-address=false, indirect-api=false, port=PS_NVM_BLOCK_SER_POWERPACKCONFIG:
      port-arg-values:
        integer literal NvM_ServiceBlockId_49: type=NvM_BlockIdType, value=49
    port-api-option enable-take-address=false, indirect-api=false, port=PS_NVM_BLOCK_SER_SECURITYKEY:
      port-arg-values:
        integer literal NvM_ServiceBlockId_28: type=NvM_BlockIdType, value=28
    port-api-option enable-take-address=false, indirect-api=false, port=PS_NVM_BLOCK_SER_SECURITYVIOLATION:
      port-arg-values:
        integer literal NvM_ServiceBlockId_22: type=NvM_BlockIdType, value=22
    port-api-option enable-take-address=false, indirect-api=false, port=PS_NVM_BLOCK_SER_TUNINGSELECT:
      port-arg-values:
        integer literal NvM_ServiceBlockId_31: type=NvM_BlockIdType, value=31
    port-api-option enable-take-address=false, indirect-api=false, port=PS_Rte_NvmBlock_AbsHwPos_EOLVehCntrOffset:
      port-arg-values:
        integer literal NvM_ServiceBlockId_46: type=NvM_BlockIdType, value=46
    port-api-option enable-take-address=false, indirect-api=false, port=PS_Rte_NvmBlock_ActivePull_PullCmpLTComp_HwNm_f32:
      port-arg-values:
        integer literal NvM_ServiceBlockId_54: type=NvM_BlockIdType, value=54
    port-api-option enable-take-address=false, indirect-api=false, port=PS_Rte_NvmBlock_AvgFricLrn_AvgFricLrnData:
      port-arg-values:
        integer literal NvM_ServiceBlockId_39: type=NvM_BlockIdType, value=39
    port-api-option enable-take-address=false, indirect-api=false, port=PS_Rte_NvmBlock_BatteryVoltage_OvervoltageData:
      port-arg-values:
        integer literal NvM_ServiceBlockId_17: type=NvM_BlockIdType, value=17
    port-api-option enable-take-address=false, indirect-api=false, port=PS_Rte_NvmBlock_CmMtrCurr_CurrTempOffset:
      port-arg-values:
        integer literal NvM_ServiceBlockId_40: type=NvM_BlockIdType, value=40
    port-api-option enable-take-address=false, indirect-api=false, port=PS_Rte_NvmBlock_CmMtrCurr_ShCurrCal:
      port-arg-values:
        integer literal NvM_ServiceBlockId_33: type=NvM_BlockIdType, value=33
    port-api-option enable-take-address=false, indirect-api=false, port=PS_Rte_NvmBlock_CurrParamComp_EOLNomMtrParam:
      port-arg-values:
        integer literal NvM_ServiceBlockId_7: type=NvM_BlockIdType, value=7
    port-api-option enable-take-address=false, indirect-api=false, port=PS_Rte_NvmBlock_FaultLog_FaultLog:
      port-arg-values:
        integer literal NvM_ServiceBlockId_42: type=NvM_BlockIdType, value=42
    port-api-option enable-take-address=false, indirect-api=false, port=PS_Rte_NvmBlock_HwTqArbn_HwTqArbnEOLCh1OffsetTrimData:
      port-arg-values:
        integer literal NvM_ServiceBlockId_51: type=NvM_BlockIdType, value=51
    port-api-option enable-take-address=false, indirect-api=false, port=PS_Rte_NvmBlock_HwTqCorrln_HwTqCorrlnCh1CMCLPFSvData:
      port-arg-values:
        integer literal NvM_ServiceBlockId_47: type=NvM_BlockIdType, value=47
    port-api-option enable-take-address=false, indirect-api=false, port=PS_Rte_NvmBlock_LrnEOT_LearnedEOT:
      port-arg-values:
        integer literal NvM_ServiceBlockId_38: type=NvM_BlockIdType, value=38
    port-api-option enable-take-address=false, indirect-api=false, port=PS_Rte_NvmBlock_Polarity_Polarity_Cnt_Str:
      port-arg-values:
        integer literal NvM_ServiceBlockId_6: type=NvM_BlockIdType, value=6
    port-api-option enable-take-address=false, indirect-api=false, port=PS_Rte_NvmBlock_PsaAgArbn_PsaAgArbnLrndOffsData:
      port-arg-values:
        integer literal NvM_ServiceBlockId_53: type=NvM_BlockIdType, value=53
    port-api-option enable-take-address=false, indirect-api=false, port=PS_Rte_NvmBlock_Sa_DigMSB_DigMSBEOLData:
      port-arg-values:
        integer literal NvM_ServiceBlockId_15: type=NvM_BlockIdType, value=15
    port-api-option enable-take-address=false, indirect-api=false, port=PS_Rte_NvmBlock_SrlComInput_ElecIntData:
      port-arg-values:
        integer literal NvM_ServiceBlockId_30: type=NvM_BlockIdType, value=30
    port-api-option enable-take-address=false, indirect-api=false, port=PS_Rte_NvmBlock_SrlComInput_ShutdownTimeData:
      port-arg-values:
        integer literal NvM_ServiceBlockId_44: type=NvM_BlockIdType, value=44
    port-api-option enable-take-address=false, indirect-api=false, port=PS_Rte_NvmBlock_SrlComInput_VVHTYPEData:
      port-arg-values:
        integer literal NvM_ServiceBlockId_29: type=NvM_BlockIdType, value=29
    port-api-option enable-take-address=false, indirect-api=false, port=PS_Rte_NvmBlock_StaMd_CloseCheckData:
      port-arg-values:
        integer literal NvM_ServiceBlockId_14: type=NvM_BlockIdType, value=14
    port-api-option enable-take-address=false, indirect-api=false, port=PS_Rte_NvmBlock_StaMd_TypeHRamBuffer:
      port-arg-values:
        integer literal NvM_ServiceBlockId_5: type=NvM_BlockIdType, value=5
    port-api-option enable-take-address=false, indirect-api=false, port=PS_Rte_NvmBlock_ThrmlDutyCycle_ThrmlDutyCycle_FltStVal:
      port-arg-values:
        integer literal NvM_ServiceBlockId_18: type=NvM_BlockIdType, value=18
    port-api-option enable-take-address=false, indirect-api=false, port=PS_Rte_NvmBlock_TrqCanc_CogTrqCal:
      port-arg-values:
        integer literal NvM_ServiceBlockId_34: type=NvM_BlockIdType, value=34
    port-api-option enable-take-address=false, indirect-api=false, port=PS_Rte_NvmBlock_TrqCanc_CogTrqRplComp:
      port-arg-values:
        integer literal NvM_ServiceBlockId_35: type=NvM_BlockIdType, value=35
    port-api-option enable-take-address=false, indirect-api=false, port=PS_Rte_NvmBlock_TrqCmdScl_TorqueCmdSF_Uls_f32:
      port-arg-values:
        integer literal NvM_ServiceBlockId_52: type=NvM_BlockIdType, value=52
    port-api-option enable-take-address=false, indirect-api=false, port=PS_Rte_NvmBlock_VehDyn_MotPosReset:
      port-arg-values:
        integer literal NvM_ServiceBlockId_23: type=NvM_BlockIdType, value=23
    8 x runnable, all with can-be-invoked-concurrently=true:
      EraseBlock: symbol=NvM_EraseNvBlock
      GetErrorStatus: symbol=NvM_GetErrorStatus
      InvalidateNvBlock: symbol=NvM_InvalidateNvBlock
      ReadBlock: symbol=NvM_ReadBlock
      RestoreBlockDefaults: symbol=NvM_RestoreBlockDefaults
      SetBlockProtection: symbol=NvM_SetBlockProtection
      SetRamBlockStatus: symbol=NvM_SetRamBlockStatus
      WriteBlock: symbol=NvM_WriteBlock
  service component type NvM: category=ServiceComponent  # Software Component description for NvM generated from Ecuc Package: ActiveEcuC
    90 x provide port:
      PAdmin_ConfigBlock: server-com-spec{operation=SetBlockProtection, queue-length=1}, provided-interface=NvM_Administration  # P-Port Prototype of NvM_Administration for NVRAM Block ConfigBlock
      PAdmin_NVM_BLOCK_CMS_ECUHWPN: server-com-spec{operation=SetBlockProtection, queue-length=1}, provided-interface=NvM_Administration  # P-Port Prototype of NvM_Administration for NVRAM Block NVM_BLOCK_CMS_ECUHWPN
      PAdmin_NVM_BLOCK_CMS_ECUSRLNUM: server-com-spec{operation=SetBlockProtection, queue-length=1}, provided-interface=NvM_Administration  # P-Port Prototype of NvM_Administration for NVRAM Block NVM_BLOCK_CMS_ECUSRLNUM
      PAdmin_NVM_BLOCK_CMS_EPSSRLNUM: server-com-spec{operation=SetBlockProtection, queue-length=1}, provided-interface=NvM_Administration  # P-Port Prototype of NvM_Administration for NVRAM Block NVM_BLOCK_CMS_EPSSRLNUM
      PAdmin_NVM_BLOCK_CMS_IGNCNTR: server-com-spec{operation=SetBlockProtection, queue-length=1}, provided-interface=NvM_Administration  # P-Port Prototype of NvM_Administration for NVRAM Block NVM_BLOCK_CMS_IGNCNTR
      PAdmin_NVM_BLOCK_CMS_NXTRMANUFSCRATCHPAD: server-com-spec{operation=SetBlockProtection, queue-length=1}, provided-interface=NvM_Administration  # P-Port Prototype of NvM_Administration for NVRAM Block NVM_BLOCK_CMS_NXTRMANUFSCRATCHPAD
      PAdmin_NVM_BLOCK_CMS_NXTRMEC: server-com-spec{operation=SetBlockProtection, queue-length=1}, provided-interface=NvM_Administration  # P-Port Prototype of NvM_Administration for NVRAM Block NVM_BLOCK_CMS_NXTRMEC
      PAdmin_NVM_BLOCK_DIAGMGR_BLACKBOX: server-com-spec{operation=SetBlockProtection, queue-length=1}, provided-interface=NvM_Administration  # P-Port Prototype of NvM_Administration for NVRAM Block NVM_BLOCK_DIAGMGR_BLACKBOX
      PAdmin_NVM_BLOCK_DIAGMGR_LATCHCNTRS: server-com-spec{operation=SetBlockProtection, queue-length=1}, provided-interface=NvM_Administration  # P-Port Prototype of NvM_Administration for NVRAM Block NVM_BLOCK_DIAGMGR_LATCHCNTRS
      PAdmin_NVM_BLOCK_DIAGMGR_NTCSTRG: server-com-spec{operation=SetBlockProtection, queue-length=1}, provided-interface=NvM_Administration  # P-Port Prototype of NvM_Administration for NVRAM Block NVM_BLOCK_DIAGMGR_NTCSTRG
      PAdmin_NVM_BLOCK_EPSDEFEATS: server-com-spec{operation=SetBlockProtection, queue-length=1}, provided-interface=NvM_Administration  # P-Port Prototype of NvM_Administration for NVRAM Block NVM_BLOCK_EPSDEFEATS
      PAdmin_NVM_BLOCK_SER_AUTHENTICATIONZONE: server-com-spec{operation=SetBlockProtection, queue-length=1}, provided-interface=NvM_Administration  # P-Port Prototype of NvM_Administration for NVRAM Block NVM_BLOCK_SER_AUTHENTICATIONZONE
      PAdmin_NVM_BLOCK_SER_CUSTECUSRLNUM: server-com-spec{operation=SetBlockProtection, queue-length=1}, provided-interface=NvM_Administration  # P-Port Prototype of NvM_Administration for NVRAM Block NVM_BLOCK_SER_CUSTECUSRLNUM
      PAdmin_NVM_BLOCK_SER_ECUMANUFACTURINGDATE: server-com-spec{operation=SetBlockProtection, queue-length=1}, provided-interface=NvM_Administration  # P-Port Prototype of NvM_Administration for NVRAM Block NVM_BLOCK_SER_ECUMANUFACTURINGDATE
      PAdmin_NVM_BLOCK_SER_EMCSTANDARDIZATIONLABEL: server-com-spec{operation=SetBlockProtection, queue-length=1}, provided-interface=NvM_Administration  # P-Port Prototype of NvM_Administration for NVRAM Block NVM_BLOCK_SER_EMCSTANDARDIZATIONLABEL
      PAdmin_NVM_BLOCK_SER_FLASHLOGA: server-com-spec{operation=SetBlockProtection, queue-length=1}, provided-interface=NvM_Administration  # P-Port Prototype of NvM_Administration for NVRAM Block NVM_BLOCK_SER_FLASHLOGA
      PAdmin_NVM_BLOCK_SER_FLASHLOGB: server-com-spec{operation=SetBlockProtection, queue-length=1}, provided-interface=NvM_Administration  # P-Port Prototype of NvM_Administration for NVRAM Block NVM_BLOCK_SER_FLASHLOGB
      PAdmin_NVM_BLOCK_SER_POWERPACKCONFIG: server-com-spec{operation=SetBlockProtection, queue-length=1}, provided-interface=NvM_Administration  # P-Port Prototype of NvM_Administration for NVRAM Block NVM_BLOCK_SER_POWERPACKCONFIG
      PAdmin_NVM_BLOCK_SER_SECURITYKEY: server-com-spec{operation=SetBlockProtection, queue-length=1}, provided-interface=NvM_Administration  # P-Port Prototype of NvM_Administration for NVRAM Block NVM_BLOCK_SER_SECURITYKEY
      PAdmin_NVM_BLOCK_SER_SECURITYVIOLATION: server-com-spec{operation=SetBlockProtection, queue-length=1}, provided-interface=NvM_Administration  # P-Port Prototype of NvM_Administration for NVRAM Block NVM_BLOCK_SER_SECURITYVIOLATION
      PAdmin_NVM_BLOCK_SER_TUNINGSELECT: server-com-spec{operation=SetBlockProtection, queue-length=1}, provided-interface=NvM_Administration  # P-Port Prototype of NvM_Administration for NVRAM Block NVM_BLOCK_SER_TUNINGSELECT
      PAdmin_Rte_NvmBlock_AbsHwPos_EOLVehCntrOffset: server-com-spec{operation=SetBlockProtection, queue-length=1}, provided-interface=NvM_Administration  # P-Port Prototype of NvM_Administration for NVRAM Block Rte_NvmBlock_AbsHwPos_EOLVehCntrOffset
      PAdmin_Rte_NvmBlock_ActivePull_PullCmpLTComp_HwNm_f32: server-com-spec{operation=SetBlockProtection, queue-length=1}, provided-interface=NvM_Administration  # P-Port Prototype of NvM_Administration for NVRAM Block Rte_NvmBlock_ActivePull_PullCmpLTComp_HwNm_f32
      PAdmin_Rte_NvmBlock_AvgFricLrn_AvgFricLrnData: server-com-spec{operation=SetBlockProtection, queue-length=1}, provided-interface=NvM_Administration  # P-Port Prototype of NvM_Administration for NVRAM Block Rte_NvmBlock_AvgFricLrn_AvgFricLrnData
      PAdmin_Rte_NvmBlock_BatteryVoltage_OvervoltageData: server-com-spec{operation=SetBlockProtection, queue-length=1}, provided-interface=NvM_Administration  # P-Port Prototype of NvM_Administration for NVRAM Block Rte_NvmBlock_BatteryVoltage_OvervoltageData
      PAdmin_Rte_NvmBlock_CmMtrCurr_CurrTempOffset: server-com-spec{operation=SetBlockProtection, queue-length=1}, provided-interface=NvM_Administration  # P-Port Prototype of NvM_Administration for NVRAM Block Rte_NvmBlock_CmMtrCurr_CurrTempOffset
      PAdmin_Rte_NvmBlock_CmMtrCurr_ShCurrCal: server-com-spec{operation=SetBlockProtection, queue-length=1}, provided-interface=NvM_Administration  # P-Port Prototype of NvM_Administration for NVRAM Block Rte_NvmBlock_CmMtrCurr_ShCurrCal
      PAdmin_Rte_NvmBlock_CurrParamComp_EOLNomMtrParam: server-com-spec{operation=SetBlockProtection, queue-length=1}, provided-interface=NvM_Administration  # P-Port Prototype of NvM_Administration for NVRAM Block Rte_NvmBlock_CurrParamComp_EOLNomMtrParam
      PAdmin_Rte_NvmBlock_FaultLog_FaultLog: server-com-spec{operation=SetBlockProtection, queue-length=1}, provided-interface=NvM_Administration  # P-Port Prototype of NvM_Administration for NVRAM Block Rte_NvmBlock_FaultLog_FaultLog
      PAdmin_Rte_NvmBlock_HwTqArbn_HwTqArbnEOLCh1OffsetTrimData: server-com-spec{operation=SetBlockProtection, queue-length=1}, provided-interface=NvM_Administration  # P-Port Prototype of NvM_Administration for NVRAM Block Rte_NvmBlock_HwTqArbn_HwTqArbnEOLCh1OffsetTrimData
      PAdmin_Rte_NvmBlock_HwTqCorrln_HwTqCorrlnCh1CMCLPFSvData: server-com-spec{operation=SetBlockProtection, queue-length=1}, provided-interface=NvM_Administration  # P-Port Prototype of NvM_Administration for NVRAM Block Rte_NvmBlock_HwTqCorrln_HwTqCorrlnCh1CMCLPFSvData
      PAdmin_Rte_NvmBlock_LrnEOT_LearnedEOT: server-com-spec{operation=SetBlockProtection, queue-length=1}, provided-interface=NvM_Administration  # P-Port Prototype of NvM_Administration for NVRAM Block Rte_NvmBlock_LrnEOT_LearnedEOT
      PAdmin_Rte_NvmBlock_Polarity_Polarity_Cnt_Str: server-com-spec{operation=SetBlockProtection, queue-length=1}, provided-interface=NvM_Administration  # P-Port Prototype of NvM_Administration for NVRAM Block Rte_NvmBlock_Polarity_Polarity_Cnt_Str
      PAdmin_Rte_NvmBlock_PsaAgArbn_PsaAgArbnLrndOffsData: server-com-spec{operation=SetBlockProtection, queue-length=1}, provided-interface=NvM_Administration  # P-Port Prototype of NvM_Administration for NVRAM Block Rte_NvmBlock_PsaAgArbn_PsaAgArbnLrndOffsData
      PAdmin_Rte_NvmBlock_Sa_DigMSB_DigMSBEOLData: server-com-spec{operation=SetBlockProtection, queue-length=1}, provided-interface=NvM_Administration  # P-Port Prototype of NvM_Administration for NVRAM Block Rte_NvmBlock_Sa_DigMSB_DigMSBEOLData
      PAdmin_Rte_NvmBlock_SrlComInput_ElecIntData: server-com-spec{operation=SetBlockProtection, queue-length=1}, provided-interface=NvM_Administration  # P-Port Prototype of NvM_Administration for NVRAM Block Rte_NvmBlock_SrlComInput_ElecIntData
      PAdmin_Rte_NvmBlock_SrlComInput_ShutdownTimeData: server-com-spec{operation=SetBlockProtection, queue-length=1}, provided-interface=NvM_Administration  # P-Port Prototype of NvM_Administration for NVRAM Block Rte_NvmBlock_SrlComInput_ShutdownTimeData
      PAdmin_Rte_NvmBlock_SrlComInput_VVHTYPEData: server-com-spec{operation=SetBlockProtection, queue-length=1}, provided-interface=NvM_Administration  # P-Port Prototype of NvM_Administration for NVRAM Block Rte_NvmBlock_SrlComInput_VVHTYPEData
      PAdmin_Rte_NvmBlock_StaMd_CloseCheckData: server-com-spec{operation=SetBlockProtection, queue-length=1}, provided-interface=NvM_Administration  # P-Port Prototype of NvM_Administration for NVRAM Block Rte_NvmBlock_StaMd_CloseCheckData
      PAdmin_Rte_NvmBlock_StaMd_TypeHRamBuffer: server-com-spec{operation=SetBlockProtection, queue-length=1}, provided-interface=NvM_Administration  # P-Port Prototype of NvM_Administration for NVRAM Block Rte_NvmBlock_StaMd_TypeHRamBuffer
      PAdmin_Rte_NvmBlock_ThrmlDutyCycle_ThrmlDutyCycle_FltStVal: server-com-spec{operation=SetBlockProtection, queue-length=1}, provided-interface=NvM_Administration  # P-Port Prototype of NvM_Administration for NVRAM Block Rte_NvmBlock_ThrmlDutyCycle_ThrmlDutyCycle_FltStVal
      PAdmin_Rte_NvmBlock_TrqCanc_CogTrqCal: server-com-spec{operation=SetBlockProtection, queue-length=1}, provided-interface=NvM_Administration  # P-Port Prototype of NvM_Administration for NVRAM Block Rte_NvmBlock_TrqCanc_CogTrqCal
      PAdmin_Rte_NvmBlock_TrqCanc_CogTrqRplComp: server-com-spec{operation=SetBlockProtection, queue-length=1}, provided-interface=NvM_Administration  # P-Port Prototype of NvM_Administration for NVRAM Block Rte_NvmBlock_TrqCanc_CogTrqRplComp
      PAdmin_Rte_NvmBlock_TrqCmdScl_TorqueCmdSF_Uls_f32: server-com-spec{operation=SetBlockProtection, queue-length=1}, provided-interface=NvM_Administration  # P-Port Prototype of NvM_Administration for NVRAM Block Rte_NvmBlock_TrqCmdScl_TorqueCmdSF_Uls_f32
      PAdmin_Rte_NvmBlock_VehDyn_MotPosReset: server-com-spec{operation=SetBlockProtection, queue-length=1}, provided-interface=NvM_Administration  # P-Port Prototype of NvM_Administration for NVRAM Block Rte_NvmBlock_VehDyn_MotPosReset
      PS_ConfigBlock: provided-interface=NvM_AC3_SRBS_Srv  # P-Port Prototype of NvM_AC3_SRBS_Srv for NVRAM Block ConfigBlock
        provided-com-specs:
          operation=EraseBlock, queue-length=1
          operation=GetErrorStatus, queue-length=1
          operation=InvalidateNvBlock, queue-length=1
          operation=ReadBlock, queue-length=1
          operation=SetRamBlockStatus, queue-length=1
          operation=WriteBlock, queue-length=1
      PS_NVM_BLOCK_CMS_ECUHWPN: provided-interface=NvM_AC3_SRBS_Srv  # P-Port Prototype of NvM_AC3_SRBS_Srv for NVRAM Block NVM_BLOCK_CMS_ECUHWPN
        provided-com-specs:
          operation=EraseBlock, queue-length=1
          operation=GetErrorStatus, queue-length=1
          operation=InvalidateNvBlock, queue-length=1
          operation=ReadBlock, queue-length=1
          operation=SetRamBlockStatus, queue-length=1
          operation=WriteBlock, queue-length=1
      PS_NVM_BLOCK_CMS_ECUSRLNUM: provided-interface=NvM_AC3_SRBS_Srv  # P-Port Prototype of NvM_AC3_SRBS_Srv for NVRAM Block NVM_BLOCK_CMS_ECUSRLNUM
        provided-com-specs:
          operation=EraseBlock, queue-length=1
          operation=GetErrorStatus, queue-length=1
          operation=InvalidateNvBlock, queue-length=1
          operation=ReadBlock, queue-length=1
          operation=SetRamBlockStatus, queue-length=1
          operation=WriteBlock, queue-length=1
      PS_NVM_BLOCK_CMS_EPSSRLNUM: provided-interface=NvM_AC3_SRBS_Srv  # P-Port Prototype of NvM_AC3_SRBS_Srv for NVRAM Block NVM_BLOCK_CMS_EPSSRLNUM
        provided-com-specs:
          operation=EraseBlock, queue-length=1
          operation=GetErrorStatus, queue-length=1
          operation=InvalidateNvBlock, queue-length=1
          operation=ReadBlock, queue-length=1
          operation=SetRamBlockStatus, queue-length=1
          operation=WriteBlock, queue-length=1
      PS_NVM_BLOCK_CMS_IGNCNTR: provided-interface=NvM_AC3_SRBS_Srv  # P-Port Prototype of NvM_AC3_SRBS_Srv for NVRAM Block NVM_BLOCK_CMS_IGNCNTR
        provided-com-specs:
          operation=EraseBlock, queue-length=1
          operation=GetErrorStatus, queue-length=1
          operation=InvalidateNvBlock, queue-length=1
          operation=ReadBlock, queue-length=1
          operation=SetRamBlockStatus, queue-length=1
          operation=WriteBlock, queue-length=1
      PS_NVM_BLOCK_CMS_NXTRMANUFSCRATCHPAD: provided-interface=NvM_AC3_SRBS_Srv  # P-Port Prototype of NvM_AC3_SRBS_Srv for NVRAM Block NVM_BLOCK_CMS_NXTRMANUFSCRATCHPAD
        provided-com-specs:
          operation=EraseBlock, queue-length=1
          operation=GetErrorStatus, queue-length=1
          operation=InvalidateNvBlock, queue-length=1
          operation=ReadBlock, queue-length=1
          operation=SetRamBlockStatus, queue-length=1
          operation=WriteBlock, queue-length=1
      PS_NVM_BLOCK_CMS_NXTRMEC: provided-interface=NvM_AC3_SRBS_Srv  # P-Port Prototype of NvM_AC3_SRBS_Srv for NVRAM Block NVM_BLOCK_CMS_NXTRMEC
        provided-com-specs:
          operation=EraseBlock, queue-length=1
          operation=GetErrorStatus, queue-length=1
          operation=InvalidateNvBlock, queue-length=1
          operation=ReadBlock, queue-length=1
          operation=SetRamBlockStatus, queue-length=1
          operation=WriteBlock, queue-length=1
      PS_NVM_BLOCK_DIAGMGR_BLACKBOX: provided-interface=NvM_AC3_SRBS_Srv  # P-Port Prototype of NvM_AC3_SRBS_Srv for NVRAM Block NVM_BLOCK_DIAGMGR_BLACKBOX
        provided-com-specs:
          operation=EraseBlock, queue-length=1
          operation=GetErrorStatus, queue-length=1
          operation=InvalidateNvBlock, queue-length=1
          operation=ReadBlock, queue-length=1
          operation=SetRamBlockStatus, queue-length=1
          operation=WriteBlock, queue-length=1
      PS_NVM_BLOCK_DIAGMGR_LATCHCNTRS: provided-interface=NvM_AC3_SRBS_Srv  # P-Port Prototype of NvM_AC3_SRBS_Srv for NVRAM Block NVM_BLOCK_DIAGMGR_LATCHCNTRS
        provided-com-specs:
          operation=EraseBlock, queue-length=1
          operation=GetErrorStatus, queue-length=1
          operation=InvalidateNvBlock, queue-length=1
          operation=ReadBlock, queue-length=1
          operation=SetRamBlockStatus, queue-length=1
          operation=WriteBlock, queue-length=1
      PS_NVM_BLOCK_DIAGMGR_NTCSTRG: provided-interface=NvM_AC3_SRBS_Srv  # P-Port Prototype of NvM_AC3_SRBS_Srv for NVRAM Block NVM_BLOCK_DIAGMGR_NTCSTRG
        provided-com-specs:
          operation=EraseBlock, queue-length=1
          operation=GetErrorStatus, queue-length=1
          operation=InvalidateNvBlock, queue-length=1
          operation=ReadBlock, queue-length=1
          operation=SetRamBlockStatus, queue-length=1
          operation=WriteBlock, queue-length=1
      PS_NVM_BLOCK_EPSDEFEATS: provided-interface=NvM_AC3_SRBS_Srv  # P-Port Prototype of NvM_AC3_SRBS_Srv for NVRAM Block NVM_BLOCK_EPSDEFEATS
        provided-com-specs:
          operation=EraseBlock, queue-length=1
          operation=GetErrorStatus, queue-length=1
          operation=InvalidateNvBlock, queue-length=1
          operation=ReadBlock, queue-length=1
          operation=SetRamBlockStatus, queue-length=1
          operation=WriteBlock, queue-length=1
      PS_NVM_BLOCK_SER_AUTHENTICATIONZONE: provided-interface=NvM_AC3_SRBS_Srv_Defs  # P-Port Prototype of NvM_AC3_SRBS_Srv_Defs for NVRAM Block NVM_BLOCK_SER_AUTHENTICATIONZONE
        provided-com-specs:
          operation=EraseBlock, queue-length=1
          operation=GetErrorStatus, queue-length=1
          operation=InvalidateNvBlock, queue-length=1
          operation=ReadBlock, queue-length=1
          operation=RestoreBlockDefaults, queue-length=1
          operation=SetRamBlockStatus, queue-length=1
          operation=WriteBlock, queue-length=1
      PS_NVM_BLOCK_SER_CUSTECUSRLNUM: provided-interface=NvM_AC3_SRBS_Srv_Defs  # P-Port Prototype of NvM_AC3_SRBS_Srv_Defs for NVRAM Block NVM_BLOCK_SER_CUSTECUSRLNUM
        provided-com-specs:
          operation=EraseBlock, queue-length=1
          operation=GetErrorStatus, queue-length=1
          operation=InvalidateNvBlock, queue-length=1
          operation=ReadBlock, queue-length=1
          operation=RestoreBlockDefaults, queue-length=1
          operation=SetRamBlockStatus, queue-length=1
          operation=WriteBlock, queue-length=1
      PS_NVM_BLOCK_SER_ECUMANUFACTURINGDATE: provided-interface=NvM_AC3_SRBS_Srv_Defs  # P-Port Prototype of NvM_AC3_SRBS_Srv_Defs for NVRAM Block NVM_BLOCK_SER_ECUMANUFACTURINGDATE
        provided-com-specs:
          operation=EraseBlock, queue-length=1
          operation=GetErrorStatus, queue-length=1
          operation=InvalidateNvBlock, queue-length=1
          operation=ReadBlock, queue-length=1
          operation=RestoreBlockDefaults, queue-length=1
          operation=SetRamBlockStatus, queue-length=1
          operation=WriteBlock, queue-length=1
      PS_NVM_BLOCK_SER_EMCSTANDARDIZATIONLABEL: provided-interface=NvM_AC3_SRBS_Srv_Defs  # P-Port Prototype of NvM_AC3_SRBS_Srv_Defs for NVRAM Block NVM_BLOCK_SER_EMCSTANDARDIZATIONLABEL
        provided-com-specs:
          operation=EraseBlock, queue-length=1
          operation=GetErrorStatus, queue-length=1
          operation=InvalidateNvBlock, queue-length=1
          operation=ReadBlock, queue-length=1
          operation=RestoreBlockDefaults, queue-length=1
          operation=SetRamBlockStatus, queue-length=1
          operation=WriteBlock, queue-length=1
      PS_NVM_BLOCK_SER_FLASHLOGA: provided-interface=NvM_AC3_SRBS_Srv  # P-Port Prototype of NvM_AC3_SRBS_Srv for NVRAM Block NVM_BLOCK_SER_FLASHLOGA
        provided-com-specs:
          operation=EraseBlock, queue-length=1
          operation=GetErrorStatus, queue-length=1
          operation=InvalidateNvBlock, queue-length=1
          operation=ReadBlock, queue-length=1
          operation=SetRamBlockStatus, queue-length=1
          operation=WriteBlock, queue-length=1
      PS_NVM_BLOCK_SER_FLASHLOGB: provided-interface=NvM_AC3_SRBS_Srv  # P-Port Prototype of NvM_AC3_SRBS_Srv for NVRAM Block NVM_BLOCK_SER_FLASHLOGB
        provided-com-specs:
          operation=EraseBlock, queue-length=1
          operation=GetErrorStatus, queue-length=1
          operation=InvalidateNvBlock, queue-length=1
          operation=ReadBlock, queue-length=1
          operation=SetRamBlockStatus, queue-length=1
          operation=WriteBlock, queue-length=1
      PS_NVM_BLOCK_SER_POWERPACKCONFIG: provided-interface=NvM_AC3_SRBS_Srv_Defs  # P-Port Prototype of NvM_AC3_SRBS_Srv_Defs for NVRAM Block NVM_BLOCK_SER_POWERPACKCONFIG
        provided-com-specs:
          operation=EraseBlock, queue-length=1
          operation=GetErrorStatus, queue-length=1
          operation=InvalidateNvBlock, queue-length=1
          operation=ReadBlock, queue-length=1
          operation=RestoreBlockDefaults, queue-length=1
          operation=SetRamBlockStatus, queue-length=1
          operation=WriteBlock, queue-length=1
      PS_NVM_BLOCK_SER_SECURITYKEY: provided-interface=NvM_AC3_SRBS_Srv_Defs  # P-Port Prototype of NvM_AC3_SRBS_Srv_Defs for NVRAM Block NVM_BLOCK_SER_SECURITYKEY
        provided-com-specs:
          operation=EraseBlock, queue-length=1
          operation=GetErrorStatus, queue-length=1
          operation=InvalidateNvBlock, queue-length=1
          operation=ReadBlock, queue-length=1
          operation=RestoreBlockDefaults, queue-length=1
          operation=SetRamBlockStatus, queue-length=1
          operation=WriteBlock, queue-length=1
      PS_NVM_BLOCK_SER_SECURITYVIOLATION: provided-interface=NvM_AC3_SRBS_Srv  # P-Port Prototype of NvM_AC3_SRBS_Srv for NVRAM Block NVM_BLOCK_SER_SECURITYVIOLATION
        provided-com-specs:
          operation=EraseBlock, queue-length=1
          operation=GetErrorStatus, queue-length=1
          operation=InvalidateNvBlock, queue-length=1
          operation=ReadBlock, queue-length=1
          operation=SetRamBlockStatus, queue-length=1
          operation=WriteBlock, queue-length=1
      PS_NVM_BLOCK_SER_TUNINGSELECT: provided-interface=NvM_AC3_SRBS_Srv_Defs  # P-Port Prototype of NvM_AC3_SRBS_Srv_Defs for NVRAM Block NVM_BLOCK_SER_TUNINGSELECT
        provided-com-specs:
          operation=EraseBlock, queue-length=1
          operation=GetErrorStatus, queue-length=1
          operation=InvalidateNvBlock, queue-length=1
          operation=ReadBlock, queue-length=1
          operation=RestoreBlockDefaults, queue-length=1
          operation=SetRamBlockStatus, queue-length=1
          operation=WriteBlock, queue-length=1
      PS_Rte_NvmBlock_AbsHwPos_EOLVehCntrOffset: provided-interface=NvM_AC3_SRBS_Srv  # P-Port Prototype of NvM_AC3_SRBS_Srv for NVRAM Block Rte_NvmBlock_AbsHwPos_EOLVehCntrOffset
        provided-com-specs:
          operation=EraseBlock, queue-length=1
          operation=GetErrorStatus, queue-length=1
          operation=InvalidateNvBlock, queue-length=1
          operation=ReadBlock, queue-length=1
          operation=SetRamBlockStatus, queue-length=1
          operation=WriteBlock, queue-length=1
      PS_Rte_NvmBlock_ActivePull_PullCmpLTComp_HwNm_f32: provided-interface=NvM_AC3_SRBS_Srv  # P-Port Prototype of NvM_AC3_SRBS_Srv for NVRAM Block Rte_NvmBlock_ActivePull_PullCmpLTComp_HwNm_f32
        provided-com-specs:
          operation=EraseBlock, queue-length=1
          operation=GetErrorStatus, queue-length=1
          operation=InvalidateNvBlock, queue-length=1
          operation=ReadBlock, queue-length=1
          operation=SetRamBlockStatus, queue-length=1
          operation=WriteBlock, queue-length=1
      PS_Rte_NvmBlock_AvgFricLrn_AvgFricLrnData: provided-interface=NvM_AC3_SRBS_Srv  # P-Port Prototype of NvM_AC3_SRBS_Srv for NVRAM Block Rte_NvmBlock_AvgFricLrn_AvgFricLrnData
        provided-com-specs:
          operation=EraseBlock, queue-length=1
          operation=GetErrorStatus, queue-length=1
          operation=InvalidateNvBlock, queue-length=1
          operation=ReadBlock, queue-length=1
          operation=SetRamBlockStatus, queue-length=1
          operation=WriteBlock, queue-length=1
      PS_Rte_NvmBlock_BatteryVoltage_OvervoltageData: provided-interface=NvM_AC3_SRBS_Srv  # P-Port Prototype of NvM_AC3_SRBS_Srv for NVRAM Block Rte_NvmBlock_BatteryVoltage_OvervoltageData
        provided-com-specs:
          operation=EraseBlock, queue-length=1
          operation=GetErrorStatus, queue-length=1
          operation=InvalidateNvBlock, queue-length=1
          operation=ReadBlock, queue-length=1
          operation=SetRamBlockStatus, queue-length=1
          operation=WriteBlock, queue-length=1
      PS_Rte_NvmBlock_CmMtrCurr_CurrTempOffset: provided-interface=NvM_AC3_SRBS_Srv  # P-Port Prototype of NvM_AC3_SRBS_Srv for NVRAM Block Rte_NvmBlock_CmMtrCurr_CurrTempOffset
        provided-com-specs:
          operation=EraseBlock, queue-length=1
          operation=GetErrorStatus, queue-length=1
          operation=InvalidateNvBlock, queue-length=1
          operation=ReadBlock, queue-length=1
          operation=SetRamBlockStatus, queue-length=1
          operation=WriteBlock, queue-length=1
      PS_Rte_NvmBlock_CmMtrCurr_ShCurrCal: provided-interface=NvM_AC3_SRBS_Srv  # P-Port Prototype of NvM_AC3_SRBS_Srv for NVRAM Block Rte_NvmBlock_CmMtrCurr_ShCurrCal
        provided-com-specs:
          operation=EraseBlock, queue-length=1
          operation=GetErrorStatus, queue-length=1
          operation=InvalidateNvBlock, queue-length=1
          operation=ReadBlock, queue-length=1
          operation=SetRamBlockStatus, queue-length=1
          operation=WriteBlock, queue-length=1
      PS_Rte_NvmBlock_CurrParamComp_EOLNomMtrParam: provided-interface=NvM_AC3_SRBS_Srv  # P-Port Prototype of NvM_AC3_SRBS_Srv for NVRAM Block Rte_NvmBlock_CurrParamComp_EOLNomMtrParam
        provided-com-specs:
          operation=EraseBlock, queue-length=1
          operation=GetErrorStatus, queue-length=1
          operation=InvalidateNvBlock, queue-length=1
          operation=ReadBlock, queue-length=1
          operation=SetRamBlockStatus, queue-length=1
          operation=WriteBlock, queue-length=1
      PS_Rte_NvmBlock_FaultLog_FaultLog: provided-interface=NvM_AC3_SRBS_Srv  # P-Port Prototype of NvM_AC3_SRBS_Srv for NVRAM Block Rte_NvmBlock_FaultLog_FaultLog
        provided-com-specs:
          operation=EraseBlock, queue-length=1
          operation=GetErrorStatus, queue-length=1
          operation=InvalidateNvBlock, queue-length=1
          operation=ReadBlock, queue-length=1
          operation=SetRamBlockStatus, queue-length=1
          operation=WriteBlock, queue-length=1
      PS_Rte_NvmBlock_HwTqArbn_HwTqArbnEOLCh1OffsetTrimData: provided-interface=NvM_AC3_SRBS_Srv  # P-Port Prototype of NvM_AC3_SRBS_Srv for NVRAM Block Rte_NvmBlock_HwTqArbn_HwTqArbnEOLCh1OffsetTrimData
        provided-com-specs:
          operation=EraseBlock, queue-length=1
          operation=GetErrorStatus, queue-length=1
          operation=InvalidateNvBlock, queue-length=1
          operation=ReadBlock, queue-length=1
          operation=SetRamBlockStatus, queue-length=1
          operation=WriteBlock, queue-length=1
      PS_Rte_NvmBlock_HwTqCorrln_HwTqCorrlnCh1CMCLPFSvData: provided-interface=NvM_AC3_SRBS_Srv  # P-Port Prototype of NvM_AC3_SRBS_Srv for NVRAM Block Rte_NvmBlock_HwTqCorrln_HwTqCorrlnCh1CMCLPFSvData
        provided-com-specs:
          operation=EraseBlock, queue-length=1
          operation=GetErrorStatus, queue-length=1
          operation=InvalidateNvBlock, queue-length=1
          operation=ReadBlock, queue-length=1
          operation=SetRamBlockStatus, queue-length=1
          operation=WriteBlock, queue-length=1
      PS_Rte_NvmBlock_LrnEOT_LearnedEOT: provided-interface=NvM_AC3_SRBS_Srv  # P-Port Prototype of NvM_AC3_SRBS_Srv for NVRAM Block Rte_NvmBlock_LrnEOT_LearnedEOT
        provided-com-specs:
          operation=EraseBlock, queue-length=1
          operation=GetErrorStatus, queue-length=1
          operation=InvalidateNvBlock, queue-length=1
          operation=ReadBlock, queue-length=1
          operation=SetRamBlockStatus, queue-length=1
          operation=WriteBlock, queue-length=1
      PS_Rte_NvmBlock_Polarity_Polarity_Cnt_Str: provided-interface=NvM_AC3_SRBS_Srv  # P-Port Prototype of NvM_AC3_SRBS_Srv for NVRAM Block Rte_NvmBlock_Polarity_Polarity_Cnt_Str
        provided-com-specs:
          operation=EraseBlock, queue-length=1
          operation=GetErrorStatus, queue-length=1
          operation=InvalidateNvBlock, queue-length=1
          operation=ReadBlock, queue-length=1
          operation=SetRamBlockStatus, queue-length=1
          operation=WriteBlock, queue-length=1
      PS_Rte_NvmBlock_PsaAgArbn_PsaAgArbnLrndOffsData: provided-interface=NvM_AC3_SRBS_Srv  # P-Port Prototype of NvM_AC3_SRBS_Srv for NVRAM Block Rte_NvmBlock_PsaAgArbn_PsaAgArbnLrndOffsData
        provided-com-specs:
          operation=EraseBlock, queue-length=1
          operation=GetErrorStatus, queue-length=1
          operation=InvalidateNvBlock, queue-length=1
          operation=ReadBlock, queue-length=1
          operation=SetRamBlockStatus, queue-length=1
          operation=WriteBlock, queue-length=1
      PS_Rte_NvmBlock_Sa_DigMSB_DigMSBEOLData: provided-interface=NvM_AC3_SRBS_Srv  # P-Port Prototype of NvM_AC3_SRBS_Srv for NVRAM Block Rte_NvmBlock_Sa_DigMSB_DigMSBEOLData
        provided-com-specs:
          operation=EraseBlock, queue-length=1
          operation=GetErrorStatus, queue-length=1
          operation=InvalidateNvBlock, queue-length=1
          operation=ReadBlock, queue-length=1
          operation=SetRamBlockStatus, queue-length=1
          operation=WriteBlock, queue-length=1
      PS_Rte_NvmBlock_SrlComInput_ElecIntData: provided-interface=NvM_AC3_SRBS_Srv  # P-Port Prototype of NvM_AC3_SRBS_Srv for NVRAM Block Rte_NvmBlock_SrlComInput_ElecIntData
        provided-com-specs:
          operation=EraseBlock, queue-length=1
          operation=GetErrorStatus, queue-length=1
          operation=InvalidateNvBlock, queue-length=1
          operation=ReadBlock, queue-length=1
          operation=SetRamBlockStatus, queue-length=1
          operation=WriteBlock, queue-length=1
      PS_Rte_NvmBlock_SrlComInput_ShutdownTimeData: provided-interface=NvM_AC3_SRBS_Srv  # P-Port Prototype of NvM_AC3_SRBS_Srv for NVRAM Block Rte_NvmBlock_SrlComInput_ShutdownTimeData
        provided-com-specs:
          operation=EraseBlock, queue-length=1
          operation=GetErrorStatus, queue-length=1
          operation=InvalidateNvBlock, queue-length=1
          operation=ReadBlock, queue-length=1
          operation=SetRamBlockStatus, queue-length=1
          operation=WriteBlock, queue-length=1
      PS_Rte_NvmBlock_SrlComInput_VVHTYPEData: provided-interface=NvM_AC3_SRBS_Srv  # P-Port Prototype of NvM_AC3_SRBS_Srv for NVRAM Block Rte_NvmBlock_SrlComInput_VVHTYPEData
        provided-com-specs:
          operation=EraseBlock, queue-length=1
          operation=GetErrorStatus, queue-length=1
          operation=InvalidateNvBlock, queue-length=1
          operation=ReadBlock, queue-length=1
          operation=SetRamBlockStatus, queue-length=1
          operation=WriteBlock, queue-length=1
      PS_Rte_NvmBlock_StaMd_CloseCheckData: provided-interface=NvM_AC3_SRBS_Srv  # P-Port Prototype of NvM_AC3_SRBS_Srv for NVRAM Block Rte_NvmBlock_StaMd_CloseCheckData
        provided-com-specs:
          operation=EraseBlock, queue-length=1
          operation=GetErrorStatus, queue-length=1
          operation=InvalidateNvBlock, queue-length=1
          operation=ReadBlock, queue-length=1
          operation=SetRamBlockStatus, queue-length=1
          operation=WriteBlock, queue-length=1
      PS_Rte_NvmBlock_StaMd_TypeHRamBuffer: provided-interface=NvM_AC3_SRBS_Srv  # P-Port Prototype of NvM_AC3_SRBS_Srv for NVRAM Block Rte_NvmBlock_StaMd_TypeHRamBuffer
        provided-com-specs:
          operation=EraseBlock, queue-length=1
          operation=GetErrorStatus, queue-length=1
          operation=InvalidateNvBlock, queue-length=1
          operation=ReadBlock, queue-length=1
          operation=SetRamBlockStatus, queue-length=1
          operation=WriteBlock, queue-length=1
      PS_Rte_NvmBlock_ThrmlDutyCycle_ThrmlDutyCycle_FltStVal: provided-interface=NvM_AC3_SRBS_Srv  # P-Port Prototype of NvM_AC3_SRBS_Srv for NVRAM Block Rte_NvmBlock_ThrmlDutyCycle_ThrmlDutyCycle_FltStVal
        provided-com-specs:
          operation=EraseBlock, queue-length=1
          operation=GetErrorStatus, queue-length=1
          operation=InvalidateNvBlock, queue-length=1
          operation=ReadBlock, queue-length=1
          operation=SetRamBlockStatus, queue-length=1
          operation=WriteBlock, queue-length=1
      PS_Rte_NvmBlock_TrqCanc_CogTrqCal: provided-interface=NvM_AC3_SRBS_Srv  # P-Port Prototype of NvM_AC3_SRBS_Srv for NVRAM Block Rte_NvmBlock_TrqCanc_CogTrqCal
        provided-com-specs:
          operation=EraseBlock, queue-length=1
          operation=GetErrorStatus, queue-length=1
          operation=InvalidateNvBlock, queue-length=1
          operation=ReadBlock, queue-length=1
          operation=SetRamBlockStatus, queue-length=1
          operation=WriteBlock, queue-length=1
      PS_Rte_NvmBlock_TrqCanc_CogTrqRplComp: provided-interface=NvM_AC3_SRBS_Srv  # P-Port Prototype of NvM_AC3_SRBS_Srv for NVRAM Block Rte_NvmBlock_TrqCanc_CogTrqRplComp
        provided-com-specs:
          operation=EraseBlock, queue-length=1
          operation=GetErrorStatus, queue-length=1
          operation=InvalidateNvBlock, queue-length=1
          operation=ReadBlock, queue-length=1
          operation=SetRamBlockStatus, queue-length=1
          operation=WriteBlock, queue-length=1
      PS_Rte_NvmBlock_TrqCmdScl_TorqueCmdSF_Uls_f32: provided-interface=NvM_AC3_SRBS_Srv  # P-Port Prototype of NvM_AC3_SRBS_Srv for NVRAM Block Rte_NvmBlock_TrqCmdScl_TorqueCmdSF_Uls_f32
        provided-com-specs:
          operation=EraseBlock, queue-length=1
          operation=GetErrorStatus, queue-length=1
          operation=InvalidateNvBlock, queue-length=1
          operation=ReadBlock, queue-length=1
          operation=SetRamBlockStatus, queue-length=1
          operation=WriteBlock, queue-length=1
      PS_Rte_NvmBlock_VehDyn_MotPosReset: provided-interface=NvM_AC3_SRBS_Srv  # P-Port Prototype of NvM_AC3_SRBS_Srv for NVRAM Block Rte_NvmBlock_VehDyn_MotPosReset
        provided-com-specs:
          operation=EraseBlock, queue-length=1
          operation=GetErrorStatus, queue-length=1
          operation=InvalidateNvBlock, queue-length=1
          operation=ReadBlock, queue-length=1
          operation=SetRamBlockStatus, queue-length=1
          operation=WriteBlock, queue-length=1
  swc implementation NvM_Implementation: behavior=NvM_InternalBehavior
    code-descriptors:
      code Code: type=SRC
