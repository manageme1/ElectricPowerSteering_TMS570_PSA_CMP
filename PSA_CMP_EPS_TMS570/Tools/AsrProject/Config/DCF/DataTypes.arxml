AUTOSAR XML (schema 314)
standard types defined: Boolean, SInt16, SInt32, SInt8, UInt16, UInt32, UInt8, Double, Float
package /DataType
  19 x array type:
    AvgFricLrnRangeCounterSubType
      element AvgFricLrnRangeCounterSubType: type=UInt16, max-number-of-elements=3
    AvgFricLrnRangeCounterType
      element AvgFricLrnRangeCounterType: type=AvgFricLrnRangeCounterSubType, max-number-of-elements=8
    AvgFricLrnThetaSubType
      element AvgFricLrnThetaSubType: type=Float, max-number-of-elements=4
    AvgFricLrnThetaType
      element AvgFricLrnThetaType: type=AvgFricLrnThetaSubType, max-number-of-elements=8
    AvgFricLrnVehLearnedFricType
      element AvgFricLrnVehLearnedFricType: type=Float, max-number-of-elements=4
    CanMsgType
      element CanMsgType: type=UInt8, max-number-of-elements=8
    CoggingCancTrq
      element CoggingCancTrq: type=UInt16, max-number-of-elements=512
    CoggingCancTrqRplComp
      element CoggingCancTrqRplComp: type=UInt16, max-number-of-elements=9
    CurrTempOffsetTblType
      element CurrTempOffsetTblType: type=SInt16, max-number-of-elements=16
    Dem_MaxDataValueType
      element Dem_MaxDataValueType: type=UInt8, max-number-of-elements=3
    Dem_MaxExtendedDataRecordType
      element Dem_MaxExtendedDataRecordType: type=UInt8, max-number-of-elements=1
    DT_Array144_s8
      element DT_Array144_s8: type=SInt8, max-number-of-elements=144
    DT_Array2_u16
      element DT_Array2_u16: type=UInt16, max-number-of-elements=2
    DT_SinTanLkpTbl_f32
      element DT_SinTanLkpTbl_f32: type=Float, max-number-of-elements=193
    FaultDataArrayType
      element FaultDataArrayType: type=FaultDataType, max-number-of-elements=60
    HarCompTbl
      element HarCompTbl: type=SInt16, max-number-of-elements=1024
    IPMCoggingCancTrq
      element IPMCoggingCancTrq: type=UInt16, max-number-of-elements=512
    NvM_DestPtr  # DataPtr Type to be used by WriteBlock, ReadBlock and RestoreBlockDefaults operations. This type is used for all NVRAM blocks
      element NvM_DestPtr: type=UInt8, max-number-of-elements=65535
    QueueDataArrayType
      element QueueDataArrayType: type=QueueDataType, max-number-of-elements=120
  12 x boolean type:
    AUTOR_ARRET_MOT_DA
      invalid-value:
        boolean literal AUTOR_ARRET_MOT_DA: type=AUTOR_ARRET_MOT_DA, value=false
    CALIBRATION_VOL
      invalid-value:
        boolean literal CALIBRATION_VOL: type=CALIBRATION_VOL, value=true
    DDE_REDEM_DA
      invalid-value:
        boolean literal DDE_REDEM_DA: type=DDE_REDEM_DA, value=false
    ETAT_CAPT_VOL
      invalid-value:
        boolean literal ETAT_CAPT_VOL: type=ETAT_CAPT_VOL, value=true
    ETAT_LIGNE_APC
      invalid-value:
        boolean literal ETAT_LIGNE_APC: type=ETAT_LIGNE_APC, value=false
    ETAT_SECU_ANGLE_COL
      invalid-value:
        boolean literal ETAT_SECU_ANGLE_COL: type=ETAT_SECU_ANGLE_COL, value=false
    FLG_AVOL_ICN
      invalid-value:
        boolean literal FLG_AVOL_ICN: type=FLG_AVOL_ICN, value=false
    FLG_INIT_AVOL
      invalid-value:
        boolean literal FLG_INIT_AVOL: type=FLG_INIT_AVOL, value=false
    SENS_ROT_VOL
    STEERWHL_HOLD_BY_DRV
      invalid-value:
        boolean literal STEERWHL_HOLD_BY_DRV: type=STEERWHL_HOLD_BY_DRV, value=false
    TRIM_VOL
      invalid-value:
        boolean literal TRIM_VOL: type=TRIM_VOL, value=true
    TRQ_LIMIT_STATE
      invalid-value:
        boolean literal TRQ_LIMIT_STATE: type=TRQ_LIMIT_STATE, value=false
  87 x integer type:
    ANGLE_COLONNE: compu {phys=raw*0.1 for raw -1630..1630; unit Deg}, lower-limit=-16300, upper-limit=16300
      invalid-value:
        integer literal ANGLE_COLONNE: type=ANGLE_COLONNE, value=0
    ANGLE_VOLANT: compu {phys=raw*0.1 for raw -780..780; unit Deg}, lower-limit=-7800, upper-limit=7800
      invalid-value:
        integer literal ANGLE_VOLANT: type=ANGLE_VOLANT, value=0
    ANGLE_VOLANT_ORIGINE: compu {phys=raw}, lower-limit=0, upper-limit=3
      invalid-value:
        integer literal ANGLE_VOLANT_ORIGINE: type=ANGLE_VOLANT_ORIGINE, value=3
    APA_State_enum: compu {0=APA_TempInhibit, 1=APA_AvailCntrl, 2=APA_Active, 3=APA_PermanentlyFailed, 4=APA_ManufacturingDisable}, lower-limit=0, upper-limit=4
    ApaAbortSt_State_enum: compu {0=CAAPAABORTST_NODRVGINTRPT, 1=CAAPAABORTST_DRVRRCVRY, 2=CAAPAABORTST_HIVEHSPDERR, 3=CAAPAABORTST_AGRDELTAERR, 4=CAAPAABORTST_AGRSPDERR, 5=CAAPAABORTST_THERMLIM, 6=CAAPAABORTST_ASSISTALLLIM, 7=CAAPAABORTST_RESD}, lower-limit=0, upper-limit=7
    ApaReqSt_State_enum: compu {0=CAAPAREQST_NOREQ, 1=CAAPAREQST_REQCTRL, 2=CAAPAREQST_CTRLACTV}, lower-limit=0, upper-limit=2
    BattSwdVltgCorrSts_Cnt_enum: compu {0=BSVCS_NOFLT, 1=BSVCS_BATTVLTGSWD2FLT, 2=BSVCS_BATTVLTGSWD1FLT, 3=BSVCS_BATTVLTGFLT, 4=BSVCS_NOCORRLN}, lower-limit=0, upper-limit=4
    BattVltgSt_Cnt_enum: compu {0=SYSPRFMNCST_NORMOPER, 1=SYSPRFMNCST_HIVLTGWARN, 2=SYSPRFMNCST_HIVLTGCRIT, 3=SYSPRFMNCST_HIVLTGOFF, 4=SYSPRFMNCST_LOVLTGWARN, 5=SYSPRFMNCST_LOVLTGCRIT, 6=SYSPRFMNCST_LOVLTGOFF}, lower-limit=0, upper-limit=6
    BmwDrvgDynIfSt_State_enum: compu {32=Cx20_Schnittstelle_verfuegbar___funktionsbereit, 33=Cx21_Schnittstelle_aktiv, 96=Cx60_Service_nicht_verfuegbar___Fehler, 128=Cx80_Schnittstelle_wird_initialisiert, 224=CxE0_Service_nicht_verfuegbar___Standby___PMA, 225=CxE1_Service_nicht_verfuegbar___Standby___EPS_Status, 255=CxFF_Signal_ungueltig}, lower-limit=32, upper-limit=255
    CAUSE_DESACTIV_CPK: compu {phys=raw}, lower-limit=0, upper-limit=7
      invalid-value:
        integer literal CAUSE_DESACTIV_CPK: type=CAUSE_DESACTIV_CPK, value=0
    CHKSUM_TRME_DYN_DAE: lower-limit=0, upper-limit=15
      invalid-value:
        integer literal CHKSUM_TRME_DYN_DAE: type=CHKSUM_TRME_DYN_DAE, value=4
    CHKSUM_VOL: lower-limit=0, upper-limit=15
    CODE_DEFAUT: compu {phys=raw for raw 0..1}, lower-limit=0, upper-limit=255
      invalid-value:
        integer literal CODE_DEFAUT: type=CODE_DEFAUT, value=0
    CODE_DEFAUT_VOL: compu {phys=raw for raw 0..4}, lower-limit=0, upper-limit=15
    CPLE_VOLANT: compu {phys=raw*0.25 for raw -32..32; unit Nm}, lower-limit=-128, upper-limit=127  # Scaling range Max limit is wrong. Tool does not let to set real value, only decimal
      invalid-value:
        integer literal CPLE_VOLANT: type=CPLE_VOLANT, value=127
    CPLE_VOLANT_OPTMSE: compu {phys=raw*0.1 for raw -10..10; unit Nm}, lower-limit=-100, upper-limit=100
      invalid-value:
        integer literal CPLE_VOLANT_OPTMSE: type=CPLE_VOLANT_OPTMSE, value=0
    CPT_PROCESS_4B_A_VOL: lower-limit=0, upper-limit=15
    CPT_PROCESS_4B_DAE: lower-limit=0, upper-limit=15
      invalid-value:
        integer literal CPT_PROCESS_4B_DAE: type=CPT_PROCESS_4B_DAE, value=0
    Dem_DTCKindType: compu {1=DEM_DTC_KIND_ALL_DTCS, 2=DEM_DTC_KIND_EMISSION_REL_DTCS}, lower-limit=1, upper-limit=2
    Dem_DTCStatusMaskType: lower-limit=0, upper-limit=255
    Dem_DTCType: lower-limit=0, upper-limit=4294967295
    Dem_EventIdType: lower-limit=0, upper-limit=255
    Dem_EventStatusExtendedType: lower-limit=0, upper-limit=255
    Dem_EventStatusType: compu {0=DEM_EVENT_STATUS_PASSED, 1=DEM_EVENT_STATUS_FAILED, 2=DEM_EVENT_STATUS_PREPASSED, 3=DEM_EVENT_STATUS_PREFAILED}, lower-limit=0, upper-limit=255
    Dem_FaultDetectionCounterType: lower-limit=-128, upper-limit=127
    Dem_IndicatorStatusType: compu {0=DEM_INDICATOR_OFF, 1=DEM_INDICATOR_CONTINUOUS, 2=DEM_INDICATOR_BLINKING, 3=DEM_INDICATOR_BLINK_CONT}, lower-limit=0, upper-limit=3
    Dem_InitMonitorKindType: compu {1=DEM_INIT_MONITOR_CLEAR, 2=DEM_INIT_MONITOR_RESTART}, lower-limit=0, upper-limit=2
    Dem_OperationCycleIdType: lower-limit=0, upper-limit=255
    Dem_OperationCycleStateType: compu {1=DEM_CYCLE_STATE_START, 2=DEM_CYCLE_STATE_END}, lower-limit=1, upper-limit=2
    Dem_SuppressDTCStatusType: compu {0=DEM_SUPPRESS_DTC_OFF, 1=DEM_SUPPRESS_DTC_ON}, lower-limit=0, upper-limit=1
    DrvrModCtrl_enum: compu {1=DMC_NORMAL, 2=DMC_SPORT, 3=DMC_SNOW, 4=DMC_TOUR}, lower-limit=1, upper-limit=4
    EcuM_StateType:
      compu {16=ECUM_STATE_STARTUP, 17=ECUM_STATE_STARTUP_ONE, 18=ECUM_STATE_STARTUP_TWO, 32=ECUM_STATE_WAKEUP, 33=ECUM_STATE_WAKEUP_ONE, 34=ECUM_STATE_WAKEUP_VALIDATION, 35=ECUM_STATE_WAKEUP_REACTION, 36=ECUM_STATE_WAKEUP_TWO, 37=ECUM_STATE_WAKEUP_WAKESLEEP, 38=ECUM_STATE_WAKEUP_TTII, 48=ECUM_STATE_RUN, 50=ECUM_STATE_APP_RUN, 51=ECUM_STATE_APP_POST_RUN, 64=ECUM_STATE_SHUTDOWN, 68=ECUM_STATE_PREP_SHUTDOWN, 73=ECUM_STATE_GO_SLEEP, 77=ECUM_STATE_GO_OFF_ONE, 78=ECUM_STATE_GO_OFF_TWO, 80=ECUM_STATE_SLEEP, 128=ECUM_STATE_OFF, 144=ECUM_STATE_RESET, 255=ECUM_STATE_ERROR}
      lower-limit=16
      upper-limit=255
    EcuM_UserType: lower-limit=0, upper-limit=255
    EnergyModeStateType: compu {0=NORMAL, 1=PRODUCTION, 2=TRANSPORTATION, 3=FLASH}, lower-limit=0, upper-limit=3
    EPS_STATE_LKA: compu {phys=raw for raw 0..4}, lower-limit=0, upper-limit=15
    ESC_State_enum: compu {0=ESC_Inactive, 1=ESC_Active, 2=ESC_TemporarilyLimited, 3=ESC_PermanentlyFailed, 4=ESC_ManufacturingDisable}, lower-limit=0, upper-limit=4
    ETAT_ASSIST_DA: compu {phys=raw}, lower-limit=0, upper-limit=7
      invalid-value:
        integer literal ETAT_ASSIST_DA: type=ETAT_ASSIST_DA, value=0
    ETAT_DA_2004: compu {phys=raw}, lower-limit=0, upper-limit=3
      invalid-value:
        integer literal ETAT_DA_2004: type=ETAT_DA_2004, value=0
    ETAT_DA_2010: compu {phys=raw}, lower-limit=0, upper-limit=3
      invalid-value:
        integer literal ETAT_DA_2010: type=ETAT_DA_2010, value=0
    ETAT_DA_DYN: compu {phys=raw}, lower-limit=0, upper-limit=3
      invalid-value:
        integer literal ETAT_DA_DYN: type=ETAT_DA_DYN, value=0
    ETAT_DAE_CAV3_VIRTUEL: compu {phys=raw}, lower-limit=0, upper-limit=7
      invalid-value:
        integer literal ETAT_DAE_CAV3_VIRTUEL: type=ETAT_DAE_CAV3_VIRTUEL, value=0
    ETAT_DAE_CPK: compu {phys=raw}, lower-limit=0, upper-limit=3
      invalid-value:
        integer literal ETAT_DAE_CPK: type=ETAT_DAE_CPK, value=0
    FETFAULTTYPE_ENUM: compu {0=NOFAULT, 1=LOWER, 2=UPPER}, lower-limit=0, upper-limit=255
    FETPHASETYPE_ENUM: compu {0=NOPHASE, 1=PHASEA, 2=PHASEB, 3=PHASEC}, lower-limit=0, upper-limit=255
    FltInjectionLocType:
      compu {1=FLTINJ_ASSIST, 2=FLTINJ_RETURN, 3=FLTINJ_DAMPING, 4=FLTINJ_ASSTSUMNLMT, 7=FLTINJ_AVGFRICLRN, 12=FLTINJ_HYSTCOMP, 14=FLTINJ_INERTIACOMP, 30=FLTINJ_TRQBASEDINRTCOMP, 29=FLTINJ_STABILITYCOMP, 33=FLTINJ_SRLCOMVEHSPD_SGNLCOND, 34=FLTINJ_ASSTFIREWALL, 150=FLTINJ_DDASTFACTRQST_DRVDYNCTRL, 151=FLTINJ_DDDMPFACTRQST_DRVDYNCTRL, 152=FLTINJ_DDRTNFACTRQST_DRVDYNCTRL, 38=FLTINJ_ASSTEOTGAIN_LMTCOD, 153=FLTINJ_OUTPUTRAMPMULT_LMTCOD, 154=FLTINJ_ASSTEOTLIMIT_LMTCOD, 8=FLTINJ_VECU_BATTERYVOLTAGE, 27=FLTINJ_EOTDAMPING_ETDMPFW, 155=FLTINJ_SRLCOMVEHLONACCEL_SGNLCOND, 156=FLTINJ_ANAHWTORQUE, 160=FLTINJ_MTRVEL, 101=FLTINJ_TRQARBLIM_LKACMD, 91=FLTINJ_TRQOVLSTA_LKAFAULT, 200=FLTINJ_PRKASTMFGSERVCH2_PRKASSISTCMD, 201=FLTINJ_PRKASTMFGSERVCH2_LRNPNCNTR, 41=FLTINJ_DIGHWTRQSENT_T1FAULT, 42=FLTINJ_DIGHWTRQSENT_T2FAULT, 46=FLTINJ_GCCDIAG_HWTRQ, 146=FLTINJ_GCCDIAG_VEHSPD, 246=FLTINJ_GCCDIAG_MTRTRQ, 100=FLTINJ_SRLCOMVEHYAWRATE_SGNLCOND, 255=FLTINJ_SRLCOMVEHLATACCEL_SGNLCOND, 25=FLTINJ_SUPPPWRLMT_CUSTPL, 43=FLTINJ_TRQOSC_PREFINALCOMMAND, 44=FLTINJ_IMCARBCROLLGCNTR, 45=FLTINJ_IMCARBRCRC, 46=FLTINJ_IMCARBRDATA, 47=FLTINJ_IMCARBRPATIDN, 48=FLTINJ_CMMTRCURR1, 49=FLTINJ_CMMTRCURR2, 50=FLTINJ_NHET1CFGANDUSE1, 51=FLTINJ_NHET1CFGANDUSE2, 52=FLTINJ_EPWM_UP1, 53=FLTINJ_EPWM_UP2, 54=FLTINJ_EPWM_UP3, 65=FLTINJ_IMCARBROPENCAN, 66=FLTINJ_IMCARBROPENCANSCI, 67=FLTINJ_IMCARBROPENSCI, 68=FLTINJ_BMWTOC, 39=FLTINJ_ANAHWTRQT1, 40=FLTINJ_ANAHWTRQT2, 69=FLTINJ_PULLCMPACTV}
      lower-limit=0
      upper-limit=255
    GmStrtStopSt_State_enum: compu {0=GMSTRTSTOPST_FCTINACTV, 1=GMSTRTSTOPST_NORMMOD, 2=GMSTRTSTOPST_INTER1MOD, 3=GMSTRTSTOPST_INTER2MOD, 4=GMSTRTSTOPST_STOPMOD, 5=GMSTRTSTOPST_SPLRMFGMOD}, lower-limit=0, upper-limit=5
    Haptic_State_enum: compu {0=Haptic_Inactive, 1=Haptic_Active, 2=Haptic_Waiting}, lower-limit=0, upper-limit=2
    ImcArbrDataSrc_enum: compu {1=IMCARBRDS_CAN, 0=IMCARBRDS_SCI}, lower-limit=0, upper-limit=255
    ImcArbrRxSts_enum: compu {0=IMCARBRRXSTS_NODATA, 1=IMCARBRRXSTS_VALID, 2=IMCARBRRXSTS_INVALID}, lower-limit=0, upper-limit=2
    IoHwAb_BoolType: lower-limit=0, upper-limit=1
    LdwSt_State_enum: compu {0=CALDWST_HAPTCRDY, 1=CALDWST_HAPTCACTV, 2=CALDWST_TMPLIMD, 3=CALDWST_DI}, lower-limit=0, upper-limit=3
    LKA_State_enum: compu {0=LKA_Inactive, 1=LKA_Active, 2=LKA_TemporarilyLimited, 3=LKA_PermanentlyFailed, 4=LKA_ManufacturingDisable}, lower-limit=0, upper-limit=4
    LkaSt_State_enum: compu {0=CALKAST_TMPLIMD, 1=CALKAST_INACTV, 2=CALKAST_ACTV, 3=CALKAST_TMPFAILD, 4=CALKAST_PRMNTFAILD, 5=CALKAST_MFGDI}, lower-limit=0, upper-limit=5
    LOA_State_enum: compu {0=LOAST_NORM, 1=LOAST_REDCD, 2=LOAST_SWBASDMTGTN, 3=LOAST_FADEOUT, 4=LOAST_CTRLDSHTDWNREQD, 5=LOAST_RPDSHTDWNREQD}, lower-limit=0, upper-limit=5
    ManufModeType: compu {0=ProductionMode, 1=ManufacturingMode, 2=EngineeringMode}, lower-limit=0, upper-limit=2
    MtrCurrOffProcessFlag: compu {0=CURROFF_INIT, 1=CURROFF_PROCESSING, 2=CURROFF_PASS, 3=CURROFF_FAIL}, lower-limit=0, upper-limit=4
    NTCNumber:
      compu {1=NTC_Num_FlashWrapperLgcFlt, 2=NTC_Num_FlashECCCorr, 3=NTC_Num_FlashECCMemFlt, 4=NTC_Num_FlashCRCMemFault, 6=NTC_Num_NvMBlkDftActA, 7=NTC_Num_NvMBlkDftActB, 8=NTC_Num_NvMBlkDftActC, 9=NTC_Num_CurrentSensorCalOutOfRange, 10=NTC_Num_EEPROMDiag, 11=NTC_Num_EEPROMDiagMtrStr, 12=NTC_Num_PriSnsrTrqStorFlt, 13=NTC_Num_EEPROMDiagPosTrimStr, 14=NTC_Num_SecSnsrTrqStorFlt, 15=NTC_Num_EEPROMDiagPolarityStr, 16=NTC_Num_RAMDiag_GeneralFlt, 17=NTC_Num_RAMDiag_WrprLgcFlt, 18=NTC_Num_RAMDiag_ECCCorrIndFlt, 19=NTC_Num_RAMDiag_ECCMemFlt, 20=NTC_Num_RAMDiag_CRCMemFlt, 23=NTC_Num_RAMDiag_VIMRamFlt, 24=NTC_Num_RAMDiag_NHET1RamFlt, 25=NTC_Num_RAMDiag_NHET2RamFlt, 26=NTC_Num_RAMDiag_ADC1RamFlt, 27=NTC_Num_RAMDiag_DCANRamFault, 28=NTC_Num_RAMDiag_ADC2RamFlt, 29=NTC_Num_RAMDiag_HETTU1RamFlt, 30=NTC_Num_RAMDiag_HETTU2RamFlt, 32=NTC_Num_CPU_RegVer, 33=NTC_Num_CPU_CoreInitFlt, 34=NTC_Num_CPU_CoreRunTimeFlt, 35=NTC_Num_CPU_ClockMon, 36=NTC_Num_CPU_eFuseFlt, 37=NTC_Num_CPU_MPUViolation, 40=NTC_Num_CPU_FactPrcsErr, 41=NTC_Num_PropExeDiag_InitDiag, 42=NTC_Num_PrgFlwDeadlnFlt, 43=NTC_Num_PropExeDiag_RunTimeDiag, 44=NTC_Num_PropExeDiag_COPTimeout, 48=NTC_Num_PropExeDiag_PrefetchAbort, 49=NTC_Num_PropExeDiag_DataAbort, 50=NTC_Num_PerDiag_ADC1Flt, 51=NTC_Num_PerDiag_ADC2Flt, 52=NTC_Num_PerDiag_ADCCrossChkFlt, 53=NTC_Num_PerDiag_IllegalAccess, 54=NTC_Num_PerDiag_DMAFlt, 55=NTC_Num_PeripheralStartupFlt, 63=NTC_Num_PerDiag_CPUWarning, 64=NTC_Num_TmpMonFunc, 65=NTC_Num_TmpMonRunTimeFlt, 66=NTC_Num_PowerRelayInitFlt, 67=NTC_Num_PrechargeFailure, 68=NTC_Num_PowerRelayRunFlt, 69=NTC_Num_Thermistor, 70=NTC_Num_RefSupplyVltg, 71=NTC_Num_TrcvrInterfaceFlt, 72=NTC_Num_CPUSupplyOvervoltage, 76=NTC_Num_GateDrvFltInProcess, 77=NTC_Num_GateDrvFlt, 78=NTC_Num_OnStateSingleFET, 79=NTC_Num_OnStateMultiFET, 80=NTC_Num_PhaseVoltageVerf, 81=NTC_Num_PhaseDscnt, 82=NTC_Num_DigPhaseVoltageVerf, 83=NTC_Num_PhaseDscntFailedDisable, 84=NTC_Num_CurrentMeas1, 85=NTC_Num_CurrentMeas2, 86=NTC_Num_CurrentMeasCrossChk, 87=NTC_Num_PDSupplyOverVoltage, 88=NTC_Num_ChargePumpUnderVoltage, 96=NTC_Num_HwTrqSensor, 97=NTC_Num_AnaVsDigHwTrq, 98=NTC_Num_TrqSensorRecoveryFlt, 100=NTC_Num_TrqSensorScaleInvalid, 101=NTC_Num_T1vsT2, 102=NTC_Num_T1OutofRange, 103=NTC_Num_T2OutofRange, 104=NTC_Num_DigT1vsT2, 105=NTC_Num_DigT1OutofRange, 106=NTC_Num_DigT2OutofRange, 107=NTC_Num_RedT1vsT2, 108=NTC_Num_HWACrossChecks, 109=NTC_Num_HWASnsrCommFault, 110=NTC_Num_HWASensorRel, 111=NTC_Num_HWASensorAbs, 112=NTC_Num_PriMSB_SinCosCorr, 113=NTC_Num_SecMSB_SinCosCorr, 114=NTC_Num_PriVsSec_SinCosCorr, 115=NTC_Num_DigMSBFlt, 116=NTC_Num_MtrVelFlt, 117=NTC_Num_HWAtoMtrAngleCorr, 118=NTC_Num_RedPriVsSec_SinCosCorr, 128=NTC_Num_TurnCntr_PosLoss, 129=NTC_Num_TurnCntr_MicroProcFlt, 130=NTC_Num_TurnCntr_SensorPosFlt, 131=NTC_Num_TurnCntr_SpiComFlt, 132=NTC_Num_TurnCntr_HighQuiescCur, 133=NTC_Num_TurnCntr_MainResets, 134=NTC_Num_TurnCntr_PosLossNotSpdDep, 144=NTC_Num_KinematicIntDiag, 145=NTC_Num_HighFriction, 148=NTC_Num_DutyCycleExceeded, 149=NTC_Num_AbsTempThermLimit, 160=NTC_Num_LatchActive, 168=NTC_Num_OpTrqVsHwTrq, 169=NTC_Num_CurrentReas, 170=NTC_Num_LoaRpdShutdn, 176=NTC_Num_OpVoltage, 177=NTC_Num_ExVoltageLow, 178=NTC_Num_ReducedAsstLowVoltage, 180=NTC_Num_ExVoltageHigh, 181=NTC_Num_OpVoltageOvrMax, 182=NTC_Num_BattTransOverVolt, 184=NTC_Num_IgnConfDiag, 185=NTC_Num_TurnCntr_LowBattery, 191=NTC_Num_EEPROMCloseFailed, 192=NTC_Num_SigPath1CrossChk, 193=NTC_Num_SigPath2CrossChk, 194=NTC_Num_SigPath3CrossChk, 195=NTC_Num_SigPath4CrossChk, 196=NTC_Num_SigPath5CrossChk, 197=NTC_Num_DampingFWReached, 198=NTC_Num_AssistFWReached, 199=NTC_Num_ReturnFWReached, 200=NTC_Num_DampingFWFltMode, 201=NTC_Num_AssistFWFltMode, 202=NTC_Num_VBICFltMode, 203=NTC_Num_StaMdsSysC, 204=NTC_NUM_SysFailureForRotVel, 205=NTC_NUM_SysFailForRedntRotVel, 206=NTC_Num_SysFailureForTrqSnsr, 207=NTC_Num_SysFailureForRedTrqSnsr, 209=NTC_NUM_SysFailureForCtrlVolt, 223=NTC_Num_GlblSgnlOvrwrtDet, 224..255=NTC_Num_VLF_00..NTC_Num_VLF_31, 256=NTC_Num_BusOffCh1, 257=NTC_Num_BusOffCh1NodeMute, 258=NTC_Num_Node1AAbsent, 259=NTC_Num_Node1AFaulty, 260=NTC_Num_Node1BAbsent, 261=NTC_Num_Node1BFaulty, 262=NTC_Num_Node1CAbsent, 263=NTC_Num_Node1CFaulty, 264=NTC_Num_Node1DAbsent, 265=NTC_Num_Node1DFaulty, 266=NTC_Num_Node1EAbsent, 267=NTC_Num_Node1EFaulty, 268=NTC_Num_Node1FAbsent, 269=NTC_Num_Node1FFaulty, 270=NTC_Num_Node1GAbsent, 271=NTC_Num_Node1GFaulty, 272=NTC_Num_BusOffCh2, 273=NTC_Num_Node2AAbsent, 274=NTC_Num_Node2AFaulty, 275=NTC_Num_Node2BAbsent, 276=NTC_Num_Node2BFaulty, 277=NTC_Num_Node2CAbsent, 278=NTC_Num_Node2CFaulty, 279=NTC_Num_Node2DAbsent, 280=NTC_Num_Node2DFaulty, 281=NTC_Num_Node2EAbsent, 282=NTC_Num_Node2EFaulty, 283=NTC_Num_Node2FAbsent, 284=NTC_Num_Node2FFaulty, 285=NTC_Num_Node2GAbsent, 286=NTC_Num_Node2GFaulty, 288=NTC_Num_InvalidMsg_M, 289=NTC_Num_MissingMsg_M, 290=NTC_Num_CRCFltMsg_M, 291=NTC_Num_PgrsCntFltMsg_M, 292=NTC_Num_DataRngFltMsg_M, 293=NTC_Num_DataRateFltMsg_M, 294=NTC_Num_DataOtherFltMsg_M, 295=NTC_Num_DataOther2FltMsg_M, 296=NTC_Num_InvalidMsg_N, 297=NTC_Num_MissingMsg_N, 298=NTC_Num_CRCFltMsg_N, 299=NTC_Num_PgrsCntFltMsg_N, 300=NTC_Num_DataRngFltMsg_N, 301=NTC_Num_DataRateFltMsg_N, 302=NTC_Num_DataOtherFltMsg_N, 303=NTC_Num_DataOtherFlt2Msg_N, 304=NTC_Num_InvalidMsg_O, 305=NTC_Num_MissingMsg_O, 306=NTC_Num_CRCFltMsg_O, 307=NTC_Num_PgrsCntFltMsg_O, 308=NTC_Num_DataRngFltMsg_O, 309=NTC_Num_DataRateFltMsg_O, 310=NTC_Num_DataOtherFltMsg_O, 312=NTC_Num_InvalidMsg_P, 313=NTC_Num_MissingMsg_P, 314=NTC_Num_CRCFltMsg_P, 315=NTC_Num_PgrsCntFltMsg_P, 316=NTC_Num_DataRngFltMsg_P, 317=NTC_Num_DataRateFltMsg_P, 318=NTC_Num_DataOtherFltMsg_P, 320=NTC_Num_InvalidMsg_Q, 321=NTC_Num_MissingMsg_Q, 322=NTC_Num_CRCFltMsg_Q, 323=NTC_Num_PgrsCntFltMsg_Q, 324=NTC_Num_DataRngFltMsg_Q, 325=NTC_Num_DataRateFltMsg_Q, 326=NTC_Num_DataOtherFltMsg_Q, 328=NTC_Num_InvalidMsg_R, 329=NTC_Num_MissingMsg_R, 330=NTC_Num_CRCFltMsg_R, 331=NTC_Num_PgrsCntFltMsg_R, 332=NTC_Num_DataRngFltMsg_R, 333=NTC_Num_DataRateFltMsg_R, 334=NTC_Num_DataOtherFltMsg_R, 335=NTC_Num_DataOtherFlt2Msg_R, 336=NTC_Num_InvalidMsg_S, 337=NTC_Num_MissingMsg_S, 338=NTC_Num_CRCFltMsg_S, 339=NTC_Num_PgrsCntFltMsg_S, 340=NTC_Num_DataRngFltMsg_S, 341=NTC_Num_DataRateFltMsg_S, 342=NTC_Num_DataOtherFltMsg_S, 344=NTC_Num_InvalidMsg_T, 345=NTC_Num_MissingMsg_T, 346=NTC_Num_CRCFltMsg_T, 347=NTC_Num_PgrsCntFltMsg_T, 348=NTC_Num_DataRngFltMsg_T, 349=NTC_Num_DataRateFltMsg_T, 350=NTC_Num_DataOtherFltMsg_T, 352=NTC_Num_InvalidMsg_U, 353=NTC_Num_MissingMsg_U, 354=NTC_Num_CRCFltMsg_U, 355=NTC_Num_PgrsCntFltMsg_U, 356=NTC_Num_DataRngFltMsg_U, 357=NTC_Num_DataRateFltMsg_U, 358=NTC_Num_DataOtherFltMsg_U, 360=NTC_Num_InvalidMsg_V, 361=NTC_Num_MissingMsg_V, 362=NTC_Num_CRCFltMsg_V, 363=NTC_Num_PgrsCntFltMsg_V, 364=NTC_Num_DataRngFltMsg_V, 365=NTC_Num_DataRateFltMsg_V, 366=NTC_Num_DataOtherFltMsg_V, 368=NTC_Num_InvalidMsg_W, 369=NTC_Num_MissingMsg_W, 370=NTC_Num_CRCFltMsg_W, 371=NTC_Num_PgrsCntFltMsg_W, 372=NTC_Num_DataRngFltMsg_W, 373=NTC_Num_DataRateFltMsg_W, 374=NTC_Num_DataOtherFltMsg_W, 376=NTC_Num_InvalidMsg_X, 377=NTC_Num_MissingMsg_X, 378=NTC_Num_CRCFltMsg_X, 379=NTC_Num_PgrsCntFltMsg_X, 380=NTC_Num_DataRngFltMsg_X, 381=NTC_Num_DataRateFltMsg_X, 382=NTC_Num_DataOtherFltMsg_X, 384=NTC_Num_InvalidMsg_Y, 385=NTC_Num_MissingMsg_Y, 386=NTC_Num_CRCFltMsg_Y, 387=NTC_Num_PgrsCntFltMsg_Y, 388=NTC_Num_DataRngFltMsg_Y, 389=NTC_Num_DataRateFltMsg_Y, 390=NTC_Num_DataOtherFltMsg_Y, 392=NTC_Num_InvalidMsg_Z, 393=NTC_Num_MissingMsg_Z, 394=NTC_Num_CRCFltMsg_Z, 395=NTC_Num_PgrsCntFltMsg_Z, 396=NTC_Num_DataRngFltMsg_Z, 397=NTC_Num_DataRateFltMsg_Z, 398=NTC_Num_DataOtherFltMsg_Z, 399=NTC_Num_DSTXORActive, 400=NTC_Num_InvalidMsg_AA, 401=NTC_Num_MissingMsg_AA, 402=NTC_Num_CRCFltMsg_AA, 403=NTC_Num_PgrsCntFltMsg_AA, 404=NTC_Num_DataRngFltMsg_AA, 405=NTC_Num_DataRateFltMsg_AA, 406=NTC_Num_DataOtherFltMsg_AA, 408=NTC_Num_InvalidMsg_AB, 409=NTC_Num_MissingMsg_AB, 410=NTC_Num_CRCFltMsg_AB, 411=NTC_Num_PgrsCntFltMsg_AB, 412=NTC_Num_DataRngFltMsg_AB, 413=NTC_Num_DataRateFltMsg_AB, 414=NTC_Num_DataOtherFltMsg_AB, 416=NTC_Num_InvalidMsg_AC, 417=NTC_Num_MissingMsg_AC, 418=NTC_Num_CRCFltMsg_AC, 419=NTC_Num_PgrsCntFltMsg_AC, 420=NTC_Num_DataRngFltMsg_AC, 421=NTC_Num_DataRateFltMsg_AC, 422=NTC_Num_DataOtherFltMsg_AC, 424=NTC_Num_InvalidMsg_AD, 425=NTC_Num_MissingMsg_AD, 426=NTC_Num_CRCFltMsg_AD, 427=NTC_Num_PgrsCntFltMsg_AD, 428=NTC_Num_DataRngFltMsg_AD, 429=NTC_Num_DataRateFltMsg_AD, 430=NTC_Num_DataOtherFltMsg_AD, 432=NTC_Num_InvalidMsg_AE, 433=NTC_Num_MissingMsg_AE, 434=NTC_Num_CRCFltMsg_AE, 435=NTC_Num_PgrsCntFltMsg_AE, 436=NTC_Num_DataRngFltMsg_AE, 437=NTC_Num_DataRateFltMsg_AE, 438=NTC_Num_DataOtherFltMsg_AE, 440=NTC_Num_InvalidMsg_AF, 441=NTC_Num_MissingMsg_AF, 442=NTC_Num_CRCFltMsg_AF, 443=NTC_Num_PgrsCntFltMsg_AF, 444=NTC_Num_DataRngFltMsg_AF, 445=NTC_Num_DataRateFltMsg_AF, 446=NTC_Num_DataOtherFltMsg_AF, 448=NTC_Num_InvalidMsg_AG, 449=NTC_Num_MissingMsg_AG, 450=NTC_Num_CRCFltMsg_AG, 451=NTC_Num_PgrsCntFltMsg_AG, 452=NTC_Num_DataRngFltMsg_AG, 453=NTC_Num_DataRateFltMsg_AG, 454=NTC_Num_DataOtherFltMsg_AG, 456=NTC_Num_InvalidMsg_AH, 457=NTC_Num_MissingMsg_AH, 458=NTC_Num_CRCFltMsg_AH, 459=NTC_Num_PgrsCntFltMsg_AH, 460=NTC_Num_DataRngFltMsg_AH, 461=NTC_Num_DataRateFltMsg_AH, 462=NTC_Num_DataOtherFltMsg_AH, 464=NTC_Num_InvalidMsg_ParkAssistParallel (For C1XX), 465=NTC_Num_FlexrayCommunicationError, 466=NTC_Num_InvalidMsg_AI, 467=NTC_Num_MissingMsg_AI, 472=NTC_Num_InvalidMsg_AJ, 473=NTC_Num_MissingMsg_AJ, 480=NTC_Num_InvalidMsg_AK, 481=NTC_Num_MissingMsg_AK, 489=NTC_Num_MissingMsg_AL, 496=NTC_Num_SysConsistencyVerf, 497=NTC_Num_ConfigMisMatch, 498=NTC_Num_CalNotPrgmd, 499=NTC_Num_TunSetNotPrgmd, 501=NTC_Num_EOLVehTunNtPerf, 502=NTC_Num_MtrSensorNotTrimmed, 504=NTC_Num_HWASensorNotTrimmed, 505=NTC_Num_HWASensorTrimNoAttempt, 506=NTC_Num_TrqSensorScaleNotSet, 507=NTC_Num_TrqSensorNotTrimmed, 509=NTC_Num_DigTrqSensorScaleNotSet, 510=NTC_Num_DigTrqSensorNotTrimmed, 500=NTC_Num_EEPROMtoFeeCpyError, 171=NTC_Num_LoaCtrldShutdn, 172=NTC_Num_LoaMgr_HwTqIdptSigTooLow, 173=NTC_Num_LoaMgr_MotAgIdptSigTooLow, 174=NTC_Num_LoaMgr_MotCurrIdptSigTooLow, 175=NTC_Num_LoaMgr_IvtrIdptSigTooLow, 508=NTC_Num_AnaHWDiffTqOfstNotTrmd, 511=NTC_Num_SENTHWDiffTqOfstNotTrmd, 73=NTC_Num_BattVltgMeasdCorrlnFlt, 74=NTC_Num_IvtrPwrDiscnctFailr, 92=NTC_Num_Inv2GateDrvFltInProcess, 93=NTC_Num_Inv2GateDrvFlt, 94=NTC_Num_Inv2OnStateSingleFET, 75=NTC_Num_PowerRelayInit2Flt, 161=NTC_Num_LimpHomeIgnitionCounter, 90=NTC_Num_Ivtr2PwrDiscnctFailr, 91=NTC_Num_SysVltgCorrlnFlt, 22=NTC_Num_PLLSlipNrcvrl, 327=NTC_Num_DataOtherFlt2Msg_Q, 95=NTC_Num_EcuIdnFlt, 127=NTC_Num_ImcArbrFault, 482=NTC_Num_MissingMsg_AM, 483=NTC_Num_InvalidMsg_AM, 484=NTC_Num_CRCFltMsg_AM, 485=NTC_Num_PgrsCntFltMsg_AM, 486=NTC_Num_DataRngFltMsg_AM, 488=NTC_Num_InvalidMsg_AL, 492=NTC_Num_DataRngFltMsg_AL, 494=NTC_Num_DataOtherFltMsg_AL, 135=NTC_Num_TurnCntr_SpiDataFlt, 150=NTC_Num_EcuCrossChk, 167=NTC_Num_AgCompDiagc, 151=NTC_Num_ImcSigArbHighOffsetCorrection, 152=NTC_Num_EcuConfigMismatch, 500=NTC_Num_PHAPosnSnsrVsPwrpkDataWrong, 503=NTC_Num_PHAScratchPadTrf, 125=NTC_Num_IMCLossOfCom, 153=NTC_Num_MotBasdHwAgFlt, 367=NTC_Num_IgnitionStatusSigFlt, 391=NTC_Num_StePinOffstAnEstInvalid, 415=NTC_Num_StePinOffstDStatSigFlt, 383=NTC_Num_WhlSpdSigFlt}
      lower-limit=0
      upper-limit=511
    NvM_BlockIdType: lower-limit=1, upper-limit=32767  # It is the type to be used in the "Port Defined Arguments". According to the NVM API it must result in an uint16 data type; thus the upper limit does not correspond to the number of configured blocks. Therefore the this type is common to all NVM SWC Descriptions. The upper limit is the theoretical maximum number of NVRAM blocks, if NVM_DATASET_SELECTION_BITS equals to 1. (It cannot be 0 since block Id 1 is fixed to be a REDUNDANT NVRAM Block - it consists of two NV blocks)
    NvM_RequestResultType: compu {0=NVM_REQ_OK, 1=NVM_REQ_NOT_OK, 2=NVM_REQ_PENDING, 3=NVM_REQ_INTEGRITY_FAILED, 4=NVM_REQ_BLOCK_SKIPPED, 5=NVM_REQ_NV_INVALIDATED}, lower-limit=0, upper-limit=5
    NxtrDiagMgrStatus: compu {0=NTC_STATUS_PASSED, 1=NTC_STATUS_FAILED, 2=NTC_STATUS_PREPASSED, 3=NTC_STATUS_PREFAILED}, lower-limit=0, upper-limit=255
    NxtrOpCycle: compu {0=NxtrDefaultOpCycle}, lower-limit=0, upper-limit=0
    NxtrOpCycleState: compu {1=NXTR_CYCLE_STATE_START, 2=NXTR_CYCLE_STATE_END}, lower-limit=1, upper-limit=2
    PsaAgArbnDiagCmdReq_Enum: compu {0=PSAAGARBNDIAGCMDREQ_DIAGNOACTN, 1=PSAAGARBNDIAGCMDREQ_DIAGRSTREQ, 2=PSAAGARBNDIAGCMDREQ_DIAGCENTR}, lower-limit=0, upper-limit=2
    PsaAgArbnSt_Enum: compu {0=PSAAGARBNST_STININ, 1=PSAAGARBNST_STPND, 2=PSAAGARBNST_STNOSYNCN, 3=PSAAGARBNST_STESCSYNCN, 4=PSAAGARBNST_STDIAGSYNCN, 5=PSAAGARBNST_STALTVSYNCN, 6=PSAAGARBNST_UNUSED, 7=PSAAGARBNST_STFAIL}, lower-limit=0, upper-limit=7
    PsaApaSt_Cnt_enum: compu {0=PSAAPAST_UNAVL, 1=PSAAPAST_AVL, 2=PSAAPAST_CTRLPRGS, 3=PSAAPAST_DFCT}, lower-limit=0, upper-limit=3
    PsaApaTranCause_Cnt_enum: compu {0=PSAAPATRANCAUSE_NOINTRPT, 1=PSAAPATRANCAUSE_DRVRINTV, 2=PSAAPATRANCAUSE_VEHSPDHI, 3=PSAAPATRANCAUSE_AGLERR, 4=PSAAPATRANCAUSE_MTRSTALL, 5=PSAAPATRANCAUSE_UNUSED, 6=PSAAPATRANCAUSE_THERMLIM, 7=PSAAPATRANCAUSE_OTHERERR}, lower-limit=0, upper-limit=7
    PsaEpsSt_Cnt_enum: compu {0=PSAEPSST_UNAVL, 1=PSAEPSST_AVL, 2=PSAEPSST_DFCT}, lower-limit=0, upper-limit=2
    PsaEpsStLxa_Cnt_enum: compu {0=PSAEPSSTLXA_UNAUTHD, 1=PSAEPSSTLXA_AUTHD, 2=PSAEPSSTLXA_AVL, 3=PSAEPSSTLXA_ACTV, 4=PSAEPSSTLXA_DFCT}, lower-limit=0, upper-limit=4
    PsaLxaSt_Cnt_enum: compu {0=PSALXAST_UNAVL, 1=PSALXAST_UNSELD, 2=PSALXAST_SELD, 3=PSALXAST_AUTHD, 4=PSALXAST_ACTV, 5=PSALXAST_DFCT, 6=PSALXAST_COLLRISK}, lower-limit=0, upper-limit=6
    PsaTunModSt_Cnt_enum: compu {0=PSATUNMODST_NORM, 1=PSATUNMODST_SPORT, 2=PSATUNMODST_TUN, 3=PSATUNMODST_FAILD}, lower-limit=0, upper-limit=3
    SigQlfr_State_enum: compu {0=SIGQLFR_NORES, 1=SIGQLFR_PASS, 2=SIGQLFR_FAIL}, lower-limit=0, upper-limit=2
    SInt4: lower-limit=-8, upper-limit=7  # SInt4 represents integers with a minimum value of -8 and a maximum value of 7. The order-relation on SInt4 is: x < y if y - x is positive. SInt4 has a lexical representation consisting of an optional sign followed by a finite-length sequence of decimal digits (#x30-#x39). If the sign is omitted, "+" is assumed. For example: -1, 0, 2, +4.
    SS_State_enum: compu {0=SS_Normal, 1=SS_Intermediate1, 2=SS_Stop, 3=SS_Intermediate2, 4=SS_Fault, 5=SS_Disable}, lower-limit=0, upper-limit=5
    StaMd_Users: compu {0=STAMD_STOPCTRL, 1=STAMD_VEHPWRMD, 2=STAMD_DIAGMGR, 3=STAMD_PHSDSCNCT, 4=STAMD_MTRDRVR, 5=STAMD_TMPRLMON, 6=STAMD_HWPWUP, 7=STAMD_MTRPOSDIAG}, lower-limit=0, upper-limit=15
    STATUS_CONFABSENT: lower-limit=0, upper-limit=4294967295
      invalid-value:
        integer literal STATUS_CONFABSENT: type=STATUS_CONFABSENT, value=0
    SteerMod_enum: compu {0=STEERMOD_BASEPS, 1=STEERMOD_SEMIATNMS, 2=STEERMOD_FULLYATNMS}, lower-limit=0, upper-limit=2
    SysPrfmncSt_Cnt_enum: compu {0=SYSPRFMNCST_NORM, 1=SYSPRFMNCST_DUTYCYCDPTWARN, 2=SYSPRFMNCST_DUTYCYCDPTLIM, 3=SYSPRFMNCST_TDPTWARN, 4=SYSPRFMNCST_TDPTLIM, 6=SYSPRFMNCST_ASSISTALLDPTLIM, 8=SYSPRFMNCST_HWAGTOMOTAGCORRLN, 9=SYSPRFMNCST_KINEINTDIAGC, 10=SYSPRFMNCST_LOASWBASDMTGTN, 15=SYSPRFMNCST_SYSSTDI}, lower-limit=0, upper-limit=15
    TuningSessionAddrPtrEnum: compu {0=TUN_SESSION_PTR_PERS, 1=TUN_SESSION_PTR_SETS, 2=TUN_SESSION_PTR_COMMON, 3=TUN_SESSION_PTR_SETANDPER, 4=TUN_SESSION_PTR_SETANDPERANDCOMMON, 16=TUN_SESSION_PTR_CUSTSEG, 255=TUN_SESSION_PTR_DISABLED}, lower-limit=0, upper-limit=255
    UInt4: lower-limit=0, upper-limit=15  # UInt4 represents integers with a minimum value of 0 and a maximum value of 15. The order-relation on UInt4 is: x < y if y - x is positive. UInt4 has a lexical representation consisting of a finite-length sequence of decimal digits (#x30-#x39). For example: 1, 0, 12, +10.
    VITESSE_COLONNE: compu {phys=raw for raw -2000..2000; unit Deg/s}, lower-limit=-2000, upper-limit=2000
      invalid-value:
        integer literal VITESSE_COLONNE: type=VITESSE_COLONNE, value=0
    VITESSE_ROT_VOL: compu {phys=raw*4 for raw 0..1016; unit Deg/s}, lower-limit=0, upper-limit=254
      invalid-value:
        integer literal VITESSE_ROT_VOL: type=VITESSE_ROT_VOL, value=0
    VITESSE_ROT_VOL_OPTIMISE: compu {phys=raw*4 for raw 0..1016}, lower-limit=0, upper-limit=255
      invalid-value:
        integer literal VITESSE_ROT_VOL_OPTIMISE: type=VITESSE_ROT_VOL_OPTIMISE, value=0
    WdgM_CheckpointIdType: lower-limit=0, upper-limit=65535
    WdgM_GlobalStatusType: compu {0=WDGM_GLOBAL_STATUS_OK, 1=WDGM_GLOBAL_STATUS_FAILED, 2=WDGM_GLOBAL_STATUS_EXPIRED, 3=WDGM_GLOBAL_STATUS_STOPPED, 4=WDGM_GLOBAL_STATUS_DEACTIVATED}, lower-limit=0, upper-limit=255
    WdgM_LocalStatusType: compu {0=WDGM_LOCAL_STATUS_OK, 1=WDGM_LOCAL_STATUS_FAILED, 2=WDGM_LOCAL_STATUS_EXPIRED, 4=WDGM_LOCAL_STATUS_DEACTIVATED}, lower-limit=0, upper-limit=255
    WdgM_ModeType: lower-limit=0, upper-limit=255
    WdgM_SupervisedEntityIdType: lower-limit=0, upper-limit=65535
  28 x record type:
    AvgFricLrnType
      8 x record element:
        FricOffset_HwNm_f32: type=Float
        EOLFric_HwNm_f32: type=Float
        EnableFricOffsetOutput_Cnt_lgc: type=Boolean
        EnableFricLearning_Cnt_lgc: type=Boolean
        OpMode_Cnt_enum: type=UInt8
        RangeCounter_Cnt_u16: type=AvgFricLrnRangeCounterType
        Theta_HwNm_f32: type=AvgFricLrnThetaType
        VehLearnedFric_HwNm_f32: type=AvgFricLrnVehLearnedFricType
    CurrTempOffsetType
      record element CurrTempOffsetX_DegC_s10p5: type=CurrTempOffsetTblType
      record element CurrOffsetY1_Volts_s4p11: type=CurrTempOffsetTblType
      record element CurrOffsetY2_Volts_s4p11: type=CurrTempOffsetTblType
    DiagSettings_Str
      record element Threshold: type=UInt16
      record element PStep: type=UInt16
      record element NStep: type=UInt16
    DigHwTrqSENTTrim_DataType
      record element k_EOLHwTrqTrim_HwNm_f32: type=Float
      record element k_EOLHwTrqTrimPerformed_Cnt_Lgc: type=Boolean
    DigMSBEOLType
      5 x record element:
        MtrPosBEMF_Rev_u0p16: type=UInt16
        MtrPosBEMFRedundant_Rev_u0p16: type=UInt16
        MtrPos1HarCompTbl_Rev_s2p13: type=HarCompTbl
        MtrPos2HarCompTbl_Rev_s2p13: type=HarCompTbl
        CRC_Cnt_u16: type=UInt16
    EOLChOffsetTrim_DataType
      record element HwTqArb_EOLChOffsetTrim_HwNm_f32: type=Float
      record element HwTqArb_EOLChOffsetTrimPerf_Cnt_lgc: type=Boolean
    EOLHwPosTrimType
      record element EOLVehCntrOffset_HwDeg_f32: type=Float
      record element EOLHwPosTrimPerformed_Cnt_u16: type=UInt16
    EOLNomMtrParamType
      record element NomKe_VpRadpS_f32: type=Float
      record element NomRmtr_Ohm_f32: type=Float
    EOTLearned_DataType
      4 x record element:
        CWEOTPosition_HwDeg_f32: type=Float
        CCWEOTPosition_HwDeg_f32: type=Float
        CWEOTFound_Cnt_lgc: type=Boolean
        CCWEOTFound_Cnt_lgc: type=Boolean
    FaultDataType
      8 x record element, all with type=UInt8:
        Byte{1..6}_Cnt_u08
        Reserved1_Cnt_u08
        Reserved2_Cnt_u08
    FaultLogType
      record element CTCFailData: type=FaultDataArrayType
      record element CTCPassData: type=FaultDataArrayType
      record element QueueData: type=QueueDataArrayType
    IS_DAT_DIRA_Msg
      9 x record element:
        CpleVolant: type=CPLE_VOLANT
        EtatDa2004: type=ETAT_DA_2004
        EtatDaDyn: type=ETAT_DA_DYN
        EtatDa2010: type=ETAT_DA_2010
        TrqLimitState: type=TRQ_LIMIT_STATE
        SteerwhlHoldByDrv: type=STEERWHL_HOLD_BY_DRV
        EpsStateLka: type=EPS_STATE_LKA
        AutorArretMotDa: type=AUTOR_ARRET_MOT_DA
        DdeRedemDa: type=DDE_REDEM_DA
    IS_DYN_DAE_Msg
      9 x record element:
        CptProcess4bDae: type=CPT_PROCESS_4B_DAE
        ChksumTrmeDynDae: type=CHKSUM_TRME_DYN_DAE
        CpleVolantOptimse: type=CPLE_VOLANT_OPTMSE
        CauseDesactivCpk: type=CAUSE_DESACTIV_CPK
        EtatDaeCpk: type=ETAT_DAE_CPK
        AngleColonne: type=ANGLE_COLONNE
        EtatSecuAngleCol: type=ETAT_SECU_ANGLE_COL
        EtatDaeCav3Virtuel: type=ETAT_DAE_CAV3_VIRTUEL
        VitesseColonne: type=VITESSE_COLONNE
    IS_DYN_VOL_MsgAdd
      8 x record element:
        EtatCaptVol: type=ETAT_CAPT_VOL
        CalibrationVol: type=CALIBRATION_VOL
        TrimVol: type=TRIM_VOL
        CodeDefaultVol: type=CODE_DEFAUT_VOL
        VitesseRotVolOptimise: type=VITESSE_ROT_VOL_OPTIMISE
        AngleVolantOrigine: type=ANGLE_VOLANT_ORIGINE
        FlgAvolIcn: type=FLG_AVOL_ICN
        FlgInitAvol: type=FLG_INIT_AVOL
    IS_DYN_VOL_MsgBase
      5 x record element:
        AngleVolant: type=ANGLE_VOLANT
        VitesseRotVol: type=VITESSE_ROT_VOL
        SensRotVol: type=SENS_ROT_VOL
        CptProcess4bAVol: type=CPT_PROCESS_4B_A_VOL
        ChksumVol: type=CHKSUM_VOL
    IS_SUPV_DIRA_Msg
      4 x record element:
        CodeDefaut: type=CODE_DEFAUT
        StatusConfabsent: type=STATUS_CONFABSENT
        EtatAssistDa: type=ETAT_ASSIST_DA
        EtatLigneApc: type=ETAT_LIGNE_APC
    MtrPos2Cal_DataType
      6 x record element:
        Sin2Offset_Volts_u3p13: type=UInt16
        Sin2AmpRec_Uls_u3p13: type=UInt16
        Cos2Offset_Volts_u3p13: type=UInt16
        Cos2AmpRec_Uls_u3p13: type=UInt16
        SinDelta2_Uls_s2p13: type=SInt16
        CosDelta2Rec_Uls_u3p13: type=UInt16
    MtrPos3Cal_DataType
      7 x record element:
        BEMFCal_Rev_u0p16: type=UInt16
        Sin3Offset_Volts_u3p13: type=UInt16
        Sin3AmpRec_Uls_u3p13: type=UInt16
        Cos3Offset_Volts_u3p13: type=UInt16
        Cos3AmpRec_Uls_u3p13: type=UInt16
        SinDelta3_Uls_s2p13: type=SInt16
        CosDelta3Rec_Uls_u3p13: type=UInt16
    MtrPosCal_DataType
      14 x record element:
        BEMFCal_Rev_u0p16: type=UInt16
        R_BEMFCal_Rev_u0p16: type=UInt16
        Sin1Offset_Volts_u3p13: type=UInt16
        Sin1AmpRec_Uls_u3p13: type=UInt16
        Cos1Offset_Volts_u3p13: type=UInt16
        Cos1AmpRec_Uls_u3p13: type=UInt16
        SinDelta1_Uls_s2p13: type=SInt16
        CosDelta1Rec_Uls_u3p13: type=UInt16
        Sin1OffCorr_Volts_s2p13: type=SInt16
        Sin1GainCorr_Uls_u1p15: type=UInt16
        Cos1OffCorr_Volts_s2p13: type=SInt16
        Cos1GainCorr_Uls_u1p15: type=UInt16
        SinHarTbl_Cnt_sm6p13: type=DT_Array144_s8
        CosHarTbl_Cnt_sm6p13: type=DT_Array144_s8
    OvervoltageDataType
      record element MaxBattVoltage_Volts_f32: type=Float
      record element OvervoltageCounter_Cnt_u16: type=UInt16
    PhaseCurrCal_DataType
      7 x record element, all with type=Float:
        EOLMtrCurrVcalCmd_VoltCnts_f32
        EOLMtrCurr1OffsetLo_Volts_f32
        EOLPhscurr1Gain_AmpspVolt_f32
        EOLPhscurr2Gain_AmpspVolt_f32
        EOLMtrCurr2OffsetLo_Volts_f32
        EOLMtrCurr1OffsetDiff_Volts_f32
        EOLMtrCurr2OffsetDiff_Volts_f32
    Polarity_DataType
      record element Polarity_Cnt_u32: type=UInt32
      record element R_Polarity_Cnt_u32: type=UInt32
    PsaAgAnLrndOffs_Str
      4 x record element:
        MaxOffset: type=Float
        MinOffset: type=Float
        MaxSrc: type=UInt8
        MinSrc: type=UInt8
    QueueDataType
      record element QueueEventIdx_Cnt_u08: type=UInt8
      record element Status_Cnt_u08: type=UInt8
    ShutdownTimeType
      record element Time_Sec_u32: type=UInt32
      record element Valid_Cnt_lgc: type=Boolean
    SysOutpCpbySig_Str
      10 x record element, all with type=Float:
        CwHwAg{1..5}
        CcwHwAg{1..5}
    ThrmlDutyCycle_FltStVal_Datatype
      4 x record element, all with type=UInt8:
        Filt{3..6}Val_Cnt_u8
    VehDyn_DataType
      record element NVMStoredLastPos_HwDeg_f32: type=Float
      record element NVMStoredLastPosValid_Cnt_lgc: type=Boolean
package /DataType/DataTypeUnits
  unit Deg: display-name=Deg
  unit Deg_s: display-name=Deg/s
  unit Nm: display-name=Nm
